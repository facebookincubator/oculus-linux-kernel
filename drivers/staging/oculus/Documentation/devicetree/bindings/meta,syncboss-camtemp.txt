## drivers/staging/oculus/Documentation/devicetree/bindings/meta,syncboss-camtemp.txt
```
=========================================
Meta SyncBoss Camera Temperature Provider
=========================================

Exposes the camera on-die temperatures reported by the SyncBoss MCU as thermal
zones.

The MCU owns the camera imagers and stamps a camera's on-die temperature into
every camera shutter packet it sends to the AP. That packet is delivered to
userspace only through the camera metadata stream, which is readable only by
the process that owns the stream. This driver registers as a SyncBoss packet
consumer, takes the temperature out of the shutter packets the SyncBoss driver
already delivers in-kernel, and republishes it through the thermal framework,
where any number of readers can poll it concurrently.

Because the temperature arrives with camera frames, a zone only reports a live
value while its camera is streaming. When the camera is not streaming the MCU
has no reading to report and the zone reads 0, which is not a temperature a
powered die can produce. Consumers must treat 0 as "not measuring" and never as
a passing measurement. Readings are also dropped when the SyncBoss stream stops
or the MCU goes down, so a stale value is never served.

Only cameras whose imagers implement an on-die temperature register are
supported. The eye-tracking imagers do not have one.

SyncBoss Camera Temperature Node
--------------------------------

The node must be a child of a "meta,syncboss-spi" node.

Required properties:
- compatible : Should be "meta,syncboss-camtemp", "meta,syncboss-consumer".
- #thermal-sensor-cells : Required by the thermal framework, should be 1. The
        cell is the camera id, matching the camera ids used by the MCU firmware
        and the cam<id>-usr thermal zone naming convention.

A thermal zone is registered only for the camera ids that a thermal zone in the
device tree actually refers to.

Example:

&syncboss_nrf54l15 {
        syncboss_camtemp: camtemp@0 {
                compatible = "meta,syncboss-camtemp", "meta,syncboss-consumer";
                #thermal-sensor-cells = <1>;
        };
};

&thermal_zones {
        cam2-usr {
                polling-delay-passive = <0>;
                polling-delay = <0>;
                thermal-sensors = <&syncboss_camtemp 2>;
        };
};
```

## drivers/staging/oculus/Kconfig.test
```kconfig
config HZOS_EXT_GPU_FREQ_KUNIT_TEST
	tristate "KUnit tests for hzos_ext gpu.freq parse helper" if !KUNIT_ALL_TESTS
	depends on KUNIT && CGROUP_GPU
	default KUNIT_STAGING_OCULUS
	help
	  Unit tests for the self-contained gpu_freq_parse_khz() helper in
	  hzos_ext/hzos_ext_gpu_freq.h.  The test includes only the header and
	  requires CONFIG_CGROUP_GPU for the gpu_cgroup.h definitions.

config HZOS_EXT_TAG_KUNIT_TEST
	tristate "KUnit tests for hzos_ext tag store helper" if !KUNIT_ALL_TESTS
	depends on KUNIT && HZOS_EXT
	default KUNIT_STAGING_OCULUS
	help
	  Unit tests for the self-contained hzos_ext_tag_store() helper in
	  linux/hzos_ext_tag.h.  The test includes only the header.

config KUNIT_STAGING_OCULUS
	tristate "Enable all KUnit tests for Oculus staging drivers"
	depends on KUNIT
	select DMABUF_REORDER_KUNIT_TEST if DMABUF_REORDER
	select MISCFIFO_KUNIT_TEST if MISCFIFO
	select META_SWD_FWUPDATE_KUNIT_TEST if META_SWD
	select HZOS_EXT_GPU_FREQ_KUNIT_TEST if CGROUP_GPU
	select HZOS_EXT_TAG_KUNIT_TEST if HZOS_EXT
	select META_PROGLOGIC_KUNIT_TEST if META_PROGLOGIC
	select META_LPD_KUNIT_TEST if META_LPD
	help
	  Master switch to enable all KUnit tests under drivers/staging/oculus/.

config RT_THROTTLE_KUNIT_TEST
	tristate "KUnit tests for the RT throttle dump" if !KUNIT_ALL_TESTS
	depends on KUNIT && RT_THROTTLING_SYSCTL
	default n
	help
	  Behavioural tests for the sched_rt throttle dump. Drives a real
	  throttle with a pinned FIFO kthread and checks the latched
	  /proc/sys/sched_rt data: that the process name is a name rather than
	  "unavailable", and that contributor rows keep the column layout the
	  crash-report preprocessor parses.

	  Costs one CPU for about one RT period per test case. Skips unless
	  /proc/sys/sched_rt/panic_on_throttle is 0, since tripping the
	  throttle with it armed panics the device.

	  Not selected by KUNIT_STAGING_OCULUS, and off by default: all
	  privileged setup runs from kunit_suite::suite_init, which kernels
	  older than 5.17 do not have, and a per-case init cannot substitute
	  because KUnit runs cases in a kthread that gets -EACCES on /proc/sys.
	  Enable it per target in the defconfig: niobe and newer.

config DMABUF_REORDER_KUNIT_TEST
	tristate "KUnit tests for dmabuf_reorder helpers" if !KUNIT_ALL_TESTS
	depends on KUNIT && !QCOM_MEM_BUF
	default KUNIT_STAGING_OCULUS
	help
	  Unit tests for the dmabuf_reorder scatterlist helper functions.

config MISCFIFO_KUNIT_TEST
	tristate "KUnit tests for miscfifo" if !KUNIT_ALL_TESTS
	depends on KUNIT && MISCFIFO
	default KUNIT_STAGING_OCULUS
	help
	  Unit tests for the miscfifo chardev driver.

config META_SWD_FWUPDATE_KUNIT_TEST
	tristate "KUnit tests for SWD fwupdate manager" if !KUNIT_ALL_TESTS
	depends on KUNIT && META_SWD
	default KUNIT_STAGING_OCULUS
	help
	  Unit tests for the SWD firmware update manager APIs.

config META_PROGLOGIC_KUNIT_TEST
	tristate "KUnit tests for meta-proglogic" if !KUNIT_ALL_TESTS
	depends on KUNIT && META_PROGLOGIC
	select REGMAP_I2C
	default KUNIT_STAGING_OCULUS
	help
	  Unit tests for the meta-proglogic control-bit data model, variant
	  selection, and the tether/SD LPD enable and latch-clear APIs. Builds
	  as meta-proglogic_test.ko; the driver's tables and helpers are reached
	  via VISIBLE_IF_KUNIT in meta-proglogic_internal.h.

config META_LPD_KUNIT_TEST
	tristate "KUnit tests for meta-lpd" if !KUNIT_ALL_TESTS
	depends on KUNIT && META_LPD
	default KUNIT_STAGING_OCULUS
	help
	  Unit tests for the meta-lpd shared decision model (per-source
	  request helpers and reconciler) and the tether state machine.
	  Builds as meta-lpd_kunit_test.ko; the tether state machine is
	  reached via EXPORT_SYMBOL_IF_KUNIT in meta-lpd_tether.c.
```
