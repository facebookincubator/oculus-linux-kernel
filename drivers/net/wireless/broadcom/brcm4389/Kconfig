## drivers/staging/qcacld-3.0/configs/peach_defconfig
```kconfig
CONFIG_CNSS_PEACH := y
CONFIG_CNSS_KIWI := y
CONFIG_CNSS_KIWI_V2 := y

#Enable 11BE EHT
CONFIG_WLAN_FEATURE_11BE := y

# Max Sta Vdev Config
CONFIG_CFG_MAX_STA_VDEVS := 4

#Enable 11BE MLO
CONFIG_WLAN_FEATURE_11BE_MLO := y

#BMISS offload max vdev config
CONFIG_CFG_BMISS_OFFLOAD_MAX_VDEV := 4

#Max MLD dev context
CONFIG_WLAN_UMAC_MLO_MAX_DEV := 3

#Chip version
CONFIG_CHIP_VERSION := 1

#DP configs
CONFIG_WLAN_DP_DISABLE_TCL_CMD_CRED_SRNG := y
CONFIG_WLAN_DP_DISABLE_TCL_STATUS_SRNG := y

# Enable separate FW image
CONFIG_GET_DRIVER_MODE := y

CONFIG_QCA_SUPPORT_TX_MIN_RATES_FOR_SPECIAL_FRAMES := y

#Enable COEX feature
CONFIG_FEATURE_COEX := y

#Enable DBAM feature
CONFIG_WLAN_FEATURE_COEX_DBAM := y

CONFIG_DP_TRAFFIC_END_INDICATION := y

#Enable Constrained Application Protocol feature
CONFIG_WLAN_FEATURE_COAP := y

#Enable TSF read using scratch register
CONFIG_QCA_GET_TSF_VIA_REG := y

CONFIG_HANDLE_RX_REROUTE_ERR := y

#Enable DP Bus Vote
CONFIG_WLAN_FEATURE_DP_BUS_BANDWIDTH := y

#Enable KIWI based Configs
ifeq ($(CONFIG_CNSS_EMULATION), y)
	CONFIG_QCA_WIFI_EMULATION := y
endif
CONFIG_EMULATION_2_0 := y
CONFIG_DIRECT_BUF_RX_ENABLE := y
CONFIG_WMI_DBR_SUPPORT := y
CONFIG_WLAN_CFR_ENABLE := y
CONFIG_WLAN_ENH_CFR_ENABLE := y
CONFIG_BERYLLIUM := y
CONFIG_WLAN_FEATURE_11AX := y
CONFIG_WLAN_FEATURE_SR := y
CONFIG_OBSS_PD := y
CONFIG_WLAN_TWT_SAP_STA_COUNT := y
CONFIG_WLAN_TWT_SAP_PDEV_COUNT := y
CONFIG_WLAN_FEATURE_DFS_OFFLOAD := y
CONFIG_DP_BE_WAR := y
CONFIG_SCALE_INCLUDES := y
CONFIG_HASTINGS_BT_WAR := y
CONFIG_WDI3_IPA_OVER_GSI := y
CONFIG_WLAN_FEATURE_LRO_CTX_IN_CB := y
CONFIG_PCIE_GEN_SWITCH := y
CONFIG_ATH_SUPPORT_SPECTRAL := n
CONFIG_DP_FEATURE_HW_COOKIE_CONVERSION := y
CONFIG_DP_HW_COOKIE_CONVERT_EXCEPTION := y
CONFIG_WLAN_FEATURE_NEAR_FULL_IRQ := y
CONFIG_WLAN_SYSFS_DP_STATS := y
CONFIG_DP_USE_REDUCED_PEER_ID_FIELD_WIDTH := y
CONFIG_DISABLE_STATUS_RING_TIMER_WAR := y
CONFIG_CE_DISABLE_SRNG_TIMER_IRQ := y
CONFIG_TX_ADDR_INDEX_SEARCH := y
CONFIG_DP_CON_MON_MSI_ENABLED := y
CONFIG_DEVICE_FORCE_WAKE_ENABLE :=y
CONFIG_HIF_REG_WINDOW_SUPPORT :=y
CONFIG_WINDOW_REG_PLD_LOCK_ENABLE := y
CONFIG_TX_MULTI_TCL := y
CONFIG_OFDM_SCRAMBLER_SEED := y
CONFIG_WLAN_RX_MON_PARSE_CMN_USER_INFO := y
CONFIG_WLAN_FEATURE_WMI_DIAG_OVER_CE7 := y
CONFIG_WLAN_TSF_UPLINK_DELAY := y
CONFIG_WLAN_SYNC_TSF_PLUS := y
CONFIG_WLAN_SYNC_TSF_TIMER := y
CONFIG_WIFI_POS_PASN := y
CONFIG_WLAN_DP_SRNG_USAGE_WM_TRACKING := y
CONFIG_WLAN_FEATURE_PEER_TXQ_FLUSH_CONF := y
CONFIG_DP_PKT_STATS_PER_LMAC := y
CONFIG_WLAN_FEATURE_RX_BUFFER_POOL := y
CONFIG_DP_RX_BUFFER_POOL_SIZE := 128
CONFIG_DP_RX_BUFFER_POOL_ALLOC_THRES := 5
CONFIG_NO_RX_PKT_HDR_TLV := y
ifeq ($(CONFIG_DP_CON_MON_MSI_ENABLED), y)
	CONFIG_DP_CON_MON_MSI_SKIP_SET := y
endif
CONFIG_QCA_WIFI_MONITOR_MODE_NO_MSDU_START_TLV_SUPPORT := y
CONFIG_WLAN_FEATURE_MCC_QUOTA := y
CONFIG_QCACLD_FEATURE_GAP_LL_PS_MODE := y
CONFIG_MON_ENABLE_DROP_FOR_NON_MON_PMAC := y
CONFIG_DP_WAR_INVALID_FIRST_MSDU_FLAG := y
#Enable 6 GHz Band
CONFIG_BAND_6GHZ := y
CONFIG_RX_FISA := y
CONFIG_MORE_TX_DESC := y

#Enable Berrylium based Configs
CONFIG_FIX_TXDMA_LIMITATION := y
CONFIG_PEER_PROTECTED_ACCESS := y
CONFIG_SERIALIZE_QUEUE_SETUP := y
CONFIG_DP_RX_PKT_NO_PEER_DELIVER := y
CONFIG_DP_RX_DROP_RAW_FRM := y
CONFIG_FEATURE_ALIGN_STATS_FROM_DP := y
CONFIG_DP_RX_SPECIAL_FRAME_NEED := y
CONFIG_FEATURE_STATS_EXT_V2 := y
CONFIG_WLAN_FEATURE_DP_RX_THREADS := y
CONFIG_WLAN_FEATURE_RX_SOFTIRQ_TIME_LIMIT := y
CONFIG_FEATURE_NO_DBS_INTRABAND_MCC_SUPPORT := y
CONFIG_HAL_DISABLE_NON_BA_2K_JUMP_ERROR := y
CONFIG_ENABLE_HAL_SOC_STATS := y
CONFIG_ENABLE_HAL_REG_WR_HISTORY := y
CONFIG_MON_ENABLE_DROP_FOR_MAC := y
CONFIG_PCI_LINK_STATUS_SANITY := y
CONFIG_DDP_MON_RSSI_IN_DBM := y
CONFIG_SYSTEM_PM_CHECK := y
CONFIG_DISABLE_EAPOL_INTRABSS_FWD := y
CONFIG_FEATURE_RX_LINKSPEED_ROAM_TRIGGER := y
CONFIG_FEATURE_AST := n
CONFIG_WIFI_MONITOR_SUPPORT := y
CONFIG_QCA_MONITOR_PKT_SUPPORT := y
CONFIG_MONITOR_MODULARIZED_ENABLE := n
#Flag to enable Legacy Fast Roaming3(LFR3)
CONFIG_QCACLD_WLAN_LFR3 := y
CONFIG_DP_HW_TX_DELAY_STATS_ENABLE := y
CONFIG_WLAN_FEATURE_DP_EVENT_HISTORY := y
CONFIG_DYNAMIC_RX_AGGREGATION := y
CONFIG_WLAN_SUPPORT_DATA_STALL := y
CONFIG_WLAN_DP_PER_RING_TYPE_CONFIG := y
CONFIG_WLAN_CE_INTERRUPT_THRESHOLD_CONFIG := y
#Enable WMI TX/RX over QMI
CONFIG_WMI_SEND_RECV_QMI := y
CONFIG_WLAN_DP_PENDING_MEM_FLUSH := y
CONFIG_WLAN_SKIP_BAR_UPDATE := y
CONFIG_TX_MULTIQ_PER_AC := y
CONFIG_WLAN_TRACEPOINTS := y
ENABLE_CE4_COMP_DISABLE_HTT_HTC_MISC_LIST := y
# Flag to enable FW based TX Flow control
CONFIG_WLAN_TX_FLOW_CONTROL_V2 := y
CONFIG_RX_DEFRAG_DO_NOT_REINJECT := y
CONFIG_MARK_ICMP_REQ_TO_FW := y
CONFIG_IPA_SET_RESET_TX_DB_PA := y
# Enable fw stats version 2
CONFIG_AR900B := y
# Enable Shadow V3 for all Beryllium platform
CONFIG_SHADOW_V3 := y
#Disable pktlog feature for Beryllium based target
CONFIG_FEATURE_PKTLOG := n
#Disable packet log
CONFIG_REMOVE_PKT_LOG := y
#Customize DSCP_to-UP map based on RFC8325
CONFIG_WLAN_CUSTOM_DSCP_UP_MAP := y
CONFIG_WAPI_BIG_ENDIAN := y
CONFIG_WLAN_FEATURE_BMI := n
CONFIG_LL_DP_SUPPORT := y
CONFIG_LL_DP_SUPPORT := y
#Define the legacy pktlog
CONFIG_PKTLOG_LEGACY := n
# Enable VERBOSE debug INI mechanism
CONFIG_VERBOSE_DEBUG := y
CONFIG_RX_DESC_SANITY_WAR := y
ifeq ($(CONFIG_PCI_MSM), $(filter $(CONFIG_PCI_MSM), m y))
	CONFIG_FEATURE_HAL_DELAYED_REG_WRITE := y
endif

CONFIG_KIWI_HEADERS_DEF := y
CONFIG_QCA_WIFI_KIWI := y

CONFIG_QCA_WIFI_QCA8074 := y
CONFIG_QCA_WIFI_QCA8074_VP := y
CONFIG_DP_INTR_POLL_BASED := y
CONFIG_TX_PER_PDEV_DESC_POOL := y
CONFIG_DP_TRACE := y
CONFIG_FEATURE_TSO := y
CONFIG_FEATURE_FORCE_WAKE := y
CONFIG_DP_LFR := y
CONFIG_DUP_RX_DESC_WAR := y
CONFIG_HTT_PADDR64 := y
CONFIG_RX_OL := y
CONFIG_TX_TID_OVERRIDE := y
CONFIG_DP_TXRX_SOC_ATTACH := y
ifeq ($(CONFIG_WLAN_FEATURE_DP_BUS_BANDWIDTH), y)
	CONFIG_WLAN_CLD_PM_QOS := y
endif
CONFIG_WLAN_CLD_DEV_PM_QOS := y
CONFIG_DISABLE_DP_STATS := n
CONFIG_MAX_ALLOC_PAGE_SIZE := y
CONFIG_REO_DESC_DEFER_FREE := y
CONFIG_RXDMA_ERR_PKT_DROP := y
CONFIG_DELIVERY_TO_STACK_STATUS_CHECK := y
CONFIG_WLAN_TRACE_HIDE_MAC_ADDRESS := n
CONFIG_WLAN_TRACE_HIDE_SSID := n
CONFIG_DP_MEM_PRE_ALLOC := y
CONFIG_FEATURE_GPIO_CFG := y
ifeq ($(CONFIG_FEATURE_TSO), y)
	CONFIG_FEATURE_TSO_STATS := y
	CONFIG_TSO_DEBUG_LOG_ENABLE := y
endif
ifeq ($(CONFIG_DISABLE_DP_STATS), y)
	CONFIG_FEATURE_TSO_STATS := n
endif

ifeq ($(CONFIG_CNSS2), m)
	CONFIG_CNSS2_MODULE := y
endif
ifeq ($(CONFIG_CNSS_GENL), m)
	CONFIG_CNSS_GENL_MODULE := y
endif
ifeq ($(CONFIG_CNSS_UTILS), m)
	CONFIG_CNSS_UTILS_MODULE := y
endif
ifeq ($(CONFIG_WCNSS_MEM_PRE_ALLOC), m)
	CONFIG_WCNSS_MEM_PRE_ALLOC_MODULE := y
endif

ifdef CONFIG_IPCIE_FW_SIM
	CONFIG_ROME_IF = ipci
	CONFIG_PLD_IPCI_ICNSS_FLAG := n
endif

ifeq (y,$(findstring y,$(CONFIG_CNSS) $(CONFIG_CNSS_MODULE) $(CONFIG_CNSS2) $(CONFIG_CNSS2_MODULE)))
ifndef CONFIG_ROME_IF
	#use pci as default interface
ifndef CONFIG_IPCIE_FW_SIM
	CONFIG_ROME_IF = pci
endif
endif
endif

# Make WLAN as open-source driver by default
WLAN_OPEN_SOURCE := y

ifneq ($(DEVELOPER_DISABLE_BUILD_TIMESTAMP), y)
ifneq ($(WLAN_DISABLE_BUILD_TAG), y)
CONFIG_BUILD_TAG := y
endif
endif

CONFIG_WLAN_FEATURE_MBSSID := y
CONFIG_WLAN_FEATURE_P2P_P2P_STA := y

#Flag to enable Dynamic MAC address update
CONFIG_WLAN_FEATURE_DYNAMIC_MAC_ADDR_UPDATE := y

#Flag to enable hdd memory dump feature
CONFIG_FEATURE_MEMDUMP_ENABLE := y

#Flag to enable/disable WLAN D0-WOW
ifeq ($(CONFIG_PCI_MSM), y)
ifeq ($(CONFIG_HIF_PCI), y)
CONFIG_FEATURE_WLAN_D0WOW := y
endif
endif

ifneq ($(CONFIG_MOBILE_ROUTER), y)
#Flag to enable TDLS feature
CONFIG_QCOM_TDLS := y

CONFIG_WLAN_SYSFS := y

CONFIG_THERMAL_STATS_SUPPORT := y

#Flag to enable pre cac feature
CONFIG_FEATURE_WLAN_PRE_CAC := y

ifeq ($(CONFIG_WLAN_SYSFS), y)
	CONFIG_WLAN_SYSFS_STA_INFO := y
	CONFIG_WLAN_SYSFS_CHANNEL := y
	CONFIG_WLAN_SYSFS_FW_MODE_CFG := y
	CONFIG_WLAN_SYSFS_MEM_STATS := y
	CONFIG_WLAN_REASSOC := y
	CONFIG_WLAN_SYSFS_CONNECT_INFO := y
	CONFIG_WLAN_SCAN_DISABLE := y
	CONFIG_WLAN_SYSFS_DCM := y
	CONFIG_WLAN_WOW_ITO := y
	CONFIG_WLAN_WOWL_ADD_PTRN := y
	CONFIG_WLAN_WOWL_DEL_PTRN := y
	CONFIG_WLAN_SYSFS_TX_STBC := y
	CONFIG_WLAN_SYSFS_WLAN_DBG := y
	CONFIG_WLAN_TXRX_FW_ST_RST := y
	CONFIG_WLAN_GTX_BW_MASK := y
	CONFIG_WLAN_SYSFS_SCAN_CFG := y
	CONFIG_WLAN_SYSFS_MONITOR_MODE_CHANNEL := y
	CONFIG_WLAN_SYSFS_RADAR := y
	CONFIG_WLAN_SYSFS_RTS_CTS := y
	CONFIG_WLAN_SYSFS_HE_BSS_COLOR := y
	CONFIG_WLAN_TXRX_FW_STATS := y
	CONFIG_WLAN_TXRX_STATS := y
	CONFIG_WLAN_SYSFS_DP_TRACE := y
	CONFIG_WLAN_SYSFS_STATS := y
ifeq ($(CONFIG_QCOM_TDLS), y)
	CONFIG_WLAN_SYSFS_TDLS_PEERS := y
endif
	CONFIG_WLAN_SYSFS_TEMPERATURE := y
	CONFIG_WLAN_THERMAL_CFG := y
	CONFIG_WLAN_DL_MODES := y
	CONFIG_WLAN_DUMP_IN_PROGRESS := n
	CONFIG_WLAN_BMISS := y
	CONFIG_WLAN_FREQ_LIST := y
	CONFIG_DP_PKT_ADD_TIMESTAMP := y
	CONFIG_WLAN_SYSFS_RANGE_EXT := y
	# Enable EHT rate sysfs entry
	CONFIG_WLAN_SYSFS_EHT_RATE := y
endif
CONFIG_WLAN_PDEV_VDEV_SEND_MULTI_PARAM := y
CONFIG_WLAN_POWER_DEBUG := y
#Enable Beacon Reception Stats
CONFIG_FEATURE_BECN_STATS := y
#Flag to enable NAN
CONFIG_QCACLD_FEATURE_NAN := y
endif

CONFIG_WLAN_FEATURE_MEDIUM_ASSESS := y

CONFIG_QCACLD_FEATURE_GREEN_AP := y

#Flag to enable Android Packet Filtering
CONFIG_QCACLD_FEATURE_APF := y

#Flag to enable SARv1 -> SARv2 conversion
CONFIG_WLAN_FEATURE_SARV1_TO_SARV2 := y

#Flag to enable get firmware state
CONFIG_QCACLD_FEATURE_FW_STATE := y

#Flag to enable set coex configuration
CONFIG_QCACLD_FEATURE_COEX_CONFIG := n

#Flag to enable Fast Transition (11r) feature
CONFIG_QCOM_VOWIFI_11R := y

#Flag to enable disable ACTION OUI feature
CONFIG_WLAN_FEATURE_ACTION_OUI := y

#Flag to enable Adaptive 11r feature
CONFIG_ADAPTIVE_11R := y

#Flag to enable sae single pmk feature
CONFIG_SAE_SINGLE_PMK := y

#Flag to enable/disable multi client low latency feature support
CONFIG_MULTI_CLIENT_LL_SUPPORT := y

#Flag to enable/disable vendor handoff feature support
CONFIG_WLAN_VENDOR_HANDOFF_CONTROL := y

#Flag to enable mscs feature
CONFIG_FEATURE_MSCS := y

#Flag to enable FILS Feature (11ai)
CONFIG_WLAN_FEATURE_FILS := y
ifneq ($(CONFIG_QCA_CLD_WLAN),)
	ifeq (y,$(findstring y,$(CONFIG_CNSS) $(CONFIG_CNSS_MODULE) $(CONFIG_CNSS2) \
			$(CONFIG_CNSS2_MODULE) $(CONFIG_ICNSS) $(CONFIG_ICNSS_MODULE) \
			$(CONFIG_ICNSS2) $(CONFIG_ICNSS2_MODULE)))
	#Flag to enable Protected Management Frames (11w) feature
	CONFIG_WLAN_FEATURE_11W := y
	#Flag to enable LTE CoEx feature
	CONFIG_QCOM_LTE_COEX := y
	ifneq ($(CONFIG_MOBILE_ROUTER), y)
		CONFIG_WLAN_FEATURE_LPSS := y
	endif
	endif
endif

CONFIG_FEATURE_EPPING := y

#Flag to enable offload packets feature
CONFIG_WLAN_OFFLOAD_PACKETS := y

#enable TSF get feature
CONFIG_WLAN_SYNC_TSF := y

#Flag to enable SAE
CONFIG_WLAN_FEATURE_SAE := y

#Flag to enable DISA
CONFIG_WLAN_FEATURE_DISA := y

#Flag to enable FIPS
CONFIG_WLAN_FEATURE_FIPS := y

# Flag to enable NAPI
CONFIG_WLAN_NAPI := y
CONFIG_WLAN_NAPI_DEBUG := n

CONFIG_POWER_MANAGEMENT_OFFLOAD := y

# Flag to enable LFR Subnet Detection
CONFIG_LFR_SUBNET_DETECTION := y

# Flag to enable MCC to SCC switch feature
CONFIG_MCC_TO_SCC_SWITCH := y

ifeq ($(CONFIG_SLUB_DEBUG_ON), y)
	# Enable Obj Mgr Degug services if slub build
	CONFIG_WLAN_OBJMGR_DEBUG:= y
	CONFIG_LOCK_STATS_ON:= y
	CONFIG_WLAN_OBJMGR_REF_ID_TRACE := y
endif


ifeq ($(CONFIG_ROME_IF),pci)
ifneq ($(CONFIG_WLAN_TX_FLOW_CONTROL_V2), y)
ifneq (y,$(filter y,$(CONFIG_LITHIUM) $(CONFIG_BERYLLIUM)))
CONFIG_WLAN_TX_FLOW_CONTROL_LEGACY := y
endif
endif
endif

#Whether have QMI support
CONFIG_QMI_SUPPORT := y

# As per target team, build is done as follows:
# Defconfig : build with default flags
# Slub      : defconfig  + CONFIG_SLUB_DEBUG=y +
#	      CONFIG_SLUB_DEBUG_ON=y + CONFIG_PAGE_POISONING=y
# Perf      : Using appropriate msmXXXX-perf_defconfig
#
# Shipment builds (user variants) should not have any debug feature
# enabled. This is identified using 'TARGET_BUILD_VARIANT'. Slub builds
# are identified using the CONFIG_SLUB_DEBUG_ON configuration. Since
# there is no other way to identify defconfig builds, QCOMs internal
# representation of perf builds (identified using the string 'perf'),
# is used to identify if the build is a slub or defconfig one. This
# way no critical debug feature will be enabled for perf and shipment
# builds. Other OEMs are also protected using the TARGET_BUILD_VARIANT
# config.
ifneq ($(TARGET_BUILD_VARIANT),user)
	CONFIG_FEATURE_PKTLOG := y
	CONFIG_WLAN_DEBUG_CRASH_INJECT := y
endif

#Enable WLAN/Power debugfs feature only if debug_fs is enabled
ifeq ($(CONFIG_DEBUG_FS), y)
       # Flag to enable debugfs. Depends on CONFIG_DEBUG_FS in kernel
       # configuration.
       CONFIG_WLAN_DEBUGFS := y

       # Flag to enable streamfs. Depends on CONFIG_DEBUG_FS and
       # CONFIG_RELAY in kernel configuration.
ifeq ($(CONFIG_RELAY), y)
       CONFIG_WLAN_STREAMFS := y
endif
endif

ifeq ($(CONFIG_WLAN_DEBUGFS), y)
       CONFIG_WLAN_MWS_INFO_DEBUGFS := y
       CONFIG_WLAN_FEATURE_MIB_STATS := y
endif

# Feature flags which are not (currently) configurable via Kconfig

#Whether to build debug version
BUILD_DEBUG_VERSION := y

#Enable this flag to build driver in diag version
BUILD_DIAG_VERSION := y

ifeq ($(CONFIG_SLUB_DEBUG), y)
	PANIC_ON_BUG := y
	WLAN_WARN_ON_ASSERT := y
else ifeq ($(CONFIG_PERF_DEBUG), y)
	PANIC_ON_BUG := y
	WLAN_WARN_ON_ASSERT := y
else
	PANIC_ON_BUG := n
	WLAN_WARN_ON_ASSERT := n
endif

# Compile all log levels by default
CONFIG_WLAN_LOG_FATAL := y
CONFIG_WLAN_LOG_ERROR := y
CONFIG_WLAN_LOG_WARN := y
CONFIG_WLAN_LOG_INFO := y
CONFIG_WLAN_LOG_DEBUG := y
CONFIG_WLAN_LOG_ENTER := y
CONFIG_WLAN_LOG_EXIT := y

#Enable OL debug and wmi unified functions
CONFIG_ATH_PERF_PWR_OFFLOAD := y

#Enable 11AC TX
ifeq ($(CONFIG_ROME_IF),pci)
	CONFIG_ATH_11AC_TXCOMPACT := y
endif

#Enable PCI specific APIS (dma, etc)
ifeq ($(CONFIG_ROME_IF),pci)
	CONFIG_HIF_PCI := y
endif

# enable/disable feature flags based upon mobile router profile
ifeq ($(CONFIG_MOBILE_ROUTER), y)
CONFIG_FEATURE_WLAN_MCC_TO_SCC_SWITCH := y
CONFIG_FEATURE_WLAN_AUTO_SHUTDOWN := y
CONFIG_FEATURE_WLAN_AP_AP_ACS_OPTIMIZE := y
CONFIG_FEATURE_WLAN_STA_4ADDR_SCHEME := y
CONFIG_MDM_PLATFORM := y
CONFIG_FEATURE_HAL_DELAYED_REG_WRITE := n
ifneq ($(CONFIG_ARCH_SDXPRAIRIE), y)
ifneq ($(CONFIG_ARCH_SA515), y)
ifneq ($(CONFIG_ARCH_SDXLEMUR), y)
CONFIG_FEATURE_WLAN_STA_AP_MODE_DFS_DISABLE := y
endif
endif
endif
CONFIG_FEATURE_AP_MCC_CH_AVOIDANCE := y
CONFIG_FEATURE_STA_MODE_VOTE_LINK := y
else
CONFIG_QCOM_ESE := y
CONFIG_WLAN_OPEN_P2P_INTERFACE := y
CONFIG_WLAN_ENABLE_SOCIAL_CHANNELS_5G_ONLY := y
endif

#Enable power management suspend/resume functionality to PCI
CONFIG_ATH_BUS_PM := y

#Enable FLOWMAC module support
CONFIG_ATH_SUPPORT_FLOWMAC_MODULE := n

#Enable spectral support
CONFIG_ATH_SUPPORT_SPECTRAL := n

#Enable WDI Event support
CONFIG_WDI_EVENT_ENABLE := y
ifeq ($(CONFIG_REMOVE_PKT_LOG), y)
ifeq ($(CONFIG_WLAN_ENH_CFR_ENABLE), n)
CONFIG_WDI_EVENT_ENABLE := n
endif
endif

#Enable the type_specific_data in the ath_pktlog_arg
ifeq ($(CONFIG_REMOVE_PKT_LOG), n)
ifeq ($(CONFIG_BERYLLIUM), y)
CONFIG_PKTLOG_HAS_SPECIFIC_DATA := y
endif
endif

#Endianness selection
CONFIG_LITTLE_ENDIAN := y

#Enable TX reclaim support
CONFIG_TX_CREDIT_RECLAIM_SUPPORT := n

#Enable FTM support
CONFIG_QCA_WIFI_FTM := y

ifeq ($(CONFIG_QCA_WIFI_FTM), y)

ifeq ($(CONFIG_NL80211_TESTMODE), y)
	QCA_WIFI_FTM_NL80211 :=y
else
	QCA_WIFI_FTM_NL80211 :=n
endif
	CONFIG_LINUX_QCMBR :=y

else
	QCA_WIFI_FTM_NL80211 :=n
	CONFIG_LINUX_QCMBR :=n
endif


#Enable Checksum Offload
CONFIG_CHECKSUM_OFFLOAD := y

#Enable GTK offload
CONFIG_GTK_OFFLOAD := y

#Set this to 1 to catch erroneous Target accesses during debug.
CONFIG_ATH_PCIE_ACCESS_DEBUG := n

#Enable IPA offload for MDM platforms
ifeq ($(CONFIG_MDM_PLATFORM), y)
ifeq ($(CONFIG_IPA), y)
CONFIG_IPA_OFFLOAD := y
endif
ifeq ($(CONFIG_IPA3), y)
CONFIG_IPA_OFFLOAD := y
endif
ifeq ($(CONFIG_IPA3), m)
CONFIG_IPA_OFFLOAD := y
endif
else
CONFIG_IPA_OFFLOAD := n
endif

#Enable Signed firmware support for split binary format
CONFIG_QCA_SIGNED_SPLIT_BINARY_SUPPORT := n

#Enable single firmware binary format
CONFIG_QCA_SINGLE_BINARY_SUPPORT := n

#Enable collecting target RAM dump after kernel panic
CONFIG_TARGET_RAMDUMP_AFTER_KERNEL_PANIC := y

#Flag to enable/disable secure firmware feature
CONFIG_FEATURE_SECURE_FIRMWARE := n

#Flag to enable Stats Ext implementation
CONFIG_FEATURE_STATS_EXT := y

#Flag to allocate memory dynamically for different buffers
CONFIG_WLAN_LOGGING_BUFFERS_DYNAMICALLY := n
CONFIG_WLAN_DFS_STATIC_MEM_ALLOC := y

#Flag to enable HTC credit history feature
CONFIG_FEATURE_HTC_CREDIT_HISTORY := y

#Flag to enable MTRACE feature
CONFIG_TRACE_RECORD_FEATURE := y

#Flag to enable p2p debug feature
CONFIG_WLAN_FEATURE_P2P_DEBUG := y

#Flag to enable roam debug log
CONFIG_FEATURE_ROAM_DEBUG := y

#Flag to enable DFS Master feature
CONFIG_WLAN_DFS_MASTER_ENABLE := y

#Flag to enable WEXT support for STA/AP/P2P interfaces
ifeq ($(CONFIG_WIRELESS_EXT), y)
CONFIG_WLAN_WEXT_SUPPORT_ENABLE := y
endif

#Flag to enable/disable MTRACE feature
CONFIG_ENABLE_MTRACE_LOG := y

#Flag to enable nud tracking feature
CONFIG_WLAN_NUD_TRACKING := y

#Flag to enable/Disable Function call trace
CONFIG_FUNC_CALL_MAP := n

#Flag to enable wbuff feature
CONFIG_WLAN_WBUFF := y

#Flag to enable set and get disable channel list feature
CONFIG_DISABLE_CHANNEL_LIST :=y

#Flag to enable beacon receive feature
CONFIG_WLAN_BCN_RECV_FEATURE := y

#Flag to enable LTE COEX feature
CONFIG_LTE_COEX := y

#Flag to enable/disable TARGET 11d scan
CONFIG_TARGET_11D_SCAN := y

#Flag to enable/disable Avoid acs freq feature
CONFIG_SAP_AVOID_ACS_FREQ_LIST := y

#Flag to enable HOST OPCLASS feature
CONFIG_HOST_OPCLASS := y

#Flag to enable Dynamic Voltage WDCVS (Config Voltage Mode)
CONFIG_WLAN_DYNAMIC_CVM := y

#Flag to enable SAR Safety Feature
CONFIG_SAR_SAFETY_FEATURE := y

CONFIG_CONNECTION_ROAMING_CFG := n

CONFIG_FEATURE_SET := y

CONFIG_WIFI_POS_CONVERGED := y
CONFIG_WLAN_TWT_CONVERGED := y
ifneq ($(CONFIG_WIFI_POS_CONVERGED), y)
CONFIG_WIFI_POS_LEGACY := y
endif

CONFIG_CP_STATS := y
CONFIG_FEATURE_INTEROP_ISSUES_AP := y

CONFIG_FEATURE_WLAN_WAPI := y

CONFIG_AGEIE_ON_SCAN_RESULTS := y

#Flag to enable FW log parsing support feature
CONFIG_FEATURE_FW_LOG_PARSING := y

CONFIG_PTT_SOCK_SVC_ENABLE := y
CONFIG_SOFTAP_CHANNEL_RANGE := y
CONFIG_FEATURE_WLAN_SCAN_PNO := y
CONFIG_WLAN_FEATURE_PACKET_FILTERING := y
CONFIG_WLAN_NS_OFFLOAD := y
CONFIG_FEATURE_WLAN_RA_FILTERING:= y
CONFIG_FEATURE_WLAN_LPHB := y
CONFIG_QCA_SUPPORT_TX_THROTTLE := y
CONFIG_WMI_INTERFACE_EVENT_LOGGING := y
CONFIG_WLAN_FEATURE_LINK_LAYER_STATS := y
CONFIG_FEATURE_CLUB_LL_STATS_AND_GET_STATION := y
CONFIG_FEATURE_WLAN_EXTSCAN := n
CONFIG_WMI_BCN_OFFLOAD := y
CONFIG_160MHZ_SUPPORT := y
CONFIG_REG_CLIENT := y
CONFIG_WLAN_PMO_ENABLE := y
CONFIG_CONVERGED_P2P_ENABLE := y
CONFIG_WLAN_POLICY_MGR_ENABLE := y
CONFIG_FEATURE_DENYLIST_MGR := y
CONFIG_FOURTH_CONNECTION := y
CONFIG_SUPPORT_11AX := y
CONFIG_HDD_INIT_WITH_RTNL_LOCK := y
CONFIG_WLAN_CONV_SPECTRAL_ENABLE := y
CONFIG_WLAN_SPECTRAL_ENABLE := y
CONFIG_WMI_CMD_STRINGS := y

CONFIG_FEATURE_MONITOR_MODE_SUPPORT := y
CONFIG_WLAN_ALLOCATE_GLOBAL_BUFFERS_DYNAMICALLY := n
CONFIG_WLAN_FEATURE_TWT := y
CONFIG_FW_THERMAL_THROTTLE := y
CONFIG_WLAN_FEATURE_BIG_DATA_STATS := y
CONFIG_WLAN_FEATURE_IGMP_OFFLOAD := y
CONFIG_WLAN_FEATURE_GET_USABLE_CHAN_LIST := y
CONFIG_FEATURE_RADAR_HISTORY := y

#Flags to enable/disable vendor commands
CONFIG_FEATURE_RSSI_MONITOR := y
CONFIG_FEATURE_BSS_TRANSITION := y
CONFIG_FEATURE_STATION_INFO := y
CONFIG_FEATURE_TX_POWER := y
CONFIG_FEATURE_OTA_TEST := y
CONFIG_FEATURE_ACTIVE_TOS := y
CONFIG_FEATURE_SAR_LIMITS := y
CONFIG_FEATURE_CONCURRENCY_MATRIX := y
CONFIG_FEATURE_SAP_COND_CHAN_SWITCH := y
CONFIG_FEATURE_P2P_LISTEN_OFFLOAD := y
CONFIG_QCACLD_FEATURE_MPTA_HELPER := n
CONFIG_QCACLD_RX_DESC_MULTI_PAGE_ALLOC := y

#Flags to enable/disable WMI APIs
CONFIG_WMI_ROAM_SUPPORT := y
CONFIG_WMI_CONCURRENCY_SUPPORT := y
CONFIG_WMI_STA_SUPPORT := y

CONFIG_DP_TRACE := y

ifeq ($(CONFIG_CNSS_EMULATION), y)
#on emulation platform, increase host timeouts by 1000 times
CONFIG_QDF_TIMER_MULTIPLIER_FRAC := 1000
endif

ifeq ($(CONFIG_SLUB_DEBUG_ON), y)
	CONFIG_DSC_DEBUG := y
	CONFIG_DESC_TIMESTAMP_DEBUG_INFO := y
	CONFIG_FEATURE_UNIT_TEST_SUSPEND := y
	CONFIG_LEAK_DETECTION := y
ifndef CONFIG_MAX_LOGS_PER_SEC
	CONFIG_MAX_LOGS_PER_SEC := 500
endif
	CONFIG_SCHED_HISTORY_SIZE := 256
	CONFIG_TALLOC_DEBUG := y
	CONFIG_UNIT_TEST := y
	CONFIG_REGISTER_OP_DEBUG := y
	CONFIG_ENABLE_QDF_PTR_HASH_DEBUG := y
	CONFIG_HAL_DEBUG := y
	CONFIG_FEATURE_HAL_RECORD_SUSPEND_WRITE := y

ifneq ($(CONFIG_HELIUMPLUS), y)
ifneq ($(CONFIG_CNSS_EMULATION), y)
	CONFIG_HIF_DETECTION_LATENCY_ENABLE := y
endif
endif
endif

ifeq ($(CONFIG_CNSS2_DEBUG), y)
	CONFIG_DSC_DEBUG := y
	CONFIG_DESC_TIMESTAMP_DEBUG_INFO := y
	CONFIG_FEATURE_UNIT_TEST_SUSPEND := y
	CONFIG_LEAK_DETECTION := y
	CONFIG_MAX_LOGS_PER_SEC := 500
	CONFIG_SCHED_HISTORY_SIZE := 256
	CONFIG_TALLOC_DEBUG := y
	CONFIG_UNIT_TEST := y
	CONFIG_REGISTER_OP_DEBUG := y
	CONFIG_ENABLE_QDF_PTR_HASH_DEBUG := y
	CONFIG_HAL_DEBUG := y
	CONFIG_ATH_DIAG_EXT_DIRECT := y
	CONFIG_WLAN_OBJMGR_DEBUG:= y
	CONFIG_WLAN_OBJMGR_REF_ID_TRACE := y
endif

	CONFIG_HIF_DEBUG := y

ifeq ($(CONFIG_UNIT_TEST), y)
	CONFIG_DSC_TEST := y
	CONFIG_QDF_TEST := y
	CONFIG_FEATURE_WLM_STATS := y
endif

ifeq (y,$(filter y,$(CONFIG_CNSS2_DEBUG) $(CONFIG_SLUB_DEBUG_ON)))
	CONFIG_RX_DESC_DEBUG_CHECK:= y
	CONFIG_ALLOW_PKT_DROPPING := y
	CONFIG_WLAN_FEATURE_DP_MON_STATUS_RING_HISTORY := y
	CONFIG_DP_TX_COMP_RING_DESC_SANITY_CHECK := y
	CONFIG_HIF_CE_DEBUG_DATA_BUF := y
	CONFIG_WLAN_RECORD_RX_PADDR := y
	CONFIG_HIF_CPU_PERF_AFFINE_MASK := y
	CONFIG_WLAN_FEATURE_DP_RX_RING_HISTORY := y
	CONFIG_WLAN_FEATURE_DP_TX_DESC_HISTORY := y
	CONFIG_REO_QDESC_HISTORY := y
	CONFIG_DP_TX_HW_DESC_HISTORY := y
	CONFIG_QDF_NBUF_HISTORY_SIZE := 8192
	CONFIG_DP_RX_REFILL_CPU_PERF_AFFINE_MASK := y
	CONFIG_FEATURE_HIF_LATENCY_PROFILE_ENABLE := y
endif

ifneq ($(CONFIG_HIF_USB), y)
CONFIG_WLAN_LOGGING_SOCK_SVC := y
endif

CONFIG_CONNECTIVITY_PKTLOG := y
CONFIG_PKTLOG_HAS_SPECIFIC_DATA := y

ifneq ($(TARGET_BUILD_VARIANT),user)
CONFIG_DESC_DUP_DETECT_DEBUG := y
endif

ifeq (y,$(findstring y,$(CONFIG_CNSS) $(CONFIG_CNSS_MODULE)))
ifeq ($(CONFIG_CNSS_SDIO), y)
CONFIG_PLD_SDIO_CNSS_FLAG := y
endif
ifeq ($(CONFIG_HIF_PCI), y)
CONFIG_PLD_PCIE_CNSS_FLAG := y
CONFIG_FEATURE_BUS_BANDWIDTH_MGR := y
endif
endif

ifeq (y,$(findstring y,$(CONFIG_CNSS2) $(CONFIG_CNSS2_MODULE)))
ifeq ($(CONFIG_HIF_PCI), y)
CONFIG_FEATURE_BUS_BANDWIDTH_MGR := y
CONFIG_PLD_PCIE_CNSS_FLAG := y
CONFIG_PLD_PCIE_INIT_FLAG := y
endif
endif

#Enable STATE MACHINE HISTORY
CONFIG_SM_ENG_HIST := n

#Enable OEM DATA feature
CONFIG_FEATURE_OEM_DATA := y

#Enable FW Offload
CONFIG_WLAN_FW_OFFLOAD := y

#Enable eLNA bypass feature
ifeq ($(CONFIG_WLAN_FW_OFFLOAD), y)
CONFIG_WLAN_FEATURE_ELNA := y
endif

#Enable mDNS and ICMP offload feature
ifeq ($(CONFIG_WLAN_FW_OFFLOAD), y)
CONFIG_WLAN_FEATURE_MDNS_OFFLOAD := y
CONFIG_WLAN_FEATURE_ICMP_OFFLOAD := y
endif


CONFIG_HANDLE_BC_EAP_TX_FRM := y

ifeq ($(CONFIG_BAND_6GHZ), y)

CONFIG_6G_SCAN_CHAN_SORT_ALGO := y

endif

CONFIG_SAP_DHCP_FW_IND := y

#Enable support to get ANI level
CONFIG_ANI_LEVEL_REQUEST := y

#Enable RX RING buffers debug
CONFIG_DEBUG_RX_RING_BUFFER := y

#Enable Hash debug
CONFIG_RX_HASH_DEBUG := y

#Enable VDEV OPS wakelock feature
CONFIG_FEATURE_VDEV_OPS_WAKELOCK := y

#Enable Hang Event
CONFIG_WLAN_HANG_EVENT := y

ifeq ($(CONFIG_FW_THERMAL_THROTTLE), y)
CONFIG_WLAN_THERMAL_MULTI_CLIENT_SUPPORT := y
endif

CONFIG_WLAN_DEBUG_LINK_VOTE := y

CONFIG_QCACLD_WLAN_CONNECTIVITY_DIAG_EVENT := y

CONFIG_WLAN_FEATURE_CAL_FAILURE_TRIGGER := y

ifeq ($(CONFIG_QCACLD_FEATURE_SON), y)
CONFIG_WDI_EVENT_ENABLE := y
CONFIG_FEATURE_MONITOR_MODE_SUPPORT := y
CONFIG_WIFI_MONITOR_SUPPORT := y
CONFIG_DCS := y
CONFIG_FEATURE_WDS := y
#Disable the Export Symbol config
CONFIG_WLAN_DISABLE_EXPORT_SYMBOL := n
else
CONFIG_WLAN_DISABLE_EXPORT_SYMBOL := y
endif

ifeq ($(CONFIG_FEATURE_WDS), y)
CONFIG_FEATURE_MEC := y
CONFIG_FEATURE_WLAN_STA_4ADDR_SCHEME := y
CONFIG_FEATURE_MCL_REPEATER := y
CONFIG_BYPASS_WDS_OL_OPS := y
CONFIG_WDS_CONV_TARGET_IF_OPS_ENABLE := y
endif

CONFIG_WLAN_FEATURE_SAP_ACS_OPTIMIZE := y
```
