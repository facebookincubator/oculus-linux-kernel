## drivers/net/wireless/broadcom/brcm4389/Kconfig
```kconfig
#
# $ Copyright Open Broadcom $
#
#
# <<Broadcom-WL-IPTag/Open:>>
#
config BROADCOM_WIFI
	bool "Broadcom WiFi Driver"
	depends on WLAN
	default n
	---help---
	  This is a configuration for Broadcom WLAN driver.

config BCM4330
	tristate "Broadcom 4330 wireless cards support"
	depends on BROADCOM_WIFI
	---help---
	  This module adds support for wireless adapters based on
	  Broadcom 4330 chipset.

config BCM4343
	tristate "Broadcom 4343 wireless cards support"
	depends on BROADCOM_WIFI
	---help---
	  This module adds support for wireless adapters based on
	  Broadcom 4343 chipset.

config BCM4334
	tristate "Broadcom 4334 wireless cards support"
	depends on BROADCOM_WIFI
	---help---
	  This module adds support for wireless adapters based on
	  Broadcom 4334 chipset.

config BCM4335
	tristate "Broadcom 4335 wireless cards support"
	depends on BROADCOM_WIFI
	---help---
	  This module adds support for wireless adapters based on
	  Broadcom 4335 chipset.

config BCM4339
	tristate "Broadcom 4339 wireless cards support"
	depends on BROADCOM_WIFI
	---help---
	  This module adds support for wireless adapters based on
	  Broadcom 4339 chipset.

config BCM4354
	tristate "Broadcom 4354 wireless cards support"
	depends on BROADCOM_WIFI
	---help---
	  This module adds support for wireless adapters based on
	  Broadcom 4354 chipset.

config BCM4358
	tristate "Broadcom 4358 wireless cards support"
	depends on BROADCOM_WIFI
	---help---
	  This module adds support for wireless adapters based on
	  Broadcom 4358 chipset.

config BCM4359
	tristate "Broadcom 4359 wireless cards support"
	depends on BROADCOM_WIFI
	---help---
	  This module adds support for wireless adapters based on
	  Broadcom 4359 chipset.

config BCM4361
	tristate "Broadcom 4361 wireless cards support"
	depends on BROADCOM_WIFI
	---help---
	  This module adds support for wireless adapters based on
	  Broadcom 4361 chipset.

config BCM4375
	tristate "Broadcom 4375 wireless cards support"
	depends on BROADCOM_WIFI
	---help---
	  This module adds support for wireless adapters based on
	  Broadcom 4375 chipset.

config BCM4389
	tristate "Broadcom 4389 wireless cards support"
	depends on BROADCOM_WIFI
	---help---
	  This module adds support for wireless adapters based on
	  Broadcom 4389 chipset.

config BCM43241
	tristate "Broadcom 43241 wireless cards support"
	depends on BROADCOM_WIFI
	---help---
	  This module adds support for wireless adapters based on
	  Broadcom 43241 chipset.

config BCM4334W
	tristate "Broadcom 4334W wireless cards support"
	depends on BROADCOM_WIFI
	---help---
	  This module adds support for wireless adapters based on
	  Broadcom 4334W chipset.

config BCM43455
        tristate "Broadcom 43455 wireless cards support"
        depends on BROADCOM_WIFI
        ---help---
          This module adds support for wireless adapters based on
          Broadcom 43455 chipset.

config BCMDHD_FW_PATH
	depends on BROADCOM_WIFI
	string "Firmware path"
	default "/system/etc/firmware/fw_bcmdhd.bin"
	---help---
	  Path to the firmware file.

config BCMDHD_NVRAM_PATH
	depends on BROADCOM_WIFI
	string "NVRAM path"
	default "/system/etc/wifi/bcmdhd.cal"
	---help---
	  Path to the calibration file.

config BROADCOM_WIFI_RESERVED_MEM
	bool "BROADCOM Reserved memory for wifi device"
	depends on BROADCOM_WIFI
	---help---
	  This is a configuration for Broadcom WLAN driver.

config WIFI_BROADCOM_COB
        bool "BROADCOM WIFI COB"
        depends on (BCM43455 || BCM4343)
        ---help---
          This is a configuration for Broadcom WIFI COB Type.

config WL_NAN
	bool "NAN Feature"
	depends on BROADCOM_WIFI
	default n
	---help---
	  This is a configuration for NAN Feature.

config BCMDHD_PCIE
	bool "Enable PCIe I/F Support"
	depends on (BCM4354 || BCM4358 || BCM4359 || BCM4361 || BCM4375 || BCM4389)
	---help---
	  Enable PCI Express I/F Support

config BCMDHD_PREALLOC_PKTIDMAP
	bool "BROADCOM PCIE specific memory reserved for PKTIDMAP"
	depends on BROADCOM_WIFI_RESERVED_MEM && BCMDHD_PCIE
	---help---
	  Preallocated memory support for PCIE interface in Broadcom
	  WLAN driver.

config BCMDHD_PREALLOC_MEMDUMP
	bool "BROADCOM PCIE specific memory reserved for MEMDUMP"
	depends on BROADCOM_WIFI_RESERVED_MEM
	---help---
	  Preallocated memory support for dongle memory dump
config BCMDHD_OOB_HOST_WAKE
	bool "Use the external WLAN_HOST_WAKE pin"
	depends on BROADCOM_WIFI
	default y
	---help---
	  Use the external GPIO pin to wake up host
```

## drivers/net/wireless/broadcom/brcm4389ar/Kconfig
```kconfig
#
# Copyright (C) 2022, Broadcom.
#
#      Unless you and Broadcom execute a separate written software license
# agreement governing use of this software, this software is licensed to you
# under the terms of the GNU General Public License version 2 (the "GPL"),
# available at http://www.broadcom.com/licenses/GPLv2.php, with the
# following added to such license:
#
#      As a special exception, the copyright holders of this software give you
# permission to link this software with independent modules, and to copy and
# distribute the resulting executable under terms of your choice, provided that
# you also meet, for each linked independent module, the terms and conditions of
# the license of that module.  An independent module is a module which is not
# derived from this software.  The special exception does not apply to any
# modifications of the software.
#
#
# <<Broadcom-WL-IPTag/Open:>>
#

config BCMDHD
	tristate "Broadcom FullMAC wireless cards support"
	help
	  This module adds support for wireless adapters based on
	  Broadcom FullMAC chipset.

	  If you choose to build a module, it'll be called dhd. Say M if
	  unsure.

config BCMDHD_SDIO
	bool "SDIO bus interface support"
	depends on BCMDHD && MMC

config BCMDHD_PCIE
	bool "PCIe bus interface support"
	depends on BCMDHD && PCI && !BCMDHD_SDIO

config BCM4375
	bool "BCM4375 support"
	depends on BCMDHD
	default n

config BCM4389
    bool "BCM4389 support"
    depends on BCMDHD
    default n

config BCM4389_AR
    bool "BCM4389 support"
    depends on BCMDHD
    default n

config DHD_OF_SUPPORT
	bool "Use in-drive platform device"
	depends on BCMDHD
	default n

config BCMDHD_FW_PATH
	depends on BCMDHD
	string "Firmware path"
	default "/vendor/etc/wifi/fw_bcmdhd.bin"
	help
	  Path to the firmware file.

config BCMDHD_NVRAM_PATH
	depends on BCMDHD
	string "NVRAM path"
	default "/vendor/etc/wifi/bcmdhd.cal"
	help
	  Path to the calibration file.

config BCMDHD_CLM_PATH
	depends on BCMDHD
	string "CLM path"
	default "/vendor/etc/wifi/bcmdhd_clm.blob"
	help
	  Path to the clm file.

config BCMDHD_MAP_PATH
	depends on BCMDHD
	string "MAP path"
	default "/vendor/etc/wifi/fw_bcmdhd.map"
	help
	  Path to the map file.

config BROADCOM_WIFI_RESERVED_MEM
	bool "BROADCOM Reserved memory for wifi device"
	depends on BCMDHD
	help
	  This is a configuration for Broadcom WLAN driver.

config BCMDHD_WEXT
	bool "Enable WEXT support"
	depends on BCMDHD && CFG80211 = n
	select WIRELESS_EXT
	select WEXT_PRIV
	help
	  Enables WEXT support

config DHD_USE_STATIC_BUF
	bool "Enable memory preallocation"
	depends on BCMDHD
	default n
	help
	  Use memory preallocated in platform

config DHD_USE_SCHED_SCAN
	bool "Use CFG80211 sched scan"
	depends on BCMDHD && CFG80211
	default n
	help
	  Use CFG80211 sched scan

config DHD_SET_RANDOM_MAC_VAL
	hex "Vendor OUI"
	depends on BCMDHD
	default 0x001A11
	help
	  Set vendor OUI for SoftAP

config WLAN_REGION_CODE
	int "---Region codes for Broadcom WiFi Driver"
	depends on BCMDHD
	default 100
	help
		This is a region code for Broadcom Wi-Fi featured functions.
		- 100 : EUR OPEN
		- 101 : EUR ORG
		- 200 : KOR OPEN
		- 201 : KOR SKT
		- 202 : KOR KTT
		- 203 : KOR LGT
		- 300 : CHN OPEN

config WL_NAN
	bool "NAN Feature"
	depends on BCMDHD
	default n
	help
	  This is a configuration for NAN Feature.

config BCMDHD_PREALLOC_PKTIDMAP
	bool "BROADCOM PCIE specific memory reserved for PKTIDMAP"
	depends on BROADCOM_WIFI_RESERVED_MEM && BCMDHD_PCIE
	help
	  Preallocated memory support for PCIE interface in Broadcom
	  WLAN driver.

config BCMDHD_PREALLOC_MEMDUMP
	bool "BROADCOM PCIE specific memory reserved for MEMDUMP"
	depends on BROADCOM_WIFI_RESERVED_MEM
	help
	  Preallocated memory support for dongle memory dump

config BCMDHD_OOB_HOST_WAKE
        bool "Use the external WLAN_HOST_WAKE pin"
        depends on BCMDHD
        help
          Use the external GPIO pin to wake up host

config BCMDHD_GET_OOB_STATE
        bool "Support WLAN_HOST_WAKE pin level information"
        depends on BCMDHD_OOB_HOST_WAKE
        default y
        help
          Support WLAN_HOST_WAKE pin level information

config BCMDHD_SIMULATE_DEGRADED_PERFORMANCE
	bool "Enable simulating degraded Wifi performance"
	depends on BCMDHD
	default n
	help
	  Use to enable injecting delay in transfering packets from host to WiFi chip

config 6GHZ_BKPORT
	bool "Enable 6Ghz band support for backported kernels."
	depends on BCMDHD
	default n
	---help---
	  For Backported kernels, use the config to enable 6GHz band support.

config XRPS
	bool "Enable XR Power Save"
	default n
	help
		Enable XR Power Save

config XRPS_PROFILING
	bool "XRPS profiling"
	depends on XRPS
	default n
	help
		Debug print significant events with their timestamps

config XRPS_DHD_HOOKS
	bool "Enable XR Power Save DHD hooks"
	depends on XRPS && BCMDHD
	default n
	help
		Enable XR Power Save DHD hooks

config DHD_LB_USE_PRIMARY_CPU
	bool "Use primary cpus for better performance."
	depends on BCMDHD
	default n
	---help---
	  Use primary cpus for better performance.

config DHD_USE_SC_SCAN
	bool "Use Scan Core only for NL80211 scan API"
	depends on BCMDHD
	default n
	---help---
	  Use Scan Core only for NL80211 scan API (Android use it for all
	  impicit scans). It can scan only 2.4 and 5GHz bands, no 6GHz channels
	  will be returned in scan results
```

## drivers/platform/oculus/Kconfig
```kconfig
menu "Oculus platform device drivers"

config OCULUS
	bool "Support for Oculus hardware"
	default y
	help
	  Enable support for Oculus systems and boards.

config VS1_BOARD
	bool "VS1 (Monterey) Platform"
	depends on OCULUS
	depends on ARCH_MSM8998
	select SND_SOC_CM710X
	select SND_SOC_CM710X_SPI
	help
	  Enabling this option adds support for the Oculus Monterey platform
	  and enables the required drivers.

endmenu
```
