## drivers/staging/oculus/Documentation/devicetree/bindings/oculus,virtual-sensor.txt
```
============================
Oculus Virtual Sensor Driver
============================

This driver implements a virtual temperature sensor. It estimates the temperature of
a region of a device without a physical thermistor via a linear combination of present
physical thermistors.

The driver registers with the thermal framework as a thermal sensor and can
be configured as the sensor associated with a thermal zone defined in the device
tree.

The driver can support alternate calculations based on whether the device is charging
or not via the defining of separate sets of values for each case.

It has an optional fault detection feature that can detect a faulty component thermistor and
replace the reading with an estimate generated using a highly correlated thermistor. The estimate
is created by a coefficient-intercept calculation similar to how the main calculation is performed.

Virtual Sensor Calculation
--------------------------

The virtual sensor temperature at time t is a linear combination of
the intercept constant, sensor temperatures at time t, and the
slope of sensor temperatures. Where the slope is defined as
sensor(t) - sensor(t-1)

VirtualSensor(t) = intercept + sensor1_coefficient*sensor1(t) + ...
  + sensorN_coefficient*(t) +
  sensor1_slopeCoefficient*( sensor1(t) - sensor1(t-1) ) + ...
  + sensorN_slopeCoefficient*( sensorN(t) - sensorN(t-1) )

Virtual Sensor Node
-------------------

Required properties:
- compatible : Should be "oculus,virtual-sensor".
- #thermal-sensor-cells : Required by thermal framework, should be 0.

- thermal-zones : String list of the names of component thermal zones.

- coefficients : Child node with holding the "charging" and "discharging" blocks.
  - charging : Child node representing the values to be used when the device is charging.
        - tz-coefficients : List of numerical values to multiply the thermal zone readings by.
                Must align with `thermal-zones`.
        - (optional) tz-slope-coefficients : List of numerical values to multiply the
                previously gathered thermal zone readings by. Must align with `thermal-zones`.
                Default 0 if not defined.
        - intercept : Value to add to the final calculation.
  - discharging : Child node representing the values to be used when the device is discharging.
        - tz-coefficients : List of numerical values to multiply the thermal zone readings by.
                Must align with `thermal-zones`.
        - (optional) tz-slope-coefficients : List of numerical values to multiply the
                previously gathered thermal zone readings by. Must align with `thermal-zones`.
                Default 0 if not defined.
        - intercept : Value to add to the final calculation.

Optional properties:
- thermal-zone-scaling-factors : List of values to multiply the readings returned from component
        thermal zones by before use, in order to assure unit coherence. Default 1 if not defined.

- fallback-thermal-zone : A thermal zone to use in lieu of the virtual sensor calculation in case
        the calculation varies too widely from this zone. Not used if undefined.
- fallback-thermal-zone-scaling-factor : Value to multiply the reading returned by
        `fallback-thermal-zone` in order to assure unit coherence. Default 1 if not defined.
        Requires definition of `fallback-thermal-zone`.
- fallback-tolerance : Gap between the calculation and reading returned by `fallback-thermal-zone`
        considered acceptable. Gaps exceeding this value in either direction will return the
        reading from `fallback-thermal-zone` rather than the calculated value. Requires definition
        of `fallback-thermal-zone`.

- thermal-zone-fault-estimator-bounds : Length-2 list of values representing the range in which
        a component thermistor should be considered functional. If a component thermal zone returns
        a reading outside this range, it will be replaced with an estimate as configured by
        `thermal-zone-fault-estimator-zones` and `thermal-zone-fault-estimator-values`. Definition
        enables fault detection feature and requires definition of the aforementioned properties.
- thermal-zone-fault-estimator-zones : String list of the names of thermal zones to be used as
        estimators in the case where the associated thermal zone is considered faulty. Estimator
        zones are considered associated with the zones they align with in the `thermal-zones`
        property. If the feature is enabled, but a component zone will not use an estimator, the
        list entry should be "NA". Requires definition of `thermal-zone-estimator-bounds` and
        `thermal-zone-fault-estimator-values`.
- thermal-zone-fault-estimator-values : List of length-2 lists of values representing
        coefficient-intercept pairs for each estimator zone. Must align with `thermal-zones` and
        `thermal-zone-fault-estimator-zones`. Requires definition of `thermal-zone-estimator-bounds`
        and `thermal-zone-fault-estimator-values`.

Example:

&thermal_zones {
        batt-virt-fan {
                polling-delay = <1000>;
                polling-delay-passive = <0>;
                thermal-sensors = <&battery_virtual_sensor>;
        };
};

battery_virtual_sensor: battery_virtual_sensor {
        compatible = "oculus,virtual-sensor";
        status = "ok";
        #thermal-sensor-cells = <0>;

        thermal-zones = "batt-usr", "pcb3-usr", "pcb2-usr", "pcb1-usr",
                        "rfpa-usr", "imu-usr";
        thermal-zone-scaling-factors = <100 1 1 1 1 1>;

        thermal-zone-fault-estimator-bounds = <(-40000) 125000>;
        thermal-zone-fault-estimator-zones =
                        "NA",
                        "rfpa-usr",
                        "imu-usr",
                        "imu-usr",
                        "pcb3-usr",
                        "pcb2-usr";
        thermal-zone-fault-estimator-values =
                        <0 0>,
                        <9712 721>,
                        <9926 313>,
                        <10186 (-477)>,
                        <10271 (-662)>,
                        <10005 (-102)>;

        fallback-thermal-zone = "batt-usr";
        fallback-thermal-zone-scaling-factor = <100>;
        fallback-tolerance = <8000>;

        coefficients {
                charging {
                        tz-coefficients = <10000 0 0 0 0 0>;
                        tz-slope-coefficients = <0 0 0 0 0 0>;
                        intercept = <0>;
                };
                discharging {
                        tz-coefficients = <10799 5790 (-2178) (-4030) (-6841) 6364>;
                        tz-slope-coefficients = <100 200 300 400 500 600>;
                        intercept = <4261>;
                };
        };
};
```

## drivers/staging/oculus/pdfu/Kconfig
```kconfig
config USB_PDFU
    tristate "USB Power Delivery Firmware Update"
    depends on META_USBVDM
    help
        The USB Power Delivery Firmware Update (PDFU) Specification defines a
        common method for updating the firmware in a USB Power Delivery capable
        device.

        Enable this configuration option if you have USB PD capabilities in
        your system and want to be able to update partner devices that can
        act as a PDFU Responder.
```

## drivers/staging/oculus/stp/Kconfig
```kconfig
config SPI_STP
	tristate "STP SPI driver"
	depends on SPI && OCULUS
	default n
	help
	  Enable STP SPI driver for data transfer between SoC (master) and slave.
```

## drivers/staging/oculus/usbvdm/Kconfig
```kconfig
menuconfig META_USBVDM
	tristate "Meta USB VDM abstraction library"
	help
	  This library handles communication between an upper-level application
	  drivers, such as one for an external battery, and each of the
	  lower-level USB PD engines that may be present on the system.

	  This presents a standard interface for an application driver to send
	  and receive VDMs with a device of a particular VID/PID pairing, without
	  concern for which particular underlying policy engine is in use.

if META_USBVDM

config META_USBVDM_CYPD
	tristate "Meta USB VDM CYPD driver"
	depends on CYPD_POLICY_ENGINE
	help
	  This driver provides an implementation of the engine for a USB VDM
	  communication channel for CYPD3177 and its underlying policy engine.

config META_USBVDM_GLINK
	tristate "Meta USB VDM QTI GLINK driver"
	depends on QTI_PMIC_GLINK
	help
	  This driver provides an implementation of the engine for a USB VDM
	  communication channel for the underlying QTI GLINK.

config META_USBVDM_QTIPD
	tristate "Meta USB VDM QTI USBPD driver"
	depends on USB_PD_POLICY
	help
	  This driver provides an implementation of the engine for a USB VDM
	  communication channel for the underlying QTI USB PD policy engine.

endif
```

## drivers/staging/qcacld-3.0/configs/kiwi_defconfig
```kconfig
CONFIG_CNSS_KIWI := y

include $(WLAN_ROOT)/configs/default_defconfig

#Enable 11BE EHT
CONFIG_WLAN_FEATURE_11BE := y

# Enable EHT rate sysfs entry
ifeq ($(CONFIG_WLAN_SYSFS), y)
CONFIG_WLAN_SYSFS_EHT_RATE := y
endif

# Max Sta Vdev Config
CONFIG_CFG_MAX_STA_VDEVS := 4

#Enable 11BE MLO
CONFIG_WLAN_FEATURE_11BE_MLO := y

#BMISS offload max vdev config
CONFIG_CFG_BMISS_OFFLOAD_MAX_VDEV := 4

#Chip version
CONFIG_CHIP_VERSION := 1

#DP configs
CONFIG_WLAN_DP_DISABLE_TCL_CMD_CRED_SRNG := y
CONFIG_WLAN_DP_DISABLE_TCL_STATUS_SRNG := y

ifeq ($(CONFIG_CNSS_KIWI_V2), y)
	CONFIG_QCA_SUPPORT_TX_MIN_RATES_FOR_SPECIAL_FRAMES := y
endif
```

## drivers/staging/qcacld-3.0/configs/kiwi_v2_defconfig
```kconfig
CONFIG_CNSS_KIWI := y
CONFIG_CNSS_KIWI_V2 := y

ifeq ($(CONFIG_ARCH_SDXPINN), y)
CONFIG_MOBILE_ROUTER := y
CONFIG_WLAN_SYSFS := y
endif

include $(WLAN_ROOT)/configs/default_defconfig

#Enable 11BE EHT
CONFIG_WLAN_FEATURE_11BE := y

#Enable IPA Optional wifi datapath feature
ifeq ($(CONFIG_ARCH_PINEAPPLE), y)
CONFIG_IPA_OPT_WIFI_DP := y
CONFIG_IPA_OFFLOAD := y
CONFIG_ENABLE_SMMU_S1_TRANSLATION := y
CONFIG_SMMU_S1_UNMAP := y
endif

# Enable EHT rate sysfs entry
ifeq ($(CONFIG_WLAN_SYSFS), y)
CONFIG_WLAN_SYSFS_EHT_RATE := y
endif

# Max Sta Vdev Config
CONFIG_CFG_MAX_STA_VDEVS := 4

#Enable 11BE MLO
CONFIG_WLAN_FEATURE_11BE_MLO := y

#Enable Peer table transition history
CONFIG_WLAN_FEATURE_PEER_TRANS_HIST := y

#Enable Single NDEV Multi VDEV
CONFIG_WLAN_HDD_MULTI_VDEV_SINGLE_NDEV := y

#BMISS offload max vdev config
CONFIG_CFG_BMISS_OFFLOAD_MAX_VDEV := 4

#Max MLD dev context
CONFIG_WLAN_UMAC_MLO_MAX_DEV := 3

#Chip version
CONFIG_CHIP_VERSION := 2

#DP configs
CONFIG_WLAN_DP_DISABLE_TCL_CMD_CRED_SRNG := y
CONFIG_WLAN_DP_DISABLE_TCL_STATUS_SRNG := y

# Enable separate FW image
CONFIG_GET_DRIVER_MODE := y

CONFIG_QCA_SUPPORT_TX_MIN_RATES_FOR_SPECIAL_FRAMES := y

#Enable COEX feature
CONFIG_FEATURE_COEX := y

#Enable DBAM feature
ifeq ($(CONFIG_FEATURE_COEX), y)
CONFIG_WLAN_FEATURE_COEX_DBAM := y
endif

CONFIG_DP_TRAFFIC_END_INDICATION := y

#Enable Constrained Application Protocol feature
CONFIG_WLAN_FEATURE_COAP := y

#Enable TSF read using scratch register
CONFIG_QCA_GET_TSF_VIA_REG := y

CONFIG_WLAN_FEATURE_AFFINITY_MGR := y

#Enable per link stats support
CONFIG_DP_MLO_LINK_STATS_SUPPORT := y

CONFIG_QCA_DFS_BW_PUNCTURE := y

ifeq ($(CONFIG_ARCH_SDXPINN), y)
CONFIG_WLAN_UMAC_MLO_MAX_DEV := 4

CONFIG_DP_FEATURE_HW_COOKIE_CONVERSION := n
CONFIG_DP_HW_COOKIE_CONVERT_EXCEPTION := n
CONFIG_DP_MEM_PRE_ALLOC := n
CONFIG_MORE_TX_DESC := n

CONFIG_WIFI_MONITOR_SUPPORT := n
CONFIG_QCA_MONITOR_PKT_SUPPORT := n
CONFIG_MONITOR_MODULARIZED_ENABLE := y

CONFIG_QCACLD_FEATURE_NAN := n
CONFIG_FEATURE_EPPING := n
CONFIG_FEATURE_P2P_LISTEN_OFFLOAD := n
CONFIG_WLAN_CFR_ENABLE := n

CONFIG_BEACON_TX_OFFLOAD_MAX_VDEV := 4
CONFIG_NUM_IPA_IFACE := 4
CONFIG_MAX_CLIENTS_ALLOWED := 64

CONFIG_QDF_MAX_NO_OF_SAP_MODE := 4

ifeq ($(CONFIG_IPA_OFFLOAD), y)
CONFIG_ENABLE_SMMU_S1_TRANSLATION := y
CONFIG_SMMU_S1_UNMAP := y
CONFIG_IPA_WDI3_TX_TWO_PIPES := y
endif # IPA_OFFLOAD

CONFIG_WLAN_SYSFS_RANGE_EXT := n

CONFIG_WLAN_FEATURE_RX_BUFFER_POOL := y
CONFIG_DP_RX_REFILL_BUFF_POOL_SIZE := 256
CONFIG_DP_RX_REFILL_THRD_THRESHOLD := 128

CONFIG_WLAN_FEATURE_COAP := n

endif # ARCH_SDXPINN

ifeq ($(CONFIG_ARCH_PINEAPPLE), y)
CONFIG_WLAN_TX_MON_2_0 := y
CONFIG_WLAN_DP_LOCAL_PKT_CAPTURE := y
endif

CONFIG_WLAN_FEATURE_LL_LT_SAP := y
```

## drivers/staging/qcacld-3.0/configs/mango_defconfig
```kconfig
CONFIG_CNSS_KIWI := y
CONFIG_CNSS_KIWI_V2 := y
CONFIG_CNSS_MANGO := y

include $(WLAN_ROOT)/configs/default_defconfig

#Enable 11BE EHT
CONFIG_WLAN_FEATURE_11BE := y

# Enable EHT rate sysfs entry
ifeq ($(CONFIG_WLAN_SYSFS), y)
CONFIG_WLAN_SYSFS_EHT_RATE := y
endif

# Max Sta Vdev Config
CONFIG_CFG_MAX_STA_VDEVS := 4

#Enable 11BE MLO
CONFIG_WLAN_FEATURE_11BE_MLO := y

#BMISS offload max vdev config
CONFIG_CFG_BMISS_OFFLOAD_MAX_VDEV := 4

#DP configs
CONFIG_WLAN_DP_DISABLE_TCL_CMD_CRED_SRNG := y
CONFIG_WLAN_DP_DISABLE_TCL_STATUS_SRNG := y

# Enable separate FW image
CONFIG_GET_DRIVER_MODE := y

CONFIG_QCA_SUPPORT_TX_MIN_RATES_FOR_SPECIAL_FRAMES := y

#Enable COEX feature
CONFIG_FEATURE_COEX := y

#Enable DBAM feature
ifeq ($(CONFIG_FEATURE_COEX), y)
CONFIG_WLAN_FEATURE_COEX_DBAM := y
endif

CONFIG_DP_TRAFFIC_END_INDICATION := y

#Enable Constrained Application Protocol feature
CONFIG_WLAN_FEATURE_COAP := y
```
