## Documentation/devicetree/bindings/display/panel/advantech,idk-1110wr.txt
```
Advantech IDK-1110WR 10.1" WSVGA LVDS Display Panel
===================================================

The Advantech IDK-1110WR is a 10.1" industrial grade LCD display with
4-wire resistive touch.

These DT bindings follow the LVDS panel bindings defined in panel-lvds.txt
with the following device-specific properties.

Required properties:

- compatible: Shall contain "advantech,idk-1110wr" and "panel-lvds", in that
  order.


Example
-------

panel {
	compatible = "advantech,idk-1110wr", "panel-lvds";

	width-mm = <223>;
	height-mm = <125>;

	data-mapping = "jeida-24";

	panel-timing {
		/* 1024x600 @60Hz */
		clock-frequency = <51200000>;
		hactive = <1024>;
		vactive = <600>;
		hsync-len = <240>;
		hfront-porch = <40>;
		hback-porch = <40>;
		vsync-len = <10>;
		vfront-porch = <15>;
		vback-porch = <10>;
	};

	port {
		panel_in: endpoint {
			remote-endpoint = <&lvds_encoder>;
		};
	};
};
```

## Documentation/devicetree/bindings/iio/st_lis2dg.txt
```
/* STMicroelectronics lis2dg sensor */

Required properties:
	- compatible : should be "st,lis2dg"
	- reg : the I2C address of the sensor

Optional properties:
	- interrupt-parent : should be the phandle for the interrupt controller
	- interrupts : interrupt mapping for GPIO IRQ, it should by configured with
		flags IRQ_TYPE_EDGE_RISING

Example:

lis2dg@1d {
	compatible = "st,lis2dg";
	reg = <0x1d>;
	interrupt-parent = <&gpio>;
	interrupts = <1 IRQ_TYPE_EDGE_RISING>;
};
```

## Documentation/devicetree/bindings/iio/st_lis2ds12.txt
```
/* STMicroelectronics lis2ds12 sensor */

Required properties:
	- compatible : should be "st,lis2ds12"
	- reg : the I2C address of the sensor

Optional properties:
	- interrupt-parent : should be the phandle for the interrupt controller
	- interrupts : interrupt mapping for GPIO IRQ, it should by configured with
		flags IRQ_TYPE_EDGE_RISING

Example:

lis2ds12@1d {
	compatible = "st,lis2ds12";
	reg = <0x1d>;
	interrupt-parent = <&gpio>;
	interrupts = <1 IRQ_TYPE_EDGE_RISING>;
};
```

## Documentation/devicetree/bindings/iio/st_lsm303agr.txt
```
/* STMicroelectronics lsm303agr eCompass sensor */

Required properties:
	- compatible : should be:
		- Accelerometer: "st,lsm303agr-accel"
		- Magnetometer:  "st,lsm303agr-magn"
	- reg : the I2C address of the sensor

Optional properties:
	- interrupt-parent : should be the phandle for the interrupt controller
	- interrupts : interrupt mapping for GPIO IRQ, it should by configured with
		flags IRQ_TYPE_EDGE_RISING

Example:

lsm303agr-accel@19 {
	compatible = "st,lsm303agr_accel";
	status = "ok";
	reg = <0x19>;
	interrupts = <1 IRQ_TYPE_EDGE_RISING>;
	interrupt-parent = <&gpio>;
};

lsm303agr-magn@1e {
	compatible = "st,lsm303agr_magn";
	status = "ok";
	reg = <0x1e>;
	interrupts = <2 IRQ_TYPE_EDGE_RISING>;
	interrupt-parent = <&gpio>;
};
```

## Documentation/devicetree/bindings/iio/st_lsm303ah.txt
```
/* STMicroelectronics lsm303ah sensor */

Required properties:
	- compatible : should be "st,lsm303ah"
	- reg : the I2C address of the sensor

Optional properties:
	- interrupt-parent : should be the phandle for the interrupt controller
	- interrupts : interrupt mapping for GPIO IRQ, it should by configured with
		flags IRQ_TYPE_EDGE_RISING

Example:

lsm303ah@1d {
	compatible = "st,lsm303ah";
	reg = <0x1d>;
	interrupt-parent = <&gpio>;
	interrupts = <1 IRQ_TYPE_EDGE_RISING>;
};
```

## Documentation/devicetree/bindings/iio/st_lsm6ds3.txt
```
/* STMicroelectronics lsm6ds3 sensor */

Required properties:
	- compatible : should be "st,lsm6ds3"
	- reg : the I2C address of the sensor

Optional properties:
	- interrupt-parent : should be the phandle for the interrupt controller
	- interrupts : interrupt mapping for GPIO IRQ, it should by configured with
		flags IRQ_TYPE_LEVEL_HIGH

Example:

lsm6ds3@6b {
	compatible = "st,lsm6ds3";
	reg = <0x6b>;
	interrupt-parent = <&gpio>;
	interrupts = <1 IRQ_TYPE_LEVEL_HIGH>;
};
```

## Documentation/devicetree/bindings/iio/st_lsm6dsm.txt
```
/* STMicroelectronics lsm6dsm sensor */

Required properties:
	- compatible : should be "st,lsm6dsm"
	- reg : the I2C address of the sensor

Optional properties:
	- interrupt-parent : should be the phandle for the interrupt controller
	- interrupts : interrupt mapping for GPIO IRQ, it should by configured with
		flags IRQ_TYPE_LEVEL_HIGH

Example:

lsm6dsm@6b {
	compatible = "st,lsm6dsm";
	reg = <0x6b>;
	interrupt-parent = <&gpio>;
	interrupts = <1 IRQ_TYPE_LEVEL_HIGH>;
};
```

## Documentation/devicetree/bindings/misc/oculus,swd.txt
```
Oculus SWD

Required properties:
- compatible : must be "oculus,swd"
- oculus,swd-flavor : swd flashing subprotocol, one of "nrf52832", "at91samd"
- oculus,swd-clk : handle to the gpio node for the SWD CLK pin
- oculus,swd-io : handle to the gpio node for the SWD IO pin
- oculus,fw-path : name of firmware, e.g. "myfirmware.bin"
- oculus,flash-block-size: <u32> flash memory block size, in bytes
- oculus,flash-page-size: <u32> flash memory page size, in bytes
- oculus,flash-page-count: <u32> number of flash memory page sizes

Optional properties:
- oculus,swd-core-supply : handle to regulator node to power SWD device, if
  applicable
- oculus,swd-core-voltage-level : cell with acceptable regulator min-max, if
  applicable
```

## Documentation/devicetree/bindings/misc/oculus,syncboss.txt
```
Oculus SyncBoss

Required properties:
- compatible : must be "oculus,syncboss"
- oculus,syncboss-reset : handle to gpio node for reset pin

Optional properties:
- oculus,syncboss-timesync = handle to gpio node for timesync pin
- oculus,syncboss-wakeup = handle to gpio node for wakeup pin
- oculus,syncboss-nsync = handle to gpio node for nsync pin
- oculus,mcu-core-supply : handle to regulator node to power the syncboss MCU,
  if applicable
- oculus,mcu-core-voltage-level = cell with mcu regulator voltage min-max, if
  applicable
- oculus,imu-core-supply : handle to regulator node to power imu, if applicable
- oculus,imu-core-voltage-level = cell with imu regulator voltage min-max, if
  applicable
- oculus,mag-core-supply : handle to regulator node to power magnetometer, if
  applicable
- oculus,mag-core-voltage-level : call with magnetometer regulator min-max, if
  applicable
```

## Documentation/devicetree/bindings/oculus/oculus_minisensor.txt
```
/* Oculus mini sensor driver */

Required properties:
	- compatible: should be "oculus,minisensor"
	- interrupts-extended: as defined in pinctrl
	- interrupts-flags: irq flags as defined in <dt-bindings/interrupt-controller/irq.h>
	- vdd-supply = regulator supply for the device
	- vdd-voltage-min = min regulator voltage in uV for the device (32-bit val)
	- vdd-voltage-max = max regulator voltage in uV for the device (32-bit val)

#include <dt-bindings/interrupt-controller/irq.h>

&spi_5 {
	lsm6dsl@0 {
		compatible = "oculus,minisensor";
		interrupts-extended = <&tlmm 115 0>;
		interrupts-flags = <IRQ_TYPE_LEVEL_HIGH>;
		vdd-supply = <&pm8994_lvs2>;
		vdd-voltage-min = 1800000;
		vdd-voltage-max = 1800000;
	};
}
```

## Documentation/devicetree/bindings/oculus/st_lis2mdl.txt
```
/* Oculus thin IMU driver for ST LIS2MDL sensor */

Required properties:
	- compatible: should be "oculus,lis2mdl"
	- int1-gpio: interrupt mapping for GPIO IRQ, it should by configured with
		     flags IRQ_TYPE_LEVEL_HIGH
	- vdd-supply = regulator supply for the device
	- vdd-voltage-min = min regulator voltage in uV for the device (32-bit val)
	- vdd-voltage-max = max regulator voltage in uV for the device (32-bit val)
	- vio-supply = regulator supply for the device
	- vio-voltage-min = min regulator voltage in uV for the device (32-bit val)
	- vio-voltage-max = max regulator voltage in uV for the device (32-bit val)

lis2mdl@0 {
	compatible = "oculus,lis2mdl";
	int1-gpio = <1 IRQ_TYPE_LEVEL_HIGH>;
	vdd-supply = <&pm8994_lvs2>;
	vdd-voltage-min = 1800000;
	vdd-voltage-max = 1800000;
	vio-supply = <&pm8994_lvs2>;
	vio-voltage-min = 1800000;
	vio-voltage-max = 1800000;
};
```

## arch/arm/configs/msm_debug_defconfig
```kconfig
CONFIG_SERIAL_MSM=y
CONFIG_SERIAL_MSM_CONSOLE=y
CONFIG_DYNAMIC_DEBUG=y
CONFIG_CAM_MCLK_DEBUG=y
CONFIG_MAGIC_SYSRQ=y
CONFIG_THERMAL_EMULATION=y
```

## arch/arm64/configs/msm_debug_defconfig
```kconfig
CONFIG_KGDB=y
CONFIG_KGDB_SERIAL_CONSOLE=y
CONFIG_QCOM_WATCHDOG_V2=n
CONFIG_SERIAL_MSM=y
CONFIG_SERIAL_MSM_CONSOLE=y
CONFIG_MSM_CAMERA_DEBUG=y
CONFIG_MSMB_CAMERA_DEBUG=y
CONFIG_MSM_SDE_ROTATOR_EVTLOG_DEBUG=y
CONFIG_FB_MSM_MDSS_XLOG_DEBUG=y
CONFIG_IOMMU_DEBUG=y
CONFIG_IOMMU_DEBUG_TRACKING=y
CONFIG_IOMMU_TESTS=y
CONFIG_CORESIGHT=y
CONFIG_CORESIGHT_EVENT=y
CONFIG_CORESIGHT_QCOM_REPLICATOR=y
CONFIG_CORESIGHT_STM=y
CONFIG_CORESIGHT_HWEVENT=y
CONFIG_CORESIGHT_CTI=y
CONFIG_CORESIGHT_TPDA=y
CONFIG_CORESIGHT_TPDM=y
CONFIG_CORESIGHT_QPDI=y
CONFIG_CORESIGHT_SOURCE_DUMMY=y
CONFIG_DYNAMIC_DEBUG=y
CONFIG_IKCONFIG_PROC=y
CONFIG_FTRACE=y
CONFIG_DYNAMIC_FTRACE=y
CONFIG_FUNCTION_TRACER=y
CONFIG_IRQSOFF_TRACER=y
CONFIG_FUNCTION_PROFILER=y
CONFIG_PREEMPT_TRACER=y
CONFIG_SCHED_TRACER=y
CONFIG_STACK_TRACER=y
CONFIG_IPC_LOGGING=y
CONFIG_CPU_FREQ_SWITCH_PROFILER=y
CONFIG_DEVMEM=y
CONFIG_MSM_IDLE_STATS=y
CONFIG_RMNET_DATA_DEBUG_PKT=y
CONFIG_CMA_DEBUGFS=y
CONFIG_DEBUG_SPINLOCK=y
CONFIG_DEBUG_MUTEXES=y
CONFIG_DEBUG_ATOMIC_SLEEP=y
CONFIG_DEBUG_LIST=y
```

## arch/arm64/configs/vendor/kasan_defconfig
```kconfig
CONFIG_KASAN=y
CONFIG_KASAN_SW_TAGS=y
CONFIG_KASAN_OUTLINE=y
CONFIG_KCOV=y
CONFIG_SLUB=y
CONFIG_SLUB_DEBUG=y
CONFIG_FRAME_WARN=8192
```
