/*
 * Copyright (c) 2019, The Linux Foundation. All rights reserved.
 *
 * This program is free software; you can redistribute it and/or modify
 * it under the terms of the GNU General Public License version 2 and
 * only version 2 as published by the Free Software Foundation.
 *
 * This program is distributed in the hope that it will be useful,
 * but WITHOUT ANY WARRANTY; without even the implied warranty of
 * MERCHANTABILITY or FITNESS FOR A PARTICULAR PURPOSE.  See the
 * GNU General Public License for more details.
 */

/dts-v1/;

#include "qcom-base/sdm429-spyro.dtsi"

/ {
	model = "MOS";
	compatible = "qcom,sdm429w-qrd", "qcom,sdm429w", "qcom,qrd";
	qcom,msm-id = <416 0x0>;
	qcom,board-id = <0 0>;
};

&mtp_batterydata {
	/delete-node/ qcom,ascent_3450mah;
	/delete-node/ qcom,mlp356477_2800mah;
	/delete-node/
	qcom,3388014_i13z5p_680mah_averaged_masterslave_mar26th2018;
};
