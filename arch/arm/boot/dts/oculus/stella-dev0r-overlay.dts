/*
 * Copyright (c) 2019, The Linux Foundation. All rights reserved.
 *
 * This program is free software; you can redistribute it and/or modify
 * it under the terms of the GNU General Public License version 2 and
 * only version 2 as published by the Free Software Foundation.
 *
 * This program is distributed in the hope that it will be useful,
 * but WITHOUT ANY WARRANTY; without even the implied warranty of
 * MERCHANTABILITY or FITNESS FOR A PARTICULAR PURPOSE.  See the
 * GNU General Public License for more details.
 */

/dts-v1/;
/plugin/;

#include "stella-common.dtsi"

/ {
	model = "Stella Dev0r";
	compatible = "qcom,sdm429w-qrd", "qcom,sdm429w", "qcom,sda429w";
	qcom,msm-id = <437 0x0>;
	qcom,board-id = <0x00010b 0x0a>;
	qcom,pmic-id = <0x0002001b 0x0 0x0 0x0>;
};

#include "stella-dev0-common.dtsi"
