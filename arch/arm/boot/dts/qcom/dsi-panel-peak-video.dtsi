&mdss_mdp {
	dsi_dual_boe_peak_video: qcom,mdss_dsi_boe_peak_video {
		qcom,mdss-dsi-panel-name = "Dual Peak video mode dsi panel";
		qcom,mdss-dsi-panel-type = "dsi_video_mode";

		// orientation, resolution
		qcom,mdss-dsi-panel-orientation = "180";
		qcom,mdss-dsi-panel-width = <1200>;
		qcom,mdss-dsi-panel-height = <1280>;

		// physical dimensions
		// note: physical width counts *both* screens
		//qcom,mdss-pan-physical-width-dimension = <118>;
		//qcom,mdss-pan-physical-height-dimension = <66>;
		qcom,mdss-dsi-panel-hdr-color-primaries = <14500 15500 32000
			17000 15500 30000 8000 3000>;
		qcom,mdss-dsi-panel-peak-brightness = <4200000>;
		qcom,mdss-dsi-panel-blackness-level = <3230>;

		qcom,mdss-dsi-panel-hdr-enabled;

		// timings
		qcom,mdss-dsi-panel-framerate = <72>;
		qcom,mdss-dsi-h-front-porch = <30>;
		qcom,mdss-dsi-h-back-porch = <20>;
		qcom,mdss-dsi-h-pulse-width = <1>;
		qcom,mdss-dsi-h-sync-skew = <0>;
		qcom,mdss-dsi-v-front-porch = <738>;
		qcom,mdss-dsi-v-back-porch = <14>;
		qcom,mdss-dsi-v-pulse-width = <1>;

		// border
		qcom,mdss-dsi-h-left-border = <0>;
		qcom,mdss-dsi-h-right-border = <0>;
		qcom,mdss-dsi-v-top-border = <0>;
		qcom,mdss-dsi-v-bottom-border = <0>;
		qcom,mdss-dsi-bpp = <24>;

		// sync
		qcom,mdss-dsi-traffic-mode = "burst_mode";
		qcom,cmd-sync-wait-broadcast;
		qcom,mdss-dsi-h-sync-pulse = <0>;

		// power & reset
		qcom,mdss-dsi-bllp-eof-power-mode;
		qcom,mdss-dsi-bllp-power-mode;
		qcom,mdss-dsi-lp11-init;
		qcom,mdss-dsi-reset-sequence = <1 20>, <0 20>, <1 20>;

		// 4 lanes enabled, timings from QC spreadsheet
		qcom,mdss-dsi-lane-0-state;
		qcom,mdss-dsi-lane-1-state;
		qcom,mdss-dsi-lane-2-state;
		qcom,mdss-dsi-lane-3-state;
		qcom,mdss-dsi-panel-timings = [
			00 24 0A 0A 26 25 09 0A 06 02 04 00
		];
		qcom,mdss-dsi-t-clk-post = <12>;
		qcom,mdss-dsi-t-clk-pre = <40>;
		qcom,mdss-dsi-dma-trigger = "trigger_sw";
		qcom,mdss-dsi-mdp-trigger = "none";
		qcom,mdss-dsi-tx-eot-append;

		// backlight
		qcom,mdss-dsi-bl-pmic-control-type = "bl_ctrl_dcs";
		qcom,mdss-dsi-bl-min-level = <1>;
		qcom,mdss-dsi-bl-max-level = <255>;

		// found in the Peak panel operating guide

		qcom,mdss-dsi-on-command = [29 01 00 00 00 00 02 B0 04
		29 01 00 00 00 00 02 B1 00
		29 01 00 00 00 00 08 B2 00 00 00 00 00 01 00
		29 01 00 00 00 00 02 B3 00
		29 01 00 00 00 00 04 B4 00 00 0A
		29 01 00 00 00 00 17 B5 00 00 00 00 00 00 00 03 02 26 66 00 00 00 00 00 00 00 00 00 00 00
		29 01 00 00 00 00 0A B6 30 6B 80 06 33 8A 00 1A 7A
		29 01 00 00 00 00 05 B7 54 00 00 00
		29 01 00 00 00 00 93 B8 18 58 22 00 01  01 18 20 3E FF 8F F0 20 00 5C 1B 07 3A 38 F8 08 20 00 40 00 1B 1B 0A 0A 1B 1B 0A 2C 0A 00 28 18 08 30 08 00 20 20 00 11 21 31 41 51 61 71 81 91 A1 B1 C1 D1 E1 F1 FF 00 00 00 00 03 00 0B 2E 16 25 2E 81 5E 75 94 A5 D6 CE FA D8 FF ED D0 18 57 FF 02 00 10 20 30 40 50 60 70 80 90 A0 B0 C0 D0 E0 F0 FF 00 00 00 00 03 71 4C 92 71 4C 92 11 41 44 11 41 44 88 28 22 DD 7D 77 88 78 77 22 D2 DD 06 00 01 05 01 00 00 03 10 00 00 00 00
		29 01 00 00 00 00 41 B9 17 BF 02 AD 00 00 00 00 05 DC 00 C8 00 00 00 00 05 DC 00 C8 00 00 00 00 05 DC 00 C8 00 00 00 00 05 DC 00 C8 00 00 00 00 05 DC 00 C8 00 00 00 00 05 DC 00 C8 00 00 00 00 05 DC 00 C8 00 00 00 00
		29 01 00 00 00 00 06 BA 08 07 80 07 00
		29 01 00 00 00 00 13 BB 00 00 00 00 00 00 00 00 00 00 00 00 00 00 00 00 00 00
		29 01 00 00 00 00 0C BC 20 00 00 00 00 00 00 00 00 FF FF
		29 01 00 00 00 00 03 BD 00 00
		29 01 00 00 00 00 24 BE 00 00 00 00 00 00 69 00 00 00 00 00 00 00 01 00 00 00 00 00 00 00 00 00 00 01 01 01 01 01 01 01 01 00 00
		29 01 00 00 00 00 4D BF 02 3C 34 55 00 00 00 00 00 00 00 00 00 00 00 00 00 00 00 00 00 00 00 00 00 00 00 00 00 00 00 00 00 00 00 00 00 00 00 00 00 00 00 00 00 00 00 00 00 00 00 00 00 00 00 00 00 00 00 00 00 00 00 00 00 00 00 00 00 00 00 00 00 00 00 00
		29 01 00 00 00 00 12 C0 40 40 14 00 07 80 00 08 00 00 08 41 00 00 14 00 08
		29 01 00 00 00 00 19 C1 30 00 00 10 11 00 00 00 22 00 00 05 20 FA 00 08 00 00 00 00 00 00 00 00
		29 01 00 00 00 00 6D C2 01 3B 81 01 00 01 00 00 00 00 00 00 00 00 00 00 00 00 00 00 00 01 3B 02 02 01 01 C1 00 05 00 01 00 00 00 08 00 00 00 00 00 00 00 00 00 00 00 00 00 00 00 00 00 00 00 01 3B 02 02 01 01 00 07 95 07 98 00 00 00 08 00 00 00 00 00 00 00 00 00 00 00 00 00 00 00 00 00 00 00 00 00 00 00 00 00 00 00 0F 00 00 00 00 00 00 00 00 00 00
		29 01 00 00 00 00 55 C3 00 00 01 00 10 00 0A 00 00 00 80 00 00 00 01 00 01 00 02 00 00 00 80 80 00 00 00 00 00 00 00 00 00 00 00 00 00 00 00 00 00 00 00 00 00 00 00 00 00 00 00 00 00 00 00 00 00 00 00 00 00 00 00 00 00 00 00 00 00 00 00 00 00 00 00 00 00 00 00 00 00 00 00 00
		29 01 00 00 00 00 7B C4 00 00 00 A3 A3 A3 8E A1 A2 8D 9F 93 92 9C 9A 9B 9A 9B 00 00 00 00 00 00 00 00 9B 9A 9B 9A 9C 92 93 9F 8D A2 A1 8E A3 A3 A3 00 00 00 FF FF FF FF FF 0F DF FF FF FF BF 0F 00 00 00 00 00 00 00 00 00 00 00 00 00 00 00 00 00 00 00 00 00 00 00 00 00 00 00 00 00 00 00 00 00 00 00 00 00 00 00 00 00 00 00 00 00 00 00 00 00 00 00 00 00 00 00 00 00 00 50 00 00 00 00 00 00 00
		29 01 00 00 00 00 06 C5 08 00 00 00 00
		29 01 00 00 00 00 38 C6 0B 08 07 48 00 00 13 01 FF 00 02 06 16 16 00 00 00 01 40 0C 00 00 00 00 00 00 00 40 00 00 b0 04 b0 04 38 7f 07 38 00 00 00 00 00 00 00 00 00 00 00 00 00 00 00 00 00
		29 01 00 00 00 00 4D C7 00 00 00 CA 01 8F 02 0E 01 85 02 0F 02 81 01 D4 01 F3 02 15 02 74 01 DA 02 2A 02 A3 02 28 02 D4 03 69 03 AF 03 FF 00 00 00 CA 01 8F 02 0E 01 85 02 0F 02 81 01 D4 01 F3 02 15 02 74 01 DA 02 2A 02 A3 02 28 02 D4 03 69 03 AF 03 FF
		29 01 00 00 00 00 32 C8 81 00 03 03 01 FF 00 00 01 FE 02 8D 00 00 FF FE 04 B9 00 00 03 03 01 FF 00 01 FE 02 8D 00 FF FE 04 B9 00 03 03 01 FF 00 01 FE 02 8D 00 FF FE 04 B9
		29 01 00 00 00 00 13 C9 00 03 03 01 FF 00 00 01 FE 02 8D 00 00 FF FE 04 B9 00
		29 01 00 00 00 00 09 CB 00 F0 00 00 01 00 FF 00
		29 01 00 00 00 00 02 CD 11
		29 01 00 00 00 00 44 CE 00 00 00 00 00 00 00 00 00 00 00 00 00 00 00 00 00 00 00 00 00 00 00 00 00 00 00 00 00 00 00 00 00 00 00 00 00 00 00 00 00 00 00 00 00 00 00 00 00 00 00 00 00 00 00 00 00 00 00 00 00 00 00 00 00 00 00
		29 01 00 00 00 00 08 CF 00 00 80 46 61 00 00
		29 01 00 00 00 00 11 D0 F1 32 03 94 C7 04 B1 32 03 00 A4 C7 0A F2 55 05
		29 01 00 00 00 00 27 D1 EF EF 33 33 07 03 3B 77 37 77 37 35 33 33 F7 33 03 03 03 36 36 66 6D 0D 0A 30 13 0A 0B 00 C4 C4 28 28 28 28 00 00
		29 01 00 00 00 00 02 D2 00
		29 01 00 00 00 00 04 D4 00 00 00
		29 01 00 00 00 00 06 E5 03 00 02 00 00
		29 01 00 00 00 00 07 D5 02 A7 02 36 02 00
		29 01 00 00 00 00 02 D6 00
		29 01 00 00 00 00 79 D7 01 32 01 38 C0 12 12 7A 00 08 0A 00 07 50 00 0C 0C 0C 0C 10 00 02 0C 0E 02 05 04 07 02 00 02 05 03 00 00 00 04 07 05 06 06 05 05 08 0A 0C 0A 0A 0A 0C 0A 06 08 07 09 08 0A 09 0B 00 00 00 00 00 00 00 0A 0A 0A 08 08 0A 0A 0A 3C 3C 3C 0A 08 08 08 08 04 04 08 08 08 04 04 08 08 08 08 00 00 00 02 02 05 04 07 02 00 02 05 03 04 07 05 00 00 00 00 00 02 02 02 02 00 00
		29 01 00 00 00 00 0F D8 BA 98 76 54 32 10 BA 98 76 54 32 10 00 00
		29 01 00 00 00 00 0F D9 BA 98 76 54 32 10 BA 98 76 54 32 10 00 00
		29 01 00 00 00 00 02 DA 00
		29 01 00 00 00 00 02 DB 00
		29 01 00 00 00 00 02 DC 00
		29 01 00 00 00 00 05 DD 32 06 18 52
		29 01 00 00 00 00 19 DE 00 00 0F FF 10 20 20 10 B4 B4 03 E4 FF FF FF 7F 20 10 08 01 00 00 00 00
		29 01 00 00 00 00 02 DF 00
		29 01 00 00 00 00 09 E0 40 00 4D 8B 4D 8B 4D 8B
		29 01 00 00 00 00 09 E1 40 00 4D 8B 4D 8B 4D 8B
		29 01 00 00 00 00 0D E2 00 00 00 00 00 00 00 00 00 00 00 00
		29 01 00 00 00 00 02 E3 FF
		29 01 00 00 00 00 34 E4 00 05 07 71 00 00 00 03 00 00 00 00 00 00 00 00 00 00 00 00 00 00 00 00 00 00 00 00 00 00 00 00 00 00 00 00 0C 00 00 00 0A 00 00 00 0A 08 00 00 27 00 00
		29 01 00 00 00 00 06 E5 03 00 00 00 00
		29 01 00 00 00 00 BD E6 12 00 00 89 10 80 07 80 07 20 00 10 01 C8 01 C8 02 00 01 E4 00 20 01 63 00 06 00 0C 06 67 07 87 18 00 10 F0 03 0C 20 00 06 0B 0B 33 0E 1C 2A 38 46 54 62 69 70 77 79 7B 7D 7E 01 02 01 00 09 40 09 BE 19 FC 19 FA 19 F8 1A 38 1A 78 1A B6 2A B6 2A F4 2A F4 4B 34 63 74 00 00 00 00 00 00 00 00 00 00 00 00 00 00 00 00 00 00 00 00 00 00 00 00 00 00 00 00 00 00 00 00 00 00 00 00 00 00 00 00 00 10 0C 07 10 20 00 06 0F 0F 33 0E 1C 2A 38 46 54 62 69 70 77 79 7B 7D 7E 01 C2 22 00 2A 40 2A BE 3A FC 3A FA 3A F8 3B 38 3B 78 3B 76 4B B6 4B B6 4B F4 63 F4 7C 00 00 00 00 00 00
		29 01 00 00 00 00 0B E7 50 00 00 00 00 00 00 00 00 00
		29 01 00 00 00 00 03 E8 09 28
		29 01 00 00 00 00 0D E9 04 00 00 00 00 00 00 00 00 00 00 00
		29 01 00 00 00 00 0A EA 00 00 00 00 00 00 00 00 00
		29 01 00 00 00 00 49 EB 02 03 00 01 06 07 04 05 0A 0B 08 09 0E 0F 0C 0D 12 13 10 11 16 17 14 15 1A 1B 18 19 1E 1F 1C 1D 22 23 20 21 02 03 00 01 06 07 04 05 0A 0B 08 09 0E 0F 0C 0D 12 13 10 11 16 17 14 15 1A 1B 18 19 1E 1F 1C 1D 22 23 20 21
		29 01 00 00 00 00 06 EC 03 00 00 00 00
		29 01 00 00 00 00 14 ED 04 02 FF 00 00 00 00 00 00 00 00 00 00 00 00 00 00 00 00
		29 01 00 00 00 00 7C EE 0C 00 00 0C 00 13 01 00 00 00 00 00 00 0C 00 33 01 00 0D 00 13 01 00 0D 00 33 01 00 0D 00 33 01 00 0C 00 03 00 00 0C 00 13 11 00 0D 00 13 01 00 0C 00 11 01 00 0C 00 11 01 00 00 00 00 00 00 00 00 00 00 00 00 00 00 00 00 00 00 00 00 00 30 00 00 00 11 01 00 00 00 00 00 00 00 30 00 00 00 10 01 00 00 00 00 00 00 00 00 00 00 00 00 00 00 00 00 00 00 00 00 0C 00 13 01 00 02
		29 01 00 00 00 00 4A EF 03 21 38 00 17 17 00 00 01 1E 36 00 03 03 03 00 00 00 00 00 00 00 00 00 00 00 00 00 00 00 00 00 33 00 00 00 00 02 00 01 00 01 0A 0A 00 00 00 03 11 00 01 00 00 00 01 00 00 00 01 00 00 00 01 00 00 00 00 00 00 00 00 00 00
		29 01 00 00 00 00 02 70 00
		29 01 00 00 00 00 02 71 00
		29 01 00 00 00 00 02 72 00
		29 01 00 00 00 00 02 73 00
		29 01 00 00 00 00 02 74 00
		29 01 00 00 00 00 02 75 00
		29 01 00 00 00 00 02 76 00
		29 01 00 00 00 00 02 77 00
		29 01 00 00 00 00 02 78 00
		29 01 00 00 00 00 02 79 00
		29 01 00 00 00 00 02 7A 00
		29 01 00 00 00 00 02 7B 00
		29 01 00 00 00 00 02 7C 00
		29 01 00 00 00 00 02 7D 00
		29 01 00 00 00 00 02 7E 00
		29 01 00 00 00 00 12 A1 00 00 00 00 00 00 00 00 00 00 00 00 00 00 00 00 FF
		29 01 00 00 00 00 04 F0 00 00 00
		29 01 00 00 00 00 02 F1 00
		29 01 00 00 00 00 06 F2 00 00 00 00 00
		29 01 00 00 00 00 0C F3 48 08 00 00 00 00 00 00 00 00 00
		29 01 00 00 00 00 1A F4 00 00 00 00 00 00 00 00 00 00 00 00 00 00 00 00 00 40 00 4D 8B 4D 8B 4D 8B
		29 01 00 00 00 00 02 F5 00
		29 01 00 00 00 00 1F FA 00 00 00 00 00 00 00 00 00 00 00 00 00 00 00 00 00 00 00 00 00 00 00 00 00 00 00 00 00 00
		29 01 00 00 00 00 0B FB 00 00 00 00 00 FF FF FF FF FF
		29 01 00 00 00 00 24 FC 00 00 00 00 00 00 00 00 00 00 00 00 00 00 00 00 00 00 00 00 00 00 00 00 00 00 00 00 00 00 00 00 00 00 00
		29 01 00 00 00 00 08 FD 00 00 00 00 00 00 00
		29 01 00 00 0A 00 0B FE 00 00 00 60 00 00 01 08 00 00
		15 01 00 00 00 00 02 35 00
		05 01 00 00 78 00 01 11
		05 01 00 00 78 00 01 29];

		qcom,mdss-dsi-off-command = [
			05 01 00 00 14 00 02 28 00
			05 01 00 00 78 00 02 10 00
		];

		// before video is on, the DSI panels typically
		// accept either hs or lp, but lp is prefered.
		qcom,mdss-dsi-on-command-state = "dsi_lp_mode";
		// once video is on, the DSI panels typically
		// only accept hs mode commands
		qcom,mdss-dsi-off-command-state = "dsi_hs_mode";
		//qcom,compression-mode = "dsc";

		qcom,config-select = <&dsi_dual_boe_peak_config0>;
		dsi_dual_boe_peak_config0: config0 {
			qcom,split-mode = "dualctl-split";
		};
		dsi_dual_boe_peak_config1: config1 {
			qcom,split-mode = "pingpong-split";
		};
	};
};
