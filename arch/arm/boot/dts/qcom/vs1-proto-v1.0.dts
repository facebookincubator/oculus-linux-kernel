/* Copyright (c) 2016, The Linux Foundation. All rights reserved.
 *
 * This program is free software; you can redistribute it and/or modify
 * it under the terms of the GNU General Public License version 2 and
 * only version 2 as published by the Free Software Foundation.
 *
 * This program is distributed in the hope that it will be useful,
 * but WITHOUT ANY WARRANTY; without even the implied warranty of
 * MERCHANTABILITY or FITNESS FOR A PARTICULAR PURPOSE.  See the
 * GNU General Public License for more details.
 */

/dts-v1/;

#include "apq8998-v2.1.dtsi"
#include "msm8998-mtp.dtsi"
#include "vs1-camera.dtsi"
#include "vs1-misc.dtsi"
#include "vs1-serial.dtsi"
#include "vs1.dtsi"

/ {
	model = "vs1 proto1";
	compatible = "qcom,apq8998-mtp", "qcom,apq8998", "qcom,mtp";
	qcom,board-id = <0x08 0x01>;

	vs1_batterydata: qcom,battery-data {
		#include "2884921_Oculus_MontereyScud_4000mAh_averaged_MasterSlave_Apr17th2017_PMI8998GUI20055.dtsi"
	};
};

&pmi8998_charger {
	qcom,fcc-max-ua = <1900000>;    /* Reduce from 3A */
};

&pmi8998_fg {
	qcom,battery-data = <&vs1_batterydata>;
};
