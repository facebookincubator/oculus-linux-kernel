/* Copyright (c) 2016, The Linux Foundation. All rights reserved.
 *
 * This program is free software; you can redistribute it and/or modify
 * it under the terms of the GNU General Public License version 2 and
 * only version 2 as published by the Free Software Foundation.
 *
 * This program is distributed in the hope that it will be useful,
 * but WITHOUT ANY WARRANTY; without even the implied warranty of
 * MERCHANTABILITY or FITNESS FOR A PARTICULAR PURPOSE.  See the
 * GNU General Public License for more details.
 */


/dts-v1/;

#include "vs1-evt.dtsi"

/ {
	model = "vs1 evt";
	compatible = "qcom,apq8998-mtp", "qcom,apq8998", "qcom,mtp";
	qcom,board-id = <0x08 0x05>;

	vs1_batterydata: qcom,battery-data {
		#include "3313509_Pegatron_VS1scud_4000mAh_averaged_MasterSlave_Mar12th2018_PMI8998GUI20058.dtsi"
	};
};

&spi_12 {
	oculusnrf@0 {
		oculus,syncboss-must-enable-cam-temp-sensor-power;
	};
};
