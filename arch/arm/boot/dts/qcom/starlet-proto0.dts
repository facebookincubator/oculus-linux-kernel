/* Copyright (c) 2016, The Linux Foundation. All rights reserved.
 *
 * This program is free software; you can redistribute it and/or modify
 * it under the terms of the GNU General Public License version 2 and
 * only version 2 as published by the Free Software Foundation.
 *
 * This program is distributed in the hope that it will be useful,
 * but WITHOUT ANY WARRANTY; without even the implied warranty of
 * MERCHANTABILITY or FITNESS FOR A PARTICULAR PURPOSE.  See the
 * GNU General Public License for more details.
 */


/dts-v1/;

#include "vs1-dvt.dtsi"
#include "vs1-starlet-compat.dtsi"

/ {
	model = "starlet proto0";
	compatible = "qcom,apq8998-mtp", "qcom,apq8998", "qcom,mtp";
	qcom,board-id = <0x08 0x40>;

	vs1_batterydata: qcom,battery-data {
		#include "4321000_Sunwoda_starlet_555mAh_fake_MasterSlave_Nov20th2019_PMI8998GUI20058.dtsi"
	};
};

&pmi8998_charger {
	qcom,usb-icl-ua = <500000>;
	/delete-property/ qcom,step-charging-enable;
};
