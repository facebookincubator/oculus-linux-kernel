
&mdss_mdp {
	dsi_dual_auo_spr_video: qcom,mdss_dsi_auo_1440x1600_video {
		qcom,mdss-dsi-panel-name = "Dual AUO video mode dsi panel w/ DSC+SPR";
		qcom,mdss-dsi-panel-type = "dsi_video_mode";

		// orientation, resolution
		qcom,mdss-dsi-panel-orientation = "180";
		qcom,mdss-dsi-panel-width = <1440>;
		qcom,mdss-dsi-panel-height = <1600>;

		// physical dimensions
		// note: physical width counts *both* screens
		qcom,mdss-pan-physical-width-dimension = <118>;
		qcom,mdss-pan-physical-height-dimension = <66>;

		qcom,mdss-dsi-panel-hdr-enabled;
		// Scale by 1 / 50000 to get x & y coordinates
		qcom,mdss-dsi-panel-hdr-color-primaries = <
			15000 16000 // W - x: 0.300, y: 0.320
			33500 16500 // R - x: 0.670, y: 0.330
			11800 35550 // G - x: 0.236. y: 0.711
			6500 3250>; // B - x: 0.130, y: 0.065
		// Scale by 1 / 10000 to get nits
		qcom,mdss-dsi-panel-peak-brightness = <1000000>;
		qcom,mdss-dsi-panel-blackness-level = <50>;

		// timings
		qcom,mdss-dsi-panel-framerate = <72>;
		qcom,mdss-dsi-h-front-porch = <16>;
		qcom,mdss-dsi-h-back-porch = <8>;
		qcom,mdss-dsi-h-pulse-width = <8>;
		qcom,mdss-dsi-h-sync-skew = <0>;
		qcom,mdss-dsi-v-front-porch = <16>;
		qcom,mdss-dsi-v-back-porch = <8>;
		qcom,mdss-dsi-v-pulse-width = <8>;

		// border
		qcom,mdss-dsi-h-left-border = <0>;
		qcom,mdss-dsi-h-right-border = <0>;
		qcom,mdss-dsi-v-top-border = <0>;
		qcom,mdss-dsi-v-bottom-border = <0>;
		qcom,mdss-dsi-bpp = <24>;

		// sync
		qcom,mdss-dsi-traffic-mode = "non_burst_sync_event";
		qcom,cmd-sync-wait-broadcast;
		qcom,mdss-dsi-h-sync-pulse = <0>;

		// power & reset
		qcom,mdss-dsi-bllp-eof-power-mode;
		qcom,mdss-dsi-bllp-power-mode;
		qcom,mdss-dsi-lp11-init;
		qcom,mdss-dsi-reset-sequence = <1 10>, <0 10>, <1 50>;

		// 4 lanes enabled, timings from QC spreadsheet
		qcom,mdss-dsi-lane-0-state;
		qcom,mdss-dsi-lane-1-state;
		qcom,mdss-dsi-lane-2-state;
		qcom,mdss-dsi-lane-3-state;
		qcom,mdss-dsi-panel-timings = [
			00 22 09 09 25 24 09 09 06 03 04 00
		];
		qcom,mdss-dsi-t-clk-post = <0x0E>;
		qcom,mdss-dsi-t-clk-pre = <0x35>;
		qcom,mdss-dsi-dma-trigger = "trigger_sw";
		qcom,mdss-dsi-mdp-trigger = "none";

		// backlight
		qcom,mdss-dsi-bl-pmic-control-type = "bl_ctrl_none";
		qcom,mdss-dsi-bl-min-level = <1>;
		qcom,mdss-dsi-bl-max-level = <255>;

		// found in the AUO panel operating guide
		qcom,mdss-dsi-on-command = [
			15 01 00 00 00 00 02 FE 09
			15 01 00 00 00 00 02 12 18
			15 01 00 00 00 00 02 13 86
			15 01 00 00 00 00 02 14 61
			15 01 00 00 00 00 02 15 18
			15 01 00 00 00 00 02 16 86
			15 01 00 00 00 00 02 17 61
			15 01 00 00 00 00 02 18 18
			15 01 00 00 00 00 02 19 86
			15 01 00 00 00 00 02 1A 61
			15 01 00 00 00 00 02 1B 18
			15 01 00 00 00 00 02 1C 86
			15 01 00 00 00 00 02 1D 61
			15 01 00 00 00 00 02 1E 18
			15 01 00 00 00 00 02 1F 86
			15 01 00 00 00 00 02 20 61
			15 01 00 00 00 00 02 21 18
			15 01 00 00 00 00 02 22 86
			15 01 00 00 00 00 02 23 61
			15 01 00 00 00 00 02 A2 B4

			15 01 00 00 00 00 02 FE 04
			15 01 00 00 00 00 02 0D 40
			15 01 00 00 00 00 02 0E 40
			15 01 00 00 00 00 02 0F 90
			15 01 00 00 00 00 02 10 01
			15 01 00 00 00 00 02 B7 24
			15 01 00 00 00 00 02 B8 6D
			15 01 00 00 00 00 02 B9 0B
			15 01 00 00 00 00 02 BA 24
			15 01 00 00 00 00 02 BB B9
			15 01 00 00 00 00 02 BC 6D
			15 01 00 00 00 00 02 BD B6
			15 01 00 00 00 00 02 BE 0D
			15 01 00 00 00 00 02 BF 00
			15 01 00 00 00 00 02 C0 49
			15 01 00 00 00 00 02 C1 42
			15 01 00 00 00 00 02 C2 92
			15 01 00 00 00 00 02 C3 DB
			15 01 00 00 00 00 02 C4 96
			15 01 00 00 00 00 02 4E 00
			15 01 00 00 00 00 02 4F 20
			15 01 00 00 00 00 02 50 49
			15 01 00 00 00 00 02 51 92
			15 01 00 00 00 00 02 52 64
			15 01 00 00 00 00 02 53 DB

			15 01 00 00 00 00 02 FE 0A
			15 01 00 00 00 00 02 25 00

			15 01 00 00 00 00 02 FE 0D
			15 01 00 00 00 00 02 AF 00

			15 01 00 00 00 00 02 FE 04
			15 01 00 00 00 00 02 1D 30
			15 01 00 00 00 00 02 1E 03

			15 01 00 00 00 00 02 FE 0D
			15 01 00 00 00 00 02 7D 84

			15 01 00 00 00 00 02 FE 04
			15 01 00 00 00 00 02 66 01

			15 01 00 00 00 00 02 FE 00
			15 01 00 00 00 00 02 C2 03
			15 01 00 00 00 00 02 35 00

			/* TE Signal Enable for Vsync */
			39 01 00 00 00 00 03 44 00 00
			15 01 00 00 00 00 02 35 00

			/* Enable DSC */
			07 01 00 00 0a 00 01 01
			/* exit sleep mode, wait 200ms */
			05 01 00 00 3C 00 01 11
			/* Set display on, wait 200ms */
			05 01 00 00 3C 00 01 29
		];
		qcom,mdss-dsi-off-command = [
			/* set display off */
			05 01 00 00 32 00 02 28 00
			/* enter sleep mode */
			05 01 00 00 78 00 02 10 00
		];

		// before video is on, the DSI panels typically
		// accept either hs or lp, but lp is prefered.
		qcom,mdss-dsi-on-command-state = "dsi_lp_mode";
		// once video is on, the DSI panels typically
		// only accept hs mode commands
		qcom,mdss-dsi-off-command-state = "dsi_hs_mode";
		qcom,compression-mode = "dsc";

		qcom,config-select = <&dsi_dual_auo_spr_video_config0>;
		dsi_dual_auo_spr_video_config0: config0 {
			qcom,split-mode = "dualctl-split";
			qcom,mdss-dsc-encoders = <1>;
			qcom,mdss-dsc-slice-height = <400>;
			qcom,mdss-dsc-slice-width = <1440>;
			qcom,mdss-dsc-slice-per-pkt = <1>;

			qcom,mdss-dsc-bit-per-component = <8>;
			qcom,mdss-dsc-bit-per-pixel = <8>;
			qcom,mdss-dsc-block-prediction-enable;
		};
		dsi_dual_auo_spr_video_config1: config1 {
			qcom,split-mode = "pingpong-split";
		};
	};
};
