
qcom,3313509_pegatron_vs1scud_4000mah_averaged_masterslave_may15th2018 {
	qcom, = <24>;
	/* #3313509_Pegatron_VS1scud_4000mAh_averaged_MasterSlave_May15th2018*/
	qcom,max-voltage-uv = <4300000>;
	qcom,nom-batt-capacity-mah = <4000>;
	qcom,batt-id-kohm = <100>;
	qcom,battery-beta = <3380>;
	qcom,fastchg-current-ma = <1900>;
	qcom,fg-cc-cv-threshold-mv = <4285>;
	qcom,battery-type = "3313509_pegatron_vs1scud_4000mah_averaged_masterslave_may15th2018";
	qcom,checksum = <0x9238>;
	qcom,gui-version = "PMI8998GUI - 2.0.0.58";
	qcom,fg-profile-data = [
		 59 1F 0E 06
		 C7 03 E7 06
		 75 1C 53 02
		 B0 0D 36 0A
		 7A 16 69 23
		 9C 45 4F 52
		 82 00 00 00
		 16 00 00 00
		 00 00 13 AB
		 DA C4 27 C3
		 22 00 08 00
		 B1 E5 93 DD
		 9D 05 2D 01
		 E9 05 DA 03
		 CF 05 32 32
		 25 06 09 20
		 27 00 14 00
		 43 1F 99 FC
		 84 03 E5 FD
		 67 1C 51 03
		 F3 15 06 12
		 4A 18 9E 22
		 2E 3C ED 4B
		 6D 00 00 00
		 14 00 00 00
		 00 00 61 CD
		 1D CA 61 CD
		 1D 00 00 00
		 5F EA 93 DD
		 BF 05 15 FA
		 B7 FC 9C 02
		 D1 FC 14 1A
		 A7 33 CC FF
		 07 10 00 00
		 23 0F CC 44
		 1D 00 40 00
		 26 01 0A FA
		 FF 00 00 00
		 00 00 00 00
		 00 00 00 00
		 00 00 00 00
		 00 00 00 00
		 00 00 00 00
		 00 00 00 00
		 00 00 00 00
		 00 00 00 00
		 00 00 00 00
		 00 00 00 00
		 00 00 00 00
		 00 00 00 00
		 00 00 00 00
		 00 00 00 00
		 00 00 00 00
		 00 00 00 00
		 00 00 00 00
		 00 00 00 00
	];
};
