/* Copyright (c) 2015, The Linux Foundation. All rights reserved.
 *
 * This program is free software; you can redistribute it and/or modify
 * it under the terms of the GNU General Public License version 2 and
 * only version 2 as published by the Free Software Foundation.
 *
 * This program is distributed in the hope that it will be useful,
 * but WITHOUT ANY WARRANTY; without even the implied warranty of
 * MERCHANTABILITY or FITNESS FOR A PARTICULAR PURPOSE.  See the
 * GNU General Public License for more details.
 */

qcom,itech-3030mah {
	/* #3150481_Longcheer_V190sony_2900mAh_averaged_MasterSlave_Oct18th2017*/
	qcom,max-voltage-uv = <4160000>;
	qcom,nom-batt-capacity-mah = <2900>;
	qcom,batt-id-kohm = <130>;
	qcom,battery-beta = <3435>;
	qcom,thermal-coefficients = [c8 86 c1 50 d3 37];//3430, 86c8 50c1 37d3
	qcom,battery-type = "itech_3030mah";
	qcom,chg-rslow-comp-c1 = <2475922>;
	qcom,chg-rslow-comp-c2 = <2273608>;
	qcom,chg-rs-to-rslow = <1637264>;
	qcom,chg-rslow-comp-thr = <0x99>;
	qcom,checksum = <0x5022>;
	qcom,gui-version = "PMI8996GUI - 1.1.0.4";
	qcom,fg-profile-data = [
		 32 88 7E 84
		 AC 82 72 7C
		 43 82 96 81
		 44 8E AE 89
		 12 82 C3 91
		 BE B4 4E C1
		 A1 1A DC 81
		 D9 80 92 84
		 74 78 47 82
		 D7 81 83 8E
		 81 89 38 82
		 FF 90 42 B4
		 E0 C0 6B 1A
		 3B 0B 66 59
		 FB 6A C6 FD
		 29 42 95 46
		 27 38 00 00
		 CB 3E 21 48
		 AF 39 00 00
		 00 00 00 00
		 00 00 00 00
		 0B 73 95 70
		 6E 75 DC 6E
		 90 75 8B 63
		 E1 6E 59 58
		 83 74 03 62
		 6D 78 5E BA
		 1B EE 71 43
		 74 A0 71 0C
		 28 00 FF 36
		 F0 11 30 03
		 00 00 00 0C
	];
};
