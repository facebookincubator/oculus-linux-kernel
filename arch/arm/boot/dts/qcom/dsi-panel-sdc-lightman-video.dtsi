&mdss_mdp {
	dsi_dual_sdc_video: qcom,mdss_dsi_sdc_lightman_video {
		qcom,mdss-dsi-panel-name = "Dual Samsung video mode dsi panel";
		qcom,mdss-dsi-panel-type = "dsi_video_mode";

		// orientation, resolution
		qcom,mdss-dsi-panel-orientation = "180";
		qcom,mdss-dsi-panel-width = <1440>;
		qcom,mdss-dsi-panel-height = <1600>;

		// physical dimensions
		// note: physical width counts *both* screens
		qcom,mdss-pan-physical-width-dimension = <118>;
		qcom,mdss-pan-physical-height-dimension = <66>;

		qcom,mdss-dsi-panel-hdr-enabled;
		// Chromaticities from 4 Mar. 2019 factory data query (56374 panels)
		// Scale by 1 / 50000 to get x & y coordinates
		qcom,mdss-dsi-panel-hdr-color-primaries = <
			14785 15820 // W - x: 0.2957, y: 0.3164
			33070 16890 // R - x: 0.6614, y: 0.3378
			11445 35825 // G - x: 0.2289, y: 0.7165
			7070 2135>; // B - x: 0.1414, y: 0.0427
		// Scale by 1 / 10000 to get nits
		qcom,mdss-dsi-panel-peak-brightness = <1000000>;
		qcom,mdss-dsi-panel-blackness-level = <50>;

		// timings
		qcom,mdss-dsi-panel-framerate = <72>;
		qcom,mdss-dsi-h-front-porch = <250>;
		qcom,mdss-dsi-h-back-porch = <110>;
		qcom,mdss-dsi-h-pulse-width = <70>;
		qcom,mdss-dsi-h-sync-skew = <0>;
		qcom,mdss-dsi-v-front-porch = <10>;
		qcom,mdss-dsi-v-back-porch = <6>;
		qcom,mdss-dsi-v-pulse-width = <8>;

		// border
		qcom,mdss-dsi-h-left-border = <0>;
		qcom,mdss-dsi-h-right-border = <0>;
		qcom,mdss-dsi-v-top-border = <0>;
		qcom,mdss-dsi-v-bottom-border = <0>;
		qcom,mdss-dsi-bpp = <24>;

		// sync
		qcom,mdss-dsi-traffic-mode = "non_burst_sync_event";
		qcom,cmd-sync-wait-broadcast;
		qcom,mdss-dsi-h-sync-pulse = <0>;

		// power & reset
		qcom,mdss-dsi-bllp-eof-power-mode;
		qcom,mdss-dsi-bllp-power-mode;
		qcom,mdss-dsi-lp11-init;
		qcom,mdss-dsi-reset-sequence = <1 10>, <0 10>, <1 10>;

		// 4 lanes enabled, timings from QC spreadsheet
		qcom,mdss-dsi-lane-0-state;
		qcom,mdss-dsi-lane-1-state;
		qcom,mdss-dsi-lane-2-state;
		qcom,mdss-dsi-lane-3-state;
		qcom,mdss-dsi-panel-timings = [
			00 17 06 05 21 20 06 06 04 03 04 00
		];
		qcom,mdss-dsi-t-clk-post = <0xc>;
		qcom,mdss-dsi-t-clk-pre = <0x26>;
		qcom,mdss-dsi-dma-trigger = "trigger_sw";
		qcom,mdss-dsi-mdp-trigger = "none";

		// backlight
		qcom,mdss-dsi-bl-pmic-control-type = "bl_ctrl_none";
		qcom,mdss-dsi-bl-min-level = <1>;
		qcom,mdss-dsi-bl-max-level = <255>;

		// found in the SDC panel operating guide
		qcom,mdss-dsi-on-command = [
			/* NOP to deal with LP-mode weirdness(?) per operating guide */
			05 01 00 00 00 00 01 00
			/* Timing control */
			39 01 00 00 00 00 03 FC 5A 5A
			15 01 00 00 00 00 02 B0 2F
			15 01 00 00 00 00 02 FE 21
			39 01 00 00 00 00 03 FC A5 A5
			/* Sleep out, wait 5ms */
			05 01 00 00 05 00 01 11
			/* Timing control */
			39 01 00 00 00 00 03 FC 5A 5A
			15 01 00 00 00 00 02 B0 2F
			15 01 00 00 00 00 02 FE 21
			39 01 00 00 00 00 03 FC A5 A5
			/* DSC Mode Interface Settings */
			39 01 00 00 00 00 03 F0 5A 5A
			15 01 00 00 00 00 02 F9 00
			15 01 00 00 00 00 02 C4 07
			39 01 00 00 00 00 03 F2 41 5A
			39 01 00 00 00 00 14 C2
			00 00 D8 D8 00 80 2B 05
			08 0E 07 0B 05 0D 0A 15
			13 20 1E
			39 01 00 00 00 00 03 F0 A5 A5
			/* DSC PPS setting */
			39 01 00 00 00 00 03 F0 5A 5A
			39 01 00 00 00 00 59 E4
			11 00 00 89 30 80 06 40
			05 A0 00 10 05 A0 05 A0
			02 00 03 D0 00 20 02 33
			00 14 00 0C 06 67 02 63
			18 00 10 F0 03 0C 20 00
			06 0B 0B 33 0E 1C 2A 38
			46 54 62 69 70 77 79 7B
			7D 7E 01 02 01 00 09 40
			09 BE 19 FC 19 FA 19 F8
			1A 38 1A 78 1A B6 2A F6
			2B 34 2B 74 3B 74 6B F4
			39 01 00 00 00 00 03 F0 A5 A5
			/* DSC Enable Settings, wait 120ms */
			07 01 00 00 78 00 02 01 00
			/* Horizontal flip */
			39 01 00 00 00 00 03 F0 5A 5A
			15 01 00 00 00 00 02 CB 10
			15 01 00 00 00 00 02 F7 03
			39 01 00 00 00 00 03 F0 A5 A5
			/* Porch Adjust Settings */
			39 01 00 00 00 00 03 F0 5A 5A
			15 01 00 00 00 00 02 B0 06
			39 01 00 00 00 00 03 F2 10 08
			15 01 00 00 00 00 02 B0 0E
			15 01 00 00 00 00 02 CB 08
			15 01 00 00 00 00 02 B0 17
			15 01 00 00 00 00 02 CB 14
			15 01 00 00 00 00 02 F7 03
			39 01 00 00 00 00 03 F0 A5 A5
			/* Brightness Control: 100nit */
			15 01 00 00 00 00 02 53 20
			15 01 00 00 00 00 02 51 FF
			/* TE Signal Enable for Vsync */
			39 01 00 00 00 00 03 44 00 00
			15 01 00 00 00 00 02 35 00
			/* Memory Settings */
			39 01 00 00 00 00 05 2A 00 00 05 9F
			/* Set display on, wait 5ms */
			05 01 00 00 05 00 01 29
		];
		qcom,mdss-dsi-off-command = [
			/* set display off */
			05 01 00 00 00 00 02 28 00
			/* enter sleep mode */
			05 01 00 00 78 00 02 10 00
		];

		// before video is on, the DSI panels typically
		// accept either hs or lp, but lp is prefered.
		qcom,mdss-dsi-on-command-state = "dsi_lp_mode";
		// once video is on, the DSI panels typically
		// only accept hs mode commands
		qcom,mdss-dsi-off-command-state = "dsi_hs_mode";
		qcom,compression-mode = "dsc";

		qcom,config-select = <&dsi_dual_samsung_video_config0>;
		dsi_dual_samsung_video_config0: config0 {
			qcom,mdss-dsc-encoders = <1>;
			qcom,mdss-dsc-slice-height = <16>;
			qcom,mdss-dsc-slice-width = <1440>;
			qcom,mdss-dsc-slice-per-pkt = <1>;
			qcom,mdss-dsc-bit-per-component = <8>;
			qcom,mdss-dsc-bit-per-pixel = <8>;
			qcom,mdss-dsc-block-prediction-enable;
			qcom,split-mode = "dualctl-split";
		};
		dsi_dual_samsung_video_config1: config1 {
			qcom,split-mode = "pingpong-split";
		};
	};
};
