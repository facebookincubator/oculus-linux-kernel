/* Copyright (c) 2015, The Linux Foundation. All rights reserved.
 *
 * This program is free software; you can redistribute it and/or modify
 * it under the terms of the GNU General Public License version 2 and
 * only version 2 as published by the Free Software Foundation.
 *
 * This program is distributed in the hope that it will be useful,
 * but WITHOUT ANY WARRANTY; without even the implied warranty of
 * MERCHANTABILITY or FITNESS FOR A PARTICULAR PURPOSE.  See the
 * GNU General Public License for more details.
 */

qcom,itech-3004mah {
	/* #Itech_B00761LF_3004mAh_averaged_MasterSlave_Feb27th2015*/
	qcom,max-voltage-uv = <4160000>;
	qcom,v-cutoff-uv = <3100000>;
	qcom,chg-term-ua = <100000>;
	qcom,nom-batt-capacity-mah = <3000>;
	qcom,batt-id-kohm = <180>;
	qcom,battery-beta = <3435>;
	qcom,thermal-coefficients = [bd 86 b6 50 cb 37];//3450, 86bd 50b6 37cb
	qcom,battery-type = "itech_3004mah";
	qcom,chg-rslow-comp-c1 = <2920156>;
	qcom,chg-rslow-comp-c2 = <3173601>;
	qcom,chg-rs-to-rslow = <1570163>;
	qcom,chg-rslow-comp-thr = <0x99>;
	qcom,checksum = <0x942A>;
	qcom,gui-version = "PMI8996GUI - 1.1.0.4";
	qcom,fg-profile-data = [
		 25 9C 6D A8
		 10 AD C1 9B
		 70 82 B9 7A
		 37 7E 31 73
		 54 82 35 80
		 91 75 12 8A
		 BA 0E 5A 97
		 01 A8 8E AC
		 F3 9A BB 82
		 42 78 EA 74
		 8E 6B 42 82
		 1C 92 E1 B5
		 50 C8 C0 0E
		 2E 0C F7 58
		 FB 6A 50 FD
		 6B 38 85 35
		 3E 35 00 00
		 47 3D F1 31
		 8E 3A 00 00
		 00 00 00 00
		 00 00 00 00
		 CF 72 50 70
		 47 74 67 54
		 11 75 12 62
		 25 6F 7F 5B
		 8E 6F BA 59
		 2A 5E 74 93
		 41 29 69 02
		 6C A0 71 0C
		 28 00 FF 36
		 F0 11 30 03
		 00 00 00 0C
	];
};
