## arch/arm64/configs/vendor/meta_userdebug_defconfig
```kconfig
CONFIG_DYNAMIC_DEBUG=y
CONFIG_SERIAL_MSM_GENI_CONSOLE=y
CONFIG_XFRM_STATISTICS=y
CONFIG_IKHEADERS=y
CONFIG_INTERCONNECT_TEST=m
CONFIG_IPC_LOGGING=y
CONFIG_IPC_LOG_MINIDUMP_BUFFERS=16
CONFIG_IP_ROUTE_VERBOSE=y
CONFIG_IP_PNP=y
CONFIG_IP_PNP_DHCP=y
CONFIG_SLUB_DEBUG=y
CONFIG_SYN_COOKIES=y
CONFIG_BATTERY_CAPACITY_EMULATION=y
CONFIG_NF_CONNTRACK_SECMARK=y
CONFIG_NF_CONNTRACK_AMANDA=y
CONFIG_NF_CONNTRACK_FTP=y
CONFIG_NF_CONNTRACK_H323=y
CONFIG_NF_CONNTRACK_IRC=y
CONFIG_NF_CONNTRACK_NETBIOS_NS=y
CONFIG_NF_CONNTRACK_PPTP=y
CONFIG_NF_CONNTRACK_SANE=y
CONFIG_NF_CONNTRACK_TFTP=y
CONFIG_NETFILTER_XT_TARGET_CLASSIFY=y
CONFIG_NETFILTER_XT_TARGET_CONNSECMARK=y
CONFIG_NETFILTER_XT_TARGET_HARDIDLETIMER=y
CONFIG_NETFILTER_XT_TARGET_LOG=y
CONFIG_NETFILTER_XT_TARGET_NFQUEUE=y
CONFIG_NETFILTER_XT_TARGET_NOTRACK=y
CONFIG_NETFILTER_XT_TARGET_TEE=y
CONFIG_NETFILTER_XT_TARGET_TPROXY=y
CONFIG_NETFILTER_XT_TARGET_TRACE=y
CONFIG_NETFILTER_XT_TARGET_SECMARK=y
CONFIG_NETFILTER_XT_TARGET_TCPMSS=y
CONFIG_NETFILTER_XT_MATCH_COMMENT=y
CONFIG_NETFILTER_XT_MATCH_CONNLIMIT=y
CONFIG_NETFILTER_XT_MATCH_CONNTRACK=y
CONFIG_NETFILTER_XT_MATCH_DSCP=y
CONFIG_NETFILTER_XT_MATCH_ESP=y
CONFIG_NETFILTER_XT_MATCH_HASHLIMIT=y
CONFIG_NETFILTER_XT_MATCH_HELPER=y
CONFIG_NETFILTER_XT_MATCH_IPRANGE=y
CONFIG_NETFILTER_XT_MATCH_LENGTH=y
CONFIG_NETFILTER_XT_MATCH_LIMIT=y
CONFIG_NETFILTER_XT_MATCH_MAC=y
CONFIG_NETFILTER_XT_MATCH_MULTIPORT=y
CONFIG_NETFILTER_XT_MATCH_OWNER=y
CONFIG_NETFILTER_XT_MATCH_PKTTYPE=y
CONFIG_NETFILTER_XT_MATCH_QUOTA2_LOG=y
# CONFIG_NETFILTER_XT_MATCH_SCTP is not set
CONFIG_NETFILTER_XT_MATCH_SOCKET=y
CONFIG_NETFILTER_XT_MATCH_STATISTIC=y
CONFIG_NETFILTER_XT_MATCH_STRING=y
CONFIG_NETFILTER_XT_MATCH_TIME=y
CONFIG_IP_NF_MATCH_AH=y
CONFIG_IP_NF_MATCH_ECN=y
CONFIG_IP_NF_MATCH_RPFILTER=y
CONFIG_IP_NF_MATCH_TTL=y
CONFIG_IP_NF_NAT=y
CONFIG_IP_NF_TARGET_MASQUERADE=y
CONFIG_IP_NF_TARGET_NETMAP=y
CONFIG_IP_NF_TARGET_REDIRECT=y
CONFIG_IP_NF_ARPTABLES=y
CONFIG_IP_NF_ARPFILTER=y
CONFIG_IP_NF_ARP_MANGLE=y
CONFIG_IP6_NF_MATCH_RPFILTER=y
CONFIG_BRIDGE_NF_EBTABLES=y
CONFIG_BRIDGE_EBT_BROUTE=y
CONFIG_IP_SCTP=y
CONFIG_L2TP_V3=y
CONFIG_L2TP_IP=y
CONFIG_L2TP_ETH=y
CONFIG_BRIDGE=y
CONFIG_NET_SCH_PRIO=y
CONFIG_NET_SCH_MULTIQ=y
CONFIG_NET_SCH_NETEM=y
CONFIG_NET_CLS_FW=y
CONFIG_CLS_U32_MARK=y
CONFIG_STM=m
CONFIG_STM_PROTO_BASIC=m
CONFIG_STM_PROTO_SYS_T=m
CONFIG_STM_PROTO_OST=m
CONFIG_STM_SOURCE_CONSOLE=m
CONFIG_STM_SOURCE_FTRACE=m
CONFIG_CORESIGHT=m
CONFIG_CORESIGHT_CSR=m
CONFIG_CORESIGHT_CTI=m
CONFIG_CORESIGHT_DUMMY=m
CONFIG_CORESIGHT_LINKS_AND_SINKS=m
CONFIG_CORESIGHT_LINK_AND_SINK_TMC=m
CONFIG_CORESIGHT_SOURCE_ETM4X=m
CONFIG_CORESIGHT_REMOTE_ETM=m
CONFIG_CORESIGHT_REMOTE_ETM_DEFAULT_ENABLE=0
CONFIG_CORESIGHT_STM=m
CONFIG_CORESIGHT_TGU=m
CONFIG_CORESIGHT_TPDA=m
CONFIG_CORESIGHT_TPDM=m
CONFIG_MINIDUMP_MAX_ENTRIES=200
CONFIG_NET_CLS_FLOW=y
CONFIG_NET_EMATCH=y
CONFIG_NET_EMATCH_CMP=y
CONFIG_NET_EMATCH_NBYTE=y
CONFIG_NET_EMATCH_U32=y
CONFIG_NET_EMATCH_META=y
CONFIG_NET_EMATCH_TEXT=y
CONFIG_NET_ACT_GACT=y
CONFIG_NET_ACT_MIRRED=y
CONFIG_NET_ACT_SKBEDIT=y
CONFIG_REGMAP_DEBUG=y
CONFIG_REGMAP_ALLOW_WRITE_DEBUGFS=y
CONFIG_REGMAP_QTI_DEBUGFS=m
CONFIG_REGMAP_QTI_DEBUGFS_ALLOW_WRITE=y
CONFIG_QCOM_MINIDUMP_FTRACE=y
CONFIG_QTI_TZ_LOG=m
CONFIG_USB_QCOM_EMU_PHY=m
CONFIG_POWER_STATE_VIRTUAL_SENSOR=y
CONFIG_META_OOM_KILL_STATS=y
CONFIG_QCOM_EUD=m
CONFIG_SERIAL_MSM_GENI_CONSOLE=m
CONFIG_SERIAL_MSM_GENI_EARLY_CONSOLE=y
CONFIG_THERMAL_EMULATION=y
CONFIG_OCULUS_SWD_DEBUG=y
CONFIG_CLOCK_ALLOW_WRITE_DEBUGFS=y
CONFIG_QCOM_BWPROF=m
CONFIG_QCOM_MEMORY_DUMP_V2=m
CONFIG_FTRACE_SYSCALLS=y
CONFIG_FUNCTION_TRACER=y
CONFIG_FUNCTION_GRAPH_TRACER=y
CONFIG_DYNAMIC_FTRACE=y
CONFIG_QTI_SYS_PM_VX=m
CONFIG_META_CAMERA_SENSOR_TEMPERATURE=y
CONFIG_META_CAMERA_DEBUG_FREEZE=y
CONFIG_KPROBE_EVENTS_ON_NOTRACE=y
CONFIG_IDLE_PAGE_TRACKING=y
CONFIG_VERBOSE_ADSP_RPC_LOGGING=y
CONFIG_META_CAMERA_SENSOR_ID_SYSFS=y
```

## arch/arm64/configs/vendor/oatmeal_common_defconfig
```kconfig
# ADC modules
CONFIG_INA2XX_ADC=y
CONFIG_TI_ADS1015=y

# AR PCI support
CONFIG_ARFIRMWARE=y
CONFIG_ARFIRMWARE_COMMON=m
CONFIG_ARFIRMWARE_ACRO_PCI=m
CONFIG_ARFIRMWARE_ACRO_UART=m
CONFIG_ARFIRMWARE_ACRO_UART_TEST=m
CONFIG_ARFIRMWARE_TEST=m

# Use legacy MSM GPIO init
CONFIG_PCI_MSM_GPIO_INIT_LEGACY=y

# Graphics modules
CONFIG_DRM_MSM=m
CONFIG_SXR_DISPCC_NEO=m
CONFIG_SXR_GPUCC_NEO=m
CONFIG_QTI_DEVFREQ_CDEV=m

# LED modules
CONFIG_LEDS_AW2016=y
CONFIG_LEDS_GPIO=y
CONFIG_LEDS_LP55XX_COMMON=y
CONFIG_LEDS_LP5562=y

# Max17332
CONFIG_MAX17332_CURRENT_OVERRIDE=y
CONFIG_MAX17332_VOLTAGE_ADJUSTMENT=y
CONFIG_MAX17332_CDEV=y

# Max77789
CONFIG_MAX77789=y

# Peripheral control
CONFIG_ACROPOLIS_CTRL=m
CONFIG_DAM_CTRL=y

# SWD for flashing MCUs
CONFIG_OCULUS_MCU=y
CONFIG_OCULUS_SWD=y
CONFIG_OCULUS_SWD_STM32L4=y

# Brow temperature sensors
CONFIG_MAX31875_I2C=y

# PM8150 XO Clock
CONFIG_PM8150_XO=y

# HL7594 BUCK, which powers WCN7851 chip
CONFIG_REGULATOR_HL7594=y

# Virtual driver for USB thermal reading
CONFIG_IIO_CHANNEL_TEMP_SENSOR=y

# Enable WLAN robust recovery
CONFIG_CNSS_META_ROBUST_RECOVERY=y

# Enable WLAN channel disable via wlan.cfg
CONFIG_WLAN_META_CHAN_DISABLE=y
```

## arch/arm64/configs/vendor/oculus_userdebug_defconfig
```kconfig
CONFIG_AQM=m
CONFIG_DEBUG_FS=y
CONFIG_DETECT_HUNG_TASK=y
CONFIG_DYNAMIC_DEBUG=y
CONFIG_DYNAMIC_FTRACE=y
CONFIG_FTRACE_SYSCALLS=y
CONFIG_FUNCTION_TRACER=y
CONFIG_IKHEADERS=y
CONFIG_META_SWD_DEBUG=y
CONFIG_MSM_DEBUGCC_KONA=y
CONFIG_MSM_TZ_LOG=y
CONFIG_PANIC_ON_REFCOUNT_ERROR=y
CONFIG_PANIC_ON_RT_THROTTLING_DEFAULT_ON=y
CONFIG_PSTORE_FTRACE=y
CONFIG_QMP_DEBUGFS_CLIENT=y
CONFIG_SERIAL_MSM_GENI_CONSOLE=y
CONFIG_SLUB_DEBUG=y
CONFIG_THERMAL_EMULATION=y
CONFIG_USB_CONFIGFS_F_UVC=y
```

## drivers/staging/oculus/Documentation/devicetree/bindings/oculus,cem43-pseudo-sensor.txt
```
=================================
Oculus CEM43 Pseudo-Sensor Driver
=================================

This driver computes the cumulative CEM43 (Cumulative Equivalent Minutes at
43°C) thermal dose of a single input thermal zone and reports the accumulated
dose in 1/1000s of a minute, as a pseudo-temperature through the thermal
framework.

The driver supports projection into the future to allow sufficient time for
a shutdown before exceeding the limit.

Even though the CEM43 standard specifies accumulation with temperatures
averaged over a minute, it has been developed in the setup where temperatures
are changing slowly, with little variation within the minute. In the world of
electronics the temperatures can change fairly quickly within a minute, so the
accumulation is done in the driver over seconds, which are then converted into
CEM minutes.  The input temperatures are averaged by default over a second, but
optionally a longer rolling average can be specified, averaging over 60 seconds
would emulate the classic CEM43 but have slower reactions to overheating.

CEM43 Pseudo-Sensor Node
-------------------------

Required properties:
- compatible: Should be "oculus,cem43-pseudo-sensor".
- #thermal-sensor-cells: Required by thermal framework, should be 0.
- input-thermal-zone: String name of the input thermal zone to monitor.
  The driver will read temperature from this zone to compute the CEM43 dose.

Optional properties:
- input-scaling-factor: Integer value to multiply the input thermal zone
	reading by, to convert to millidegrees Celsius. Default is 1 if not
	specified.

- cem-horizon-minutes: Integer value specifying the CEM43 horizon in minutes.
  The driver computes the cumulative thermal dose over this time horizon.
  Default is 180 minutes if not specified. Must be positive (> 0).

- cem-target-mdeg: Integer value specifying the CEM target temperature in
	millidegrees Celsius. The default is 43000 for CEM43 calculations (43°C =
	43000 millidegrees).

- averaging-count: Integer value specifying the number of samples over
  which to average the output temperature. Uses a circular buffer to
  smooth noisy readings. Default is 10 if not specified. If set to 0 or 1,
  averaging is disabled.

- averaging-delay: Integer value specifying the delay between averaged
  samples, in milliseconds. Must be specified together with
  `averaging-count`. The associated thermal zone's polling-delay should be
  a multiple of this value. Default is 100 ms if not specified.

- projection-seconds: Integer value specifying how many seconds to project
  the current temperature forward. Since the shutdown is not immediate,
	to complete the shutdown before exceeding the CEM43 limit, the logic
	that triggers the shutdown must allow for the additional accumulation
	during the shutdown. The speed this additional accumulation depends on
	the current temperature in a major way, due to the exponential character
	of accumulation. For example, at 48°C the accumulation is accelerated
	32-fold. The CEM driver already includes the exponential computation,
	and so is the natural place to embed this logic, letting the shutdown
	trigger to work in the same simple-minded way as when based on the
	temperature. Note that the projection does not allow to take the slope into
	account, and so if the temperature continues to grow, the projection is
	optimistic. To compensate for this, leave a safety margin in the projection
	time over the expected shutdown time.  Default is 0 (no projection) if not
	specified. Must be non-negative (>= 0) if specified.

- thermal-zone-fault-estimator-bounds: Array of 2 integers representing the
  lower and upper bounds (in millidegrees Celsius) in which the input
  thermal zone is considered functional. If the input zone returns a
  reading outside this range, it is considered faulty, and the previous value
	(or 0 if no previous value was ever read) is used. This allows to
	filter out the erroneous short-term spikes in the sensors, and to ignore
	the faulty sensors.

- meta,hotpluggable: Boolean property. If present, the input thermal zone
  is considered hotpluggable and will be re-resolved by name on every
  temperature reading. This is useful for zones that may come and go
  (e.g., pluggable sensors). If not present, the zone is resolved once at
  probe time.

Example:
--------

&thermal_zones {
	cem43_sensor: cem43-sensor {
		polling-delay = <1000>;
		polling-delay-passive = <0>;
		thermal-sensors = <&cem43_pseudo_sensor>;
	};
};

cem43_pseudo_sensor: cem43-pseudo-sensor {
	compatible = "oculus,cem43-pseudo-sensor";
	#thermal-sensor-cells = <0>;

	/* Input thermal zone to monitor */
	input-thermal-zone = "skin-usr";
	input-scaling-factor = <1>;

	/* CEM43 configuration */
	cem-horizon-minutes = <180>;
	cem-target-mdeg = <43000>;
	projection-seconds = <300>;

	/* Averaging configuration */
	averaging-delay = <100>;
	averaging-count = <10>;

	/* Fault detection - mark as faulty if outside 0-127°C range */
	thermal-zone-fault-estimator-bounds = <0 127000>;
};
```
