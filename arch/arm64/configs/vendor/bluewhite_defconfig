## arch/arm64/configs/vendor/bluewhite_defconfig
```kconfig
CONFIG_META_BLUEWHITE=y
CONFIG_META_GREATWHITE=y
CONFIG_I2C_MSM_GENI=y
CONFIG_MSM_GPI_DMA=y
CONFIG_MSM_GENI_SE=y
CONFIG_DRM_MSM=m
CONFIG_MAX31875_I2C=y
CONFIG_REGULATOR_MAX77655=y
CONFIG_RAA491901_I2C=y
CONFIG_SXR_DISPCC_NEO=m
CONFIG_SXR_GPUCC_NEO=m
CONFIG_QTI_DEVFREQ_CDEV=m
CONFIG_HYPEROFF=y
CONFIG_TMP114_I2C=y
CONFIG_MPM_SLEEP_CLOCK=y
# CONFIG_KSM is not set
CONFIG_SPI_STP_INTERFACE=m
CONFIG_SPI_STP_I2C=m
CONFIG_METABATTERY=m
CONFIG_ARCH_HIBERNATION_HEADER=y
CONFIG_QCOM_S2D_VENDOR_HOOK=m
CONFIG_QCOM_SECURE_HIBERNATION=m
CONFIG_QCOM_HIB_KERNEL_BASED=y
CONFIG_QCOM_KERNEL_SEC_KEY=y
CONFIG_HIBERNATION_COMP_LZ4=y
CONFIG_PM_STD_PARTITION=""
CONFIG_QCOM_KGSL_HIBERNATION=y
CONFIG_HIBERNATE_CALLBACKS=y
CONFIG_HIBERNATION_SNAPSHOT_DEV=y
CONFIG_HIBERNATION=y
CONFIG_JBD4020_I2C=y
CONFIG_METASOC=y
CONFIG_LRU_GEN_ENABLED=y
CONFIG_REGULATOR_DA9172=y
```

## arch/arm64/configs/vendor/florian_defconfig
```kconfig
CONFIG_META_FLORIAN=y
CONFIG_REGULATOR_HL7594=y
CONFIG_REGULATOR_PM3003A=y
CONFIG_SPI_STP_INTERFACE=m
CONFIG_SPI_STP_I2C=m
CONFIG_METABATTERY=m
CONFIG_METASOC=y
CONFIG_CNSS_META_BOARD_ID_OVERRIDE=y
CONFIG_MCU_THERMISTOR=m
CONFIG_ST60_CTRL=m
# Use legacy MSM GPIO init
CONFIG_PCI_MSM_GPIO_INIT_LEGACY=y
```

## arch/arm64/configs/vendor/greatwhite_defconfig
```kconfig
CONFIG_META_GREATWHITE=y
CONFIG_MEMCG=y
CONFIG_MEMCG_SWAP=y
CONFIG_I2C_MSM_GENI=y
CONFIG_MSM_GPI_DMA=y
CONFIG_MSM_GENI_SE=y
CONFIG_DRM_MSM=m
CONFIG_MAX31875_I2C=y
CONFIG_REGULATOR_MAX77655=y
CONFIG_RAA491901_I2C=y
CONFIG_SXR_DISPCC_NEO=m
CONFIG_SXR_GPUCC_NEO=m
CONFIG_QTI_DEVFREQ_CDEV=m
CONFIG_HYPEROFF=y
CONFIG_TMP114_I2C=y
CONFIG_MPM_SLEEP_CLOCK=y
# CONFIG_KSM is not set
CONFIG_SPI_STP_INTERFACE=m
CONFIG_SPI_STP_I2C=m
CONFIG_METABATTERY=m
CONFIG_JBD4020_I2C=y
CONFIG_METASOC=y
CONFIG_LRU_GEN_ENABLED=y
CONFIG_REGULATOR_DA9172=y
CONFIG_MCU_THERMISTOR=m
```

## arch/arm64/configs/vendor/hfd_defconfig
```kconfig
CONFIG_META_HFD=y
CONFIG_DRM_MSM=m
CONFIG_SXR_DISPCC_NEO=m
CONFIG_SXR_GPUCC_NEO=m
CONFIG_QTI_DEVFREQ_CDEV=m
CONFIG_ARFIRMWARE=y
CONFIG_ARFIRMWARE_COMMON=m
CONFIG_ARFIRMWARE_AVO_PCI=m
```

## arch/arm64/configs/vendor/meg2_defconfig
```kconfig
CONFIG_META_MEG2=y
CONFIG_DRM_MSM=m
CONFIG_SXR_DISPCC_NEO=m
CONFIG_SXR_GPUCC_NEO=m
CONFIG_QTI_DEVFREQ_CDEV=m
CONFIG_ARFIRMWARE=y
CONFIG_ARFIRMWARE_COMMON=m
CONFIG_ARFIRMWARE_COLEMAN_PCI_TEST=m
CONFIG_ARFIRMWARE_COLEMAN_PCI=m
CONFIG_ARFIRMWARE_AVO_PCI=m
CONFIG_GFX_KMD=m
CONFIG_PCI_TUNNEL=m
CONFIG_I3C=y
CONFIG_I3C_MASTER_MSM_GENI=m
CONFIG_LEDS_LP5562=m
CONFIG_LEDS_LP55XX_COMMON=m
CONFIG_REGULATOR_MAX77675=m
CONFIG_SLG5B47231=m
CONFIG_AR_AP2ARP_TSYNC=y
CONFIG_QCA_CLD_WLAN=m

# Meta Adaptive Memory KMD feature
CONFIG_QCOM_LLCC=m
CONFIG_AMEM_KMD=m
```
