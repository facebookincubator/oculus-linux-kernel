## drivers/staging/oculus/arfw/Kconfig
```kconfig
config ARFIRMWARE
    tristate "AR firmware driver support"
    default n

config ARFIRMWARE_COMMON
    tristate "AR firmware common driver support"
    depends on ARFIRMWARE

config ARFIRMWARE_LOOPBACK
    tristate "AR firmware Loopback driver support"
    depends on ARFIRMWARE_COMMON
    default m

config ARFIRMWARE_COLEMAN_PCI
    tristate "AR firmware IPC Coleman PCI driver"
    depends on ARFIRMWARE_COMMON
    depends on PCI
    default n

config ARFIRMWARE_JAZZ_PCI
    tristate "AR firmware IPC Jazz PCI driver"
    depends on ARFIRMWARE_COMMON
    depends on PCI
    default n

config ARFIRMWARE_JAZZ_USB_HOST
    tristate "AR firmware Jazz USB host driver support (experimental)"
    depends on ARFIRMWARE_COMMON
    depends on USB
    default n

config ARFIRMWARE_COLEMAN_PCI_TEST
    tristate "AR firmware test IPC Coleman PCI driver"
    depends on ARFIRMWARE_COMMON
    depends on PCI
    default n

config ARFIRMWARE_ACRO_PCI
    tristate "AR firmware ACROPOLIS PCI driver support"
    depends on ARFIRMWARE_COMMON
    depends on PCI
    default n

config ARFIRMWARE_AVO_PCI
    tristate "AR firmware AVOGADRO PCI driver support"
    depends on ARFIRMWARE_COMMON
    depends on PCI

config ARFIRMWARE_ACRO_UART
    tristate "AR firmware Acropolis UART transport"
    depends on ARFIRMWARE_COMMON
    depends on TTY
    default n
    help
      Kernel transport for Janus IPC over UART to Acropolis IMCU. Registered as
      the N_ARFW tty line discipline (attached by the arfwuartattach userspace
      helper); uses super_serial (COBS+CRC32) framing.

config ARFIRMWARE_ACRO_UART_TEST
    tristate "AR firmware Acropolis UART transport unit tests"
    depends on ARFIRMWARE_ACRO_UART && KUNIT
    default n
    help
      KUnit tests for the UART transport: the super_serial (COBS+CRC32) framing
      codec and the transport-agnostic engine (header translation, TX/RX bounds
      checks, RX frame routing, queue-slot reuse). Builds as a loadable module;
      test results appear in the kernel log when the module is loaded.
```

## drivers/staging/oculus/da9172/Kconfig
```kconfig
if REGULATOR_DA9172

config DA9172_PWRSEQ_DEBUG
	bool "DA9172 power sequencer debug sysfs"
	default n
	help
	  Expose read-only pwrseq and read-write vneg{1,2,3}_vout sysfs nodes
	  for debugging DA9172 power sequencer timing and VNEG rail voltages.
	  Only enable on bring-up builds; disable once the OTP profile is final.

config DA9172_VNEG_VOUT_DT_OVERRIDE
	bool "DA9172 VNEG VOUT override from device tree"
	default n
	help
	  Apply VNEG output voltage overrides from device tree properties at probe.
	  Reads meta,vneg{1,2,3}-vout-microvolt and programs the rails before
	  userspace starts. Only enable on bring-up builds; disable once the OTP profile
	  is final.

endif
```

## drivers/staging/oculus/langdon/Kconfig
```kconfig
config PCI_LANGDON_FPGA_MISC
	tristate "Langdon FPGA DMA driver"
	default n
	help
		This driver adds DMA support for the Langdon FPGA board
```

## drivers/staging/oculus/mcu/Kconfig
```kconfig
menuconfig OCULUS_MCU
	bool "Oculus MCU drivers"
	default y
	help
	  Enable support for Oculus MCU drivers and features

if OCULUS_MCU

config OCULUS_SWD
	bool "Oculus MCU SWD Driver"
	help
	  Oculus SWD Driver

config OCULUS_SWD_DEBUG
	bool "Oculus MCU SWD Debug support"
	depends on DEBUG_FS && OCULUS_SWD
	default n
	help
	  Oculus SWD Debug support

config OCULUS_SWD_STM32L4
	bool "STM32L4 SWD Driver"
	select OCULUS_SWD
	default n
	help
	  Oculus STM32L4 SWD Support

config OCULUS_SWD_USE_FW_FALLBACK
	bool "Use fw fallback mechanism"
	default n
	help
	  Oculus SWD will use fw fallback mechanism

endif # OCULUS_MCU
```

## init/Kconfig.meta
```kconfig
# SPDX-License-Identifier: GPL-2.0-only
config META_WAKE_AFFINE
	bool "Allows tasks to wake affine inside a cpuset."
	select CPUSETS
```

## techpack/camera/Kconfig
```kconfig
config SPECTRA_ISP
	bool "enable camera ISP module"
	help
	  This is enabling camera ISP module.
	  IFE camera driver file be included.
	  This will enable camera ISP driver to handle IFE driver.
	  Core camera driver to handle VFE HW.

config SPECTRA_ICP
	bool "enable camera ICP module"
	help
	  This is enabling camera ICP module.
	  Camera ICP driver file be included.
	  This will enable camera ICP driver to interact with,
	  ICP FW. Which can control IPE and BPS HW.

config SPECTRA_JPEG
	bool "enable camera jpeg module"
	help
	  This is enabling camera JPEG module.
	  camera jpeg module will be functional.
	  This module interact with jpeg HW for
	  snapshot processing.

config SPECTRA_SENSOR
	bool "enable camera sensor module"
	help
	  This is enabling camera sensor module.
	  sensor module files will be included to enable the driver.
	  eeprom, flash, csiphy all other module will be included
	  to make the sensor functional.

config INTERCONNECT_QCOM
	bool "enabling icc bus driver"
	help
      This is to access icc driver api.
      To cache AB and IB vote will
      use ICC kernel driver API.
      So that ICC driver can consolidate the vote

config SPECTRA_FD
    bool "enabling camera fd module"
    help
      This is enabling camera FD module.

config CAM_PRESIL
    bool "enabling camera presil module"
    help
      This is enabling camera presil module.

config QCOM_CX_IPEAK
    bool "enabling camera ipeak module"
    help
      This is enabling camera ipeak module.

config QCOM_BUS_SCALING
    bool "enabling camera bus scaling module"
    help
      This is enabling camera bus scaling module.

config SPECTRA_LRME
    bool "enabling camera lrme module"
    help
      This is enabling camera lrme module.

config SPECTRA_CUSTOM
    bool "enabling camera custom module"
    help
      This is enabling camera custom module.

config SPECTRA_OPE
    bool "enabling camera ope module"
    help
      This is enabling camera ope module.

config SPECTRA_CRE
    bool "enabling camera cre module"
    help
      This is enabling camera cre module.

config SPECTRA_TFE
    bool "enabling camera tfe module"
    help
      This is enabling camera tfe module.

config MSM_GLOBAL_SYNX
	bool "enable HW synx"
	help
	  This is enabling HW syx feature.
	  synx hw signaling external to camera,
	  like EVA and other.
	  This is to avoid sw signaling latency.
```

## techpack/camera/neo-la_defconfig
```kconfig
CONFIG_SPECTRA_ISP=y
CONFIG_SPECTRA_ICP=y
CONFIG_SPECTRA_JPEG=y
CONFIG_SPECTRA_SENSOR=y
CONFIG_INTERCONNECT_QCOM=y
CONFIG_MSM_GLOBAL_SYNX=y
```
