## drivers/staging/oculus/Kconfig
```kconfig
menuconfig OCULUS
	bool "Oculus feature support"
	default y
	help
	  Enable support for Oculus drivers and features

if OCULUS

config CAM_FSYNC
	bool "Oculus Camera FSYNC Timestamp driver"
	depends on OCULUS
	default n
	help
	    Enable Camera FSYNC Timestamp driver

config GENERIC_VIRTUAL_SENSOR
	tristate "Generic Virtual Sensor Driver"
	default n
	help
	  This driver implements a generic virtual sensor driver which
	  can be configured through userspace.

config GPIO_LOWVOLT_DETECT
	tristate "Low voltage GPIO interrupt handler driver"
	default n
	help
		This driver handles H/W interrupt that gets triggered when voltage droop
		which might cause brown-out is detected. S/W can reduce system power
		to avoid this interrupt. This driver handles this interrupt and will report
		to user mode to take appropriate action.

config INSTRUCTION_SAMPLER
	tristate "Periodic instruction sampler"
	depends on EVENT_TRACING && CONTEXT_SWITCH_TRACER && ARM64
	help
	  Provides support for periodic instruction sampling of processes
	  running on the system.

config LEDS_AW2026
	tristate "LED Support for AW2026"
	default n
	depends on LEDS_CLASS && I2C
	help
		This option enables support for the AW2026 LED connected through I2C.
		This driver enables automatic breathing and also allows flexible patterns to
		be configured. It allows multiple patterns to be run successively or
		cyclically.

config MAX17332
	tristate "Maxim Integrated MAX17332 Fuel Gauge"
	depends on I2C
	select REGMAP_IRQ
	help
	  Say yes here to add support for Maxim Integrated MAX17332.
	  MAX17332 is a multifunction device with battery and charger
	  functionality included. The IC supports Non-Volatile
	  programming and precision current, voltage and other measurements
	  without calibration.

config BATTERY_CAPACITY_EMULATION
	bool "Battery capacity emulation mode support"
	default n
	help
	  Enable this option to make a emul_batt_capacity sysfs node in
	  max17332-battery/metabattery directory to support battery capacity emulation.

config MAX17332_CURRENT_OVERRIDE
	bool "MAX17332 current override logic"
	default n
	depends on MAX17332
	help
	  Say yes here to add support for MAX17332 current override logic.
	  For Oatmeal, we added charging control logic which is not suitable
	  for other products. So split them from the main logic and make it
	  configurable.

config MAX17332_VOLTAGE_ADJUSTMENT
	bool "MAX17332 voltage adjustment logic"
	default n
	depends on MAX17332
	help
	  Say yes here to add support for MAX17332 voltage adjustment logic.
	  For Oatmeal, we added charging voltage adjustment logic which is
	  not suitable for other products. So split them from the main logic
	  and make it configurable.

config MAX17332_CDEV
	bool "MAX17332 thermal cooling device"
	default n
	depends on MAX17332 && THERMAL
	help
	  Say yes here to register the MAX17332 charger as a thermal cooling
	  device. This allows the thermal framework to disable charging
	  when the device temperature exceeds configured thresholds.

config MAX77789
	tristate "Maxim Integrated MAX77789 Charger IC"
	default n
	depends on I2C
	help
	  Enable support for Maxim Integrated MAX77789.

config META_HAMMERHEAD
	bool "Enable support for hammerhead device"
	default n
	select ARCH_NEO
	help
	  Enable support for hammerhead device

config META_FLORIAN
	bool "Enable support for florian device"
	default n
	select ARCH_NEO
	help
	  Enable support for florian device

config META_GREATWHITE
	bool "Enable support for greatwhite device"
	default n
	select ARCH_NEO
	help
	  Enable support for greatwhite device

config META_OATMEAL
	bool "Enable support for oatmeal device"
	default n
	select ARCH_NEO
	help
	  Enable support for oatmeal device

config META_OOM_KILL_STATS
	bool "Log Kernel OOM Kill events"
	default n
	select ARCH_NEO
	help
	  Enable this option to log Kernel OOM Kill events


config DSP_PD_KILL
	tristate "Meta DSP per-user-PD kill/restart debugfs hooks"
	depends on DEBUG_FS
	help
	  Expose write-only debugfs files under
	  /sys/kernel/debug/dsp_pd_kill/ that trigger a SERVREG-based
	  restart of a single DSP user PD via pdr_restart_pd(), leaving
	  the root PD and the other user PDs running. Used for
	  development and stress-testing of the per-PD recovery path on
	  userdebug/eng builds.

	  To compile the driver as a module, choose M here: the module
	  will be called dsp_pd_kill.ko

config META_USB_CONN_GPIO
	tristate "Meta implementation of USB GPIO connection interface"
	depends on GPIOLIB
	select USB_ROLE_SWITCH
	select POWER_SUPPLY
	help
	  The driver supports USB role switch between host and device via GPIO
	  based USB cable detection, used typically if an input GPIO is used
	  to detect USB ID pin, and another input GPIO may be also used to detect
	  Vbus pin at the same time, it also can be used to enable/disable
	  device if an input GPIO is only used to detect Vbus pin.

	  To compile the driver as a module, choose M here: the module will
	  be called meta-usb-conn-gpio.ko

config MFI_I2C
	tristate "MFI I2C driver"
	default n
	depends on I2C
	help
	  Driver to support read from and writing to MFi devices via I2C.
		This driver is built on top of regmap subsystem and exposes read/write
		functions from kernel to user mode.
		Using MFi for authentication should be implemented in user space.

config MPM_SLEEP_CLOCK
	bool "MPM-based sleep clock for Qualcomm chipsets"
	default y
	help
	    Enable MPM sleep clock driver for Qualcomm chipsets

config POWER_STATE_VIRTUAL_SENSOR
	tristate "SN Power State Driver"
	default n
	help
	  This driver is built as a virtual sensor and plugged into the
	  thermal HAL to provide power state that will be used for
	  hammerhead power management.

config REGULATOR_MAX77813
	tristate "Maxim MAX77813 High Efficiency Buck-Boost Converter"
	depends on I2C
	help
	  This driver controls Maxim MAX77813 high efficiency buck-boost
	  converter via I2C bus. The converter VOUT is configurable.
	  The charger BOB will need to be programmed when charger source
	  becomes available. Say Y here to enable the regulator driver for
	  the converter.

config REGULATOR_PM3003A
	tristate "Qualcomm PM3003A High Efficiency Buck Converter"
	depends on I2C
	help
	  This driver controls Qualcomm pm3003a high efficiency buck
	  converter via I2C bus. The converter VOUT is configurable.

config REGULATOR_RT6160
	tristate "Richtek RT6160 High Efficiency Buck-Boost Converter"
	depends on I2C
	help
	  This driver controls Richtek RT6160 high efficiency buck-boost
	  converter via I2C bus. The converter VOUT is configurable.

config RT600_CTRL
	tristate "Oculus RT600 control driver"
	default n
	help
	    Enable RT600 control driver. This driver controls RT600 state
		for flashing and reset. RT600 state needs to be modified via
		sysfs to enable testing of different state transitions and also
		to ensure RT600 is in the correct state for flashing.

config RT600_CTRL_BOARD_ID
	bool "Expose the CDT board-id as a sysfs attribute"
	depends on RT600_CTRL
	default n
	help
	    Publish qcom,board-id from this device's firmware node as a
		read-only board_id sysfs attribute.

		Only needed where the platform describes the board in ACPI _DSD:
		ACPI properties are never published to userspace, whereas on
		devicetree the OF core already exposes the root property under
		/sys/firmware/devicetree. Leave disabled on devicetree platforms.

config SPI_STP
	tristate "STP SPI driver"
	depends on SPI && EVENT_TRACING
	default n
	help
	  Enable STP SPI driver for data transfer between SoC (master) and slave.
	  This driver implements the STP protocol on top of the SPI bus,
	  to facilitate communication between MCU and SoC. Driver supports up to 32
	  pre-configured STP channels. Each STP channel is exposed as a dedicated
	  character device, interfaceable through syscalls

config SPI_STP_INTERFACE
	tristate "STP communication interface with the kernel"
	depends on SPI_STP
	help
	  Enable communicating with STP in the kernel.

config SPI_STP_I2C
	tristate "I2C Bus over STP driver"
	depends on SPI_STP_INTERFACE
	help
	  Enable I2C bus driver over STP.

config ST60_CTRL
	tristate "Meta ST60 control driver"
	default n
	help
	  Enable ST60 control driver.

config METABATTERY
	tristate "Kernel Battery Driver"
	depends on SPI_STP_INTERFACE
	help
	  Enable battery interface.

config VENDOR_DT_OUTPUT_DISABLE
	bool "Disable building of device trees for test platforms"
	default y
	help
	  Building Qualcomm kernels with default flags causes serveral unrelated
	  device-trees to be built by default. Don't build them when
	  VENDOR_DT_OUTPUT_DISABLE is set since we don't need any of these on Meta
	  platforms.

config VIRTUAL_SENSOR_UTILS
	tristate "Virtual Sensor Utilities"
	default n
	help
	  This driver implements virtual thermal sensor helper functionality.

config METASOC
	tristate "Meta state of charge implementation"
	default n
	help
	  Enable generation of metasoc in max17332 battery driver

config PCI_MSM_GPIO_INIT_LEGACY
    depends on PCI_MSM
    bool "Use legacy GPIO initialization"

config MCU_THERMISTOR
	tristate "Kernel MCU Thermistor Driver"
	depends on SPI_STP_INTERFACE
	help
	  Enable mcu thermistor interface.

config ACROPOLIS_CTRL
	tristate "Acropolis control driver"
	default n
	help
	  Say yes here to add support for starting up Acropolis and setting up its
	  control signals on the Oatmeal platform.

config AMEM_KMD
	tristate "Enable support for Adaptive Memory Driver"
	imply QCOM_LLCC
	default n
	help
	  Enable Adaptive Memory Driver. This feature is the kernel
	  component that implements the Adaptive Memory allocator feature.

config BBC_CTRL
	tristate "BBC Control Driver"
	default n
	help
	  Say yes here to add support for setting the BBC control signals on
	  the Oatmeal platform.

config DAM_CTRL
	tristate "DAM control driver"
	default n
	help
	  Say yes here to add support for setting the DAM control signals on
	  the Oatmeal platform.

config HYPEROFF
  tristate "Hyperoff driver"
	depends on SPI
	default n
	help
		Enable Hyperoff driver for communication with SoC and Hyperoff.

config IIO_CHANNEL_TEMP_SENSOR
	tristate "IIO Channel Temp Sensor Driver"
	default n
	help
	  Say yes here to add support for reading adc voltage and calculating
	  usb temperature.

config JBD4020_I2C
        tristate "JBD4020 I2C driver"
        default n
        depends on OF
        select DRM_PANEL_BRIDGE
        select DRM_KMS_HELPER
        select DRM_MIPI_DSI
        select REGMAP_I2C
        help
          Driver to support read from and writing to JBD4020 device via I2C.
          Exposes functions to initialize JBD4020 and read/write to device in user space.

config MAX31875_I2C
	tristate "Maxim Integrated MAX31875 Temperature Sensor"
	default n
	depends on I2C
	help
	  Enable support for Maxim Integrated MAX31875.

config METABATTERY
	tristate "MetaBattery driver"
	default n
	help
		Provides an interface to interact with the battery IC on another device.

config NETINFO
        tristate "Netinfo Driver"
        default n
        help
          Enable netinfo driver

config PM8150_XO
	tristate "PM8150 XO Clock Driver"
	default n
	depends on SPMI
	help
	  Say Y here to enable the PM8150 XO Clock Driver driver. This driver is
	  responsible for PM8150 XO Clock, it adjusts cap between XTAL1_IN_PAD
	  and XTAL1_OUT_PAD.

config RAA491901_I2C
	tristate "RGB Buck-Boost Four-Channel LED Driver"
	default n
	depends on I2C
	help
	  Enable support for Renesas RAA491901.

config REGULATOR_HL7594
	tristate "HL7594 Buck Converter Driver"
	default n
	depends on I2C
	select REGMAP_I2C
	help
	  This driver controls HL7594 Buck converter via I2C bus and
	  configures the PWM mode through I2C. Say Y here to enable
	  the HL7594 Buck Converter Driver.

config REGULATOR_KTB8399
	tristate "Kinetic KTB8399 External Buck-Boost Converter"
	default n
	depends on I2C
	help
	  This driver controls Kinetic KTB8399 external buck via I2C bus.
	  The converter VOUT is configurable. Its input voltage range is
	  2.5 V to 5.5 V. Its output voltage range is 0.6 V to 1.394 V in
	  6.25 mV steps, programmed through an I2C interface. Say Y here
	  to enable the regulator driver for the converter.

config REGULATOR_MAX77655
	tristate "MAX77655 PMIC for LCOS display"
	default n
	depends on I2C
	help
	  Regulator driver to support MAX77655 PMIC enable and disable via I2C and GPIO.

config REGULATOR_MP28167
	tristate "MPS MP28167 High Efficiency Buck-Boost Converter"
	depends on I2C
	help
	  This driver controls MP28167 high efficiency buck-boost.

config REGULATOR_DA9172
  tristate "DA9172 PMIC Driver"
  default n
  depends on I2C
  help
    Regulator driver to support DA9172 PMIC enable and disable via I2C and GPIO.

config STUSB4500_USB
	tristate "STUSB4500 USB Controller Driver"
	default n
	depends on I2C
	help
	  Say Y here to enable the STUSB4500 USB controller driver. This driver is
	  responsible for USB PD negotiation and CC detection. It also supports the
	  STUSB4500L chip variant that only does CC detection.

config TMP114_I2C
	tristate "Texas Instruments TMP114 Temperature Sensor"
	default n
	depends on I2C
	help
	  Enable support for Texas Instruments TMP114.

config TPS61280
	tristate "TPS61280 boost driver"
	default n
	help
	  Enable support for TI TPS61280

source "drivers/staging/oculus/arfw/Kconfig"
source "drivers/staging/oculus/da9172/Kconfig"
source "drivers/staging/oculus/mcu/Kconfig"

endif # OCULUS
```

## drivers/staging/oculus/Kconfig.test
```kconfig
config HZOS_EXT_GPU_FREQ_KUNIT_TEST
	tristate "KUnit tests for hzos_ext gpu.freq parse helper" if !KUNIT_ALL_TESTS
	depends on KUNIT && CGROUP_GPU
	default KUNIT_STAGING_OCULUS
	help
	  Unit tests for the self-contained gpu_freq_parse_khz() helper in
	  hzos_ext/hzos_ext_gpu_freq.h.  The test includes only the header and
	  requires CONFIG_CGROUP_GPU for the gpu_cgroup.h definitions.

config KUNIT_STAGING_OCULUS
	tristate "Enable all KUnit tests for Oculus staging drivers"
	depends on KUNIT
	select DMABUF_REORDER_KUNIT_TEST if DMABUF_REORDER
	select MISCFIFO_KUNIT_TEST if MISCFIFO
	select META_SWD_FWUPDATE_KUNIT_TEST if META_SWD
	select HZOS_EXT_GPU_FREQ_KUNIT_TEST if CGROUP_GPU
	select META_PROGLOGIC_KUNIT_TEST if META_PROGLOGIC
	help
	  Master switch to enable all KUnit tests under drivers/staging/oculus/.

config DMABUF_REORDER_KUNIT_TEST
	tristate "KUnit tests for dmabuf_reorder helpers" if !KUNIT_ALL_TESTS
	depends on KUNIT && !QCOM_MEM_BUF
	default KUNIT_STAGING_OCULUS
	help
	  Unit tests for the dmabuf_reorder scatterlist helper functions.

config MISCFIFO_KUNIT_TEST
	tristate "KUnit tests for miscfifo" if !KUNIT_ALL_TESTS
	depends on KUNIT && MISCFIFO
	default KUNIT_STAGING_OCULUS
	help
	  Unit tests for the miscfifo chardev driver.

config META_SWD_FWUPDATE_KUNIT_TEST
	tristate "KUnit tests for SWD fwupdate manager" if !KUNIT_ALL_TESTS
	depends on KUNIT && META_SWD
	default KUNIT_STAGING_OCULUS
	help
	  Unit tests for the SWD firmware update manager APIs.

config META_PROGLOGIC_KUNIT_TEST
	bool "KUnit tests for meta-proglogic" if !KUNIT_ALL_TESTS
	depends on KUNIT && META_PROGLOGIC
	select REGMAP_I2C
	default KUNIT_STAGING_OCULUS
	help
	  Unit tests for the meta-proglogic control-bit data model, variant
	  selection, and the tether/SD LPD enable and latch-clear APIs. The
	  tests are compiled into the meta-proglogic driver via an #include at
	  the end of meta-proglogic.c, so they reach its static tables.
```
