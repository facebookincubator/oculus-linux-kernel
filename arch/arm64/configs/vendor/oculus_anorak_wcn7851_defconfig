## arch/arm64/configs/vendor/oculus_crimson_hollywood_defconfig
```kconfig
CONFIG_NUM_ATTACHED_CAMERAS=6
CONFIG_SND_SOC_AK4331=y
CONFIG_SND_SOC_CM710X=y
CONFIG_AS5510=y
CONFIG_OCULUS_VIRTUAL_SENSOR=y
CONFIG_OCULUS_EXTERNAL_BATTERY=y
CONFIG_OCULUS_HOLLYWOOD=y
CONFIG_USB_CONFIGFS_F_UVC=y
CONFIG_USB_CONFIGFS_F_UAC2=y
CONFIG_OCULUS_CRIMSON=y
```

## arch/arm64/configs/vendor/oculus_eng_defconfig
```kconfig
CONFIG_PSI_FTRACE=y
CONFIG_DEBUG_FS=y
CONFIG_DEBUG_BLK_CGROUP=y
CONFIG_CGROUP_DEBUG=y
CONFIG_PRINT_VMEMLAYOUT=y
CONFIG_PM_DEBUG=y
CONFIG_KPROBES=y
CONFIG_CLEANCACHE=y
CONFIG_L2TP_DEBUGFS=y
CONFIG_DNS_RESOLVER=y
CONFIG_SERIAL_MSM_GENI_CONSOLE=y
CONFIG_SERIAL_DEV_BUS=y
CONFIG_TTY_PRINTK=y
CONFIG_VIDEO_ADV_DEBUG=y
CONFIG_MMC_IPC_LOGGING=y
CONFIG_EDAC=y
CONFIG_EDAC_CORTEX_ARM64=y
CONFIG_EDAC_CORTEX_ARM64_DBE_IRQ_ONLY=y
CONFIG_EDAC_CORTEX_ARM64_PANIC_ON_UE=y
CONFIG_QCOM_GPI_DMA_DEBUG=y
CONFIG_IOMMU_TLBSYNC_DEBUG=y
CONFIG_ARM_SMMU_TESTBUS_DUMP=y
CONFIG_IOMMU_DEBUG=y
CONFIG_IOMMU_TESTS=y
CONFIG_MSM_CORE_HANG_DETECT=y
CONFIG_MSM_GLADIATOR_HANG_DETECT=y
CONFIG_ICNSS_DEBUG=y
CONFIG_PHY_XGENE=y
CONFIG_HARDENED_USERCOPY_PAGESPAN=y
CONFIG_XZ_DEC=y
CONFIG_DYNAMIC_DEBUG=y
CONFIG_DEBUG_CONSOLE_UNHASHED_POINTERS=y
CONFIG_DEBUG_MODULE_LOAD_INFO=y
# CONFIG_DEBUG_INFO_REDUCED is not set
CONFIG_PAGE_OWNER=y
CONFIG_PAGE_OWNER_ENABLE_DEFAULT=y
CONFIG_DEBUG_SECTION_MISMATCH=y
# CONFIG_SECTION_MISMATCH_WARN_ONLY is not set
CONFIG_DEBUG_FORCE_WEAK_PER_CPU=y
CONFIG_DEBUG_PAGEALLOC=y
CONFIG_SLUB_DEBUG_PANIC_ON=y
CONFIG_DEBUG_PANIC_ON_OOM=y
CONFIG_DEBUG_PAGEALLOC_ENABLE_DEFAULT=y
CONFIG_PAGE_POISONING=y
CONFIG_PAGE_POISONING_ENABLE_DEFAULT=y
CONFIG_SLUB_DEBUG=y
CONFIG_SLUB_DEBUG_ON=y
CONFIG_DEBUG_KMEMLEAK=y
CONFIG_DEBUG_KMEMLEAK_EARLY_LOG_SIZE=4000
CONFIG_DEBUG_KMEMLEAK_DEFAULT_OFF=y
CONFIG_DEBUG_STACK_USAGE=y
CONFIG_DEBUG_MEMORY_INIT=y
CONFIG_SOFTLOCKUP_DETECTOR=y
# CONFIG_DETECT_HUNG_TASK is not set
CONFIG_WQ_WATCHDOG=y
CONFIG_PANIC_ON_SCHED_BUG=y
CONFIG_SCHED_STACK_END_CHECK=y
CONFIG_DEBUG_SPINLOCK_PANIC_ON_BUG=y
CONFIG_PROVE_LOCKING=y
CONFIG_DEBUG_ATOMIC_SLEEP=y
CONFIG_LOCK_TORTURE_TEST=m
CONFIG_DEBUG_SG=y
CONFIG_DEBUG_NOTIFIERS=y
CONFIG_DEBUG_CREDENTIALS=y
CONFIG_RCU_TORTURE_TEST=m
CONFIG_FAULT_INJECTION=y
CONFIG_FAIL_PAGE_ALLOC=y
CONFIG_FAULT_INJECTION_DEBUG_FS=y
CONFIG_UFS_FAULT_INJECTION=y
CONFIG_FAULT_INJECTION_STACKTRACE_FILTER=y
CONFIG_QCOM_RTB=y
CONFIG_QCOM_RTB_SEPARATE_CPUS=y
CONFIG_FUNCTION_TRACER=y
CONFIG_PREEMPTIRQ_EVENTS=y
CONFIG_IRQSOFF_TRACER=y
CONFIG_PREEMPT_TRACER=y
CONFIG_BLK_DEV_IO_TRACE=y
CONFIG_LKDTM=m
CONFIG_ATOMIC64_SELFTEST=m
CONFIG_TEST_USER_COPY=m
CONFIG_MEMTEST=y
CONFIG_BUG_ON_DATA_CORRUPTION=y
CONFIG_PANIC_ON_DATA_CORRUPTION=y
CONFIG_KGDB=y
CONFIG_KGDB_KDB=y
CONFIG_PID_IN_CONTEXTIDR=y
CONFIG_ARM64_STRICT_BREAK_BEFORE_MAKE=y
```

## arch/arm64/configs/vendor/oculus_eureka865_defconfig
```kconfig
CONFIG_AS5510=y
CONFIG_CHARGER_CYPD3177=y
# CONFIG_CNSS_QCA6390 is not set
CONFIG_CNSS_QCA6490=y
CONFIG_CYPD_POLICY_ENGINE=y
CONFIG_I2C_MUX_PCA954x=y
CONFIG_MFD_I2C_PMIC=y
CONFIG_MMC=y
CONFIG_MMC_BLOCK_MINORS=32
CONFIG_MMC_BLOCK_DEFERRED_RESUME=y
CONFIG_MMC_IPC_LOGGING=y
CONFIG_MMC_SDHCI=y
CONFIG_MMC_SDHCI_PLTFM=y
CONFIG_MMC_SDHCI_MSM=y
CONFIG_MMC_TEST=y
CONFIG_NAUTILUS_CLK=y
CONFIG_NUM_ATTACHED_CAMERAS=6
CONFIG_OCULUS_BLU_I2C=y
CONFIG_OCULUS_EUREKA865=y
CONFIG_QCA_CLD_WLAN_PROFILE="default"
CONFIG_SMB1355_SLAVE_CHARGER=y
CONFIG_SND_SOC_AK4331=y
CONFIG_SND_SOC_MAX98360A=y
CONFIG_REGULATOR_TPS65132=y
CONFIG_SPECTRA_CAMERA_ICP=y
CONFIG_SPECTRA_CAMERA_JPEG=y
```

## arch/arm64/configs/vendor/oculus_eureka_defconfig
```kconfig
CONFIG_AK09973=m
CONFIG_AS5510=m
CONFIG_CHARGER_CYPD3177=y
CONFIG_CYPD_POLICY_ENGINE=y
CONFIG_META_USBVDM_CYPD=m
CONFIG_NAUTILUS_RESOURCE_MANAGER=m
CONFIG_OCULUS_EUREKA=y
CONFIG_OCULUS_CHARGING_DOCK=m
CONFIG_META_SWD_STM32G0=y
CONFIG_REGULATOR_SGM62110=m
CONFIG_SENSORLOCK=m
CONFIG_SERIAL_MSM_GENI_IOS_DELAY_MONITOR=y
CONFIG_SND_SOC_AK4333=m
CONFIG_SND_SOC_MAX98388=m
CONFIG_USB_PDFU=m
CONFIG_VIRTUAL_SENSOR=m
CONFIG_USBIP_CORE=m
CONFIG_USBIP_VUDC=m
```

## arch/arm64/configs/vendor/oculus_hammerhead_defconfig
```kconfig
CONFIG_LEDS_AW2026=y
CONFIG_MAX17332=y
CONFIG_REGULATOR_MAX77813=y
CONFIG_RT600_CTRL=y
CONFIG_SPI_STP=y
```

## arch/arm64/configs/vendor/oculus_hollywood_defconfig
```kconfig
CONFIG_NUM_ATTACHED_CAMERAS=4
CONFIG_SND_SOC_AK4331=y
CONFIG_SND_SOC_CM710X=y
CONFIG_AS5510=y
CONFIG_CHARGING_THERMAL_CONTROLLER=y
CONFIG_META_USBVDM=y
CONFIG_META_USBVDM_QTIPD=y
CONFIG_OCULUS_EXTERNAL_BATTERY=y
CONFIG_OCULUS_HOLLYWOOD=y
CONFIG_OCULUS_CHARGING_DOCK=y
CONFIG_BLU_FW=y
CONFIG_VIRTUAL_SENSOR=y
```

## arch/arm64/configs/vendor/oculus_panther_defconfig
```kconfig
CONFIG_AK09973=m
CONFIG_OCULUS_CHARGING_DOCK=m
CONFIG_OCULUS_PANTHER=y
CONFIG_LEDS_CLASS_FLASH=m
CONFIG_LEDS_QTI_FLASH=m
CONFIG_LEDS_TRIGGER_DEFAULT_ON=m
CONFIG_SENSORLOCK=m
CONFIG_SND_SOC_MAX98388=m
CONFIG_USB_PDFU=m
CONFIG_VIRTUAL_SENSOR=m
```

## arch/arm64/configs/vendor/oculus_seacliff_defconfig
```kconfig
CONFIG_ARM64_KERNEL_STACK_ORDER=2
CONFIG_BCMDHD=m
CONFIG_BCM4389=y
CONFIG_BCMDHD_FW_PATH="/vendor/firmware/bcmdhd/bcm4389_net.bin"
CONFIG_BCMDHD_NVRAM_PATH="/vendor/firmware/bcmdhd/bcm4389.cal"
CONFIG_BCMDHD_CLM_PATH="/vendor/firmware/bcmdhd/bcm4389_clm.blob"
CONFIG_BCMDHD_OOB_HOST_WAKE=y
CONFIG_BCMDHD_PCIE=y
CONFIG_BCMDHD_DEFAULT_LOG_MASK=1
CONFIG_BCMDHD_PREALLOC_MEMDUMP=y
CONFIG_BROADCOM_WIFI_RESERVED_MEM=y
CONFIG_BT_BCM4361=y
CONFIG_BT_BLUESLEEP=y
# CONFIG_BT_SLIM_QCA6390 is not set
# CONFIG_BTFM_SLIM is not set
CONFIG_CHARGER_CYPD3177=y
# CONFIG_CNSS2 is not set
CONFIG_DEPTH_PROJECTOR=y
CONFIG_DHD_OF_SUPPORT=y
CONFIG_EYE_FACE_LED=y
CONFIG_FPGA_AGGREGATOR=m
CONFIG_GPIO_CAPACITOR=y
CONFIG_META_USBVDM=y
CONFIG_META_USBVDM_CYPD=y
CONFIG_META_USBVDM_QTIPD=y
CONFIG_MFD_I2C_PMIC=y
# CONFIG_MSM_BT_POWER is not set
CONFIG_NUM_ATTACHED_CAMERAS=6
CONFIG_OCULUS_SEACLIFF=y
# CONFIG_QCA_CLD_WLAN is not set
CONFIG_REGULATOR_AW37504=y
CONFIG_SEACLIFF_BLU=y
CONFIG_SERIAL_MSM_GENI_DISALLOW_SUSPEND_RFR_PULL=y
CONFIG_SMB1355_SLAVE_CHARGER=y
CONFIG_SND_SOC_CM7120=y
CONFIG_SND_SOC_CM7120_SPI=y
CONFIG_SPECTRA_CAMERA_ICP=y
CONFIG_SPECTRA_CAMERA_JPEG=y
CONFIG_UVLO_TLV4021=y
CONFIG_PAC193X=y
CONFIG_CYPD_POLICY_ENGINE=y
CONFIG_OCULUS_CHARGING_DOCK=y
CONFIG_OCULUS_SWD_STM32G0=y
CONFIG_CHARGING_THERMAL_CONTROLLER=y
CONFIG_VIRTUAL_SENSOR=y
```

## arch/arm64/configs/wifi_debug_defconfig
```kconfig
CONFIG_MODULES=y
CONFIG_MODULE_UNLOAD=y
CONFIG_MSM_BT_POWER=y
CONFIG_QCA_CLD_WLAN=m
CONFIG_DIAG_CHAR=y
```

## drivers/backports-wireless/Kconfig.local
```kconfig
config BACKPORTED_BACKPORT_DIR
	tristate
	default BACKPORT_DIR
config BACKPORTED_BACKPORTS_VERSION
	tristate
	default BACKPORTS_VERSION
config BACKPORTED_BACKPORTED_KERNEL_VERSION
	tristate
	default BACKPORTED_KERNEL_VERSION
config BACKPORTED_BACKPORTED_KERNEL_NAME
	tristate
	default BACKPORTED_KERNEL_NAME
config BACKPORTED_BACKPORTED_DEBUG_INFO
	tristate
	default BACKPORTED_DEBUG_INFO
config BACKPORTED_WIRELESS
	tristate
	default WIRELESS
config BACKPORTED_NET_CORE
	tristate
	default NET_CORE
config BACKPORTED_EXPERT
	tristate
	default EXPERT
config BACKPORTED_BP_MODULES
	tristate
	default BP_MODULES
config BACKPORTED_BPAUTO_BUILD_CORDIC
	tristate
	default BPAUTO_BUILD_CORDIC
config BACKPORTED_BPAUTO_CORDIC
	tristate
	default BPAUTO_CORDIC
config BACKPORTED_BPAUTO_MII
	tristate
	default BPAUTO_MII
config BACKPORTED_BPAUTO_BUILD_LEDS
	tristate
	default BPAUTO_BUILD_LEDS
config BACKPORTED_BPAUTO_NEW_LEDS
	tristate
	default BPAUTO_NEW_LEDS
config BACKPORTED_BPAUTO_LEDS_CLASS
	tristate
	default BPAUTO_LEDS_CLASS
config BACKPORTED_BPAUTO_LEDS_TRIGGERS
	tristate
	default BPAUTO_LEDS_TRIGGERS
config BACKPORTED_BPAUTO_USERSEL_BUILD_ALL
	tristate
	default BPAUTO_USERSEL_BUILD_ALL
config BACKPORTED_BPAUTO_CRYPTO_SKCIPHER
	tristate
	default BPAUTO_CRYPTO_SKCIPHER
config BACKPORTED_BPAUTO_WANT_DEV_COREDUMP
	tristate
	default BPAUTO_WANT_DEV_COREDUMP
config BACKPORTED_BPAUTO_BUILD_WANT_DEV_COREDUMP
	tristate
	default BPAUTO_BUILD_WANT_DEV_COREDUMP
config BACKPORTED_BPAUTO_RHASHTABLE
	tristate
	default BPAUTO_RHASHTABLE
config BACKPORTED_BPAUTO_BUCKET_LOCKS
	tristate
	default BPAUTO_BUCKET_LOCKS
config BACKPORTED_BPAUTO_BUILD_HDMI
	tristate
	default BPAUTO_BUILD_HDMI
config BACKPORTED_BPAUTO_HDMI
	tristate
	default BPAUTO_HDMI
config BACKPORTED_BPAUTO_FRAME_VECTOR
	tristate
	default BPAUTO_FRAME_VECTOR
config BACKPORTED_BPAUTO_BUILD_FRAME_VECTOR
	tristate
	default BPAUTO_BUILD_FRAME_VECTOR
config BACKPORTED_BPAUTO_REFCOUNT
	tristate
	default BPAUTO_REFCOUNT
config BACKPORTED_BPAUTO_SYSTEM_DATA_VERIFICATION
	tristate
	default BPAUTO_SYSTEM_DATA_VERIFICATION
config BACKPORTED_BPAUTO_BUILD_SYSTEM_DATA_VERIFICATION
	tristate
	default BPAUTO_BUILD_SYSTEM_DATA_VERIFICATION
config BACKPORTED_BPAUTO_PUBLIC_KEY
	tristate
	default BPAUTO_PUBLIC_KEY
config BACKPORTED_BPAUTO_ASN1_DECODER
	tristate
	default BPAUTO_ASN1_DECODER
config BACKPORTED_BPAUTO_PKCS7
	tristate
	default BPAUTO_PKCS7
config BACKPORTED_CFG80211
	tristate
	default CFG80211
config BACKPORTED_NL80211_TESTMODE
	tristate
	default NL80211_TESTMODE
config BACKPORTED_CFG80211_DEVELOPER_WARNINGS
	tristate
	default CFG80211_DEVELOPER_WARNINGS
config BACKPORTED_CFG80211_CERTIFICATION_ONUS
	tristate
	default CFG80211_CERTIFICATION_ONUS
config BACKPORTED_CFG80211_REG_CELLULAR_HINTS
	tristate
	default CFG80211_REG_CELLULAR_HINTS
config BACKPORTED_CFG80211_REG_RELAX_NO_IR
	tristate
	default CFG80211_REG_RELAX_NO_IR
config BACKPORTED_CFG80211_DEFAULT_PS
	tristate
	default CFG80211_DEFAULT_PS
config BACKPORTED_CFG80211_DEBUGFS
	tristate
	default CFG80211_DEBUGFS
config BACKPORTED_CFG80211_INTERNAL_REGDB
	tristate
	default CFG80211_INTERNAL_REGDB
config BACKPORTED_CFG80211_CRDA_SUPPORT
	tristate
	default CFG80211_CRDA_SUPPORT
config BACKPORTED_CFG80211_WEXT
	tristate
	default CFG80211_WEXT
config BACKPORTED_CFG80211_WEXT_EXPORT
	tristate
	default CFG80211_WEXT_EXPORT
config BACKPORTED_LIB80211
	tristate
	default LIB80211
config BACKPORTED_LIB80211_CRYPT_WEP
	tristate
	default LIB80211_CRYPT_WEP
config BACKPORTED_LIB80211_CRYPT_CCMP
	tristate
	default LIB80211_CRYPT_CCMP
config BACKPORTED_LIB80211_CRYPT_TKIP
	tristate
	default LIB80211_CRYPT_TKIP
config BACKPORTED_LIB80211_DEBUG
	tristate
	default LIB80211_DEBUG
config BACKPORTED_WLAN
	tristate
	default WLAN
config BACKPORTED_WIRELESS_WDS
	tristate
	default WIRELESS_WDS
config BACKPORTED_PCMCIA_RAYCS
	tristate
	default PCMCIA_RAYCS
config BACKPORTED_PCMCIA_WL3501
	tristate
	default PCMCIA_WL3501
config BACKPORTED_MAC80211_HWSIM
	tristate
	default MAC80211_HWSIM
config BACKPORTED_USB_NET_RNDIS_WLAN
	tristate
	default USB_NET_RNDIS_WLAN
config BACKPORTED_WLAN_VENDOR_BROADCOM
	tristate
	default WLAN_VENDOR_BROADCOM
config BACKPORTED_BRCMUTIL
	tristate
	default BRCMUTIL
config BACKPORTED_BRCMSMAC
	tristate
	default BRCMSMAC
config BACKPORTED_BRCMFMAC
	tristate
	default BRCMFMAC
config BACKPORTED_BRCMFMAC_PROTO_BCDC
	tristate
	default BRCMFMAC_PROTO_BCDC
config BACKPORTED_BRCMFMAC_PROTO_MSGBUF
	tristate
	default BRCMFMAC_PROTO_MSGBUF
config BACKPORTED_BRCMFMAC_SDIO
	tristate
	default BRCMFMAC_SDIO
config BACKPORTED_BRCMFMAC_USB
	tristate
	default BRCMFMAC_USB
config BACKPORTED_BRCMFMAC_PCIE
	tristate
	default BRCMFMAC_PCIE
config BACKPORTED_BRCM_TRACING
	tristate
	default BRCM_TRACING
config BACKPORTED_BRCMDBG
	tristate
	default BRCMDBG
config BACKPORTED_BRCMFMAC_PCIE_BARWIN_SZ
	tristate
	default BRCMFMAC_PCIE_BARWIN_SZ
config BACKPORTED_BRCMFMAC_ANDROID
	tristate
	default BRCMFMAC_ANDROID
config BACKPORTED_BRCM_INSMOD_NO_FW
	tristate
	default BRCM_INSMOD_NO_FW
config BACKPORTED_BRCMFMAC_CARD_DETECT
	tristate
	default BRCMFMAC_CARD_DETECT
```

## drivers/backports-wireless/drivers/net/wireless/broadcom/brcm80211/Kconfig
```kconfig
config BRCMUTIL
	tristate
	depends on m

config BRCMSMAC
	depends on n
	tristate "Broadcom IEEE802.11n PCIe SoftMAC WLAN driver"
	depends on m
	depends on MAC80211
	depends on BCMA_POSSIBLE
	depends on BCMA
	select NEW_LEDS if BCMA_DRIVER_GPIO
	select LEDS_CLASS if BCMA_DRIVER_GPIO
	select BRCMUTIL
	depends on FW_LOADER
	select BPAUTO_CORDIC
	---help---
	  This module adds support for PCIe wireless adapters based on Broadcom
	  IEEE802.11n SoftMAC chipsets. It also has WLAN led support, which will
	  be available if you select BCMA_DRIVER_GPIO. If you choose to build a
	  module, the driver will be called brcmsmac.ko.

config BRCMFMAC
	tristate "Broadcom FullMAC WLAN driver"
	depends on m
	depends on CFG80211
	select BRCMUTIL
	---help---
	  This module adds support for wireless adapters based on Broadcom
	  FullMAC chipsets. It has to work with at least one of the bus
	  interface support. If you choose to build a module, it'll be called
	  brcmfmac.ko.

config BRCMFMAC_PROTO_BCDC
	bool

config BRCMFMAC_PROTO_MSGBUF
	bool

config BRCMFMAC_SDIO
	bool "SDIO bus interface support for FullMAC driver"
	depends on (MMC = y || MMC = BRCMFMAC)
	depends on BRCMFMAC
	select BRCMFMAC_PROTO_BCDC
	depends on FW_LOADER
	default y
	---help---
	  This option enables the SDIO bus interface support for Broadcom
	  IEEE802.11n embedded FullMAC WLAN driver. Say Y if you want to
	  use the driver for a SDIO wireless card.

config BRCMFMAC_USB
	bool "USB bus interface support for FullMAC driver"
	depends on (USB = y || USB = BRCMFMAC)
	depends on BRCMFMAC
	select BRCMFMAC_PROTO_BCDC
	depends on FW_LOADER
	---help---
	  This option enables the USB bus interface support for Broadcom
	  IEEE802.11n embedded FullMAC WLAN driver. Say Y if you want to
	  use the driver for an USB wireless card.

config BRCMFMAC_PCIE
	bool "PCIE bus interface support for FullMAC driver"
	depends on BRCMFMAC
	depends on PCI
	depends on HAS_DMA
	select BRCMFMAC_PROTO_MSGBUF
	depends on FW_LOADER
	---help---
	  This option enables the PCIE bus interface support for Broadcom
	  IEEE802.11ac embedded FullMAC WLAN driver. Say Y if you want to
	  use the driver for an PCIE wireless card.

config BRCM_TRACING
	bool "Broadcom device tracing"
	depends on BRCMSMAC || BRCMFMAC
	---help---
	  If you say Y here, the Broadcom wireless drivers will register
	  with ftrace to dump event information into the trace ringbuffer.
	  Tracing can be enabled at runtime to aid in debugging wireless
	  issues. This option adds a small amount of overhead when tracing
	  is disabled. If unsure, say Y to allow developers to better help
	  you when wireless problems occur.

config BRCMDBG
	bool "Broadcom driver debug functions"
	depends on BRCMSMAC || BRCMFMAC
	select BPAUTO_WANT_DEV_COREDUMP
	---help---
	  Selecting this enables additional code for debug purposes.

config BRCMFMAC_PCIE_BARWIN_SZ
	bool "Custom PCIE BAR window size support for FullMAC driver"
	depends on BRCMFMAC
	depends on PCI
	default n
	---help---
	  If you say Y here, the FMAC driver will use custom PCIE BAR
	  window size. Say Y to allow developers to use custom PCIE
	  BAR window size when HOST PCIE IP can support less then 4MB
	  BAR window.

config BRCMFMAC_ANDROID
	bool "brcmfmac android support"
	depends on BRCMFMAC
	---help---
	  If you say Y here, the FMAC driver will support Android mode

config BRCM_INSMOD_NO_FW
	bool "insmod module without loading firmware"
	depends on BRCMFMAC_ANDROID
	---help---
	  If you say Y here, the FMAC driver will not load firmware when
	  inserting the module, it only create wlan interface. Firmware
	  will be loaded when wlan interface up.

config BRCMFMAC_CARD_DETECT
	bool "Enable specific platform's API with brcmfmac android"
	depends on BRCMFMAC_ANDROID
	depends on BRCMFMAC_SDIO
	---help---
	  If you say Y here, specific wifi_card_detect() API will
	  enable when platform_driver or power cycle on/off call.
	  This feature indicate for specific(e.g. I.MX) kernel.
```
