## drivers/input/touchscreen/focaltech_touch/Kconfig
```kconfig
#
# Focaltech Touchscreen driver configuration
#

config TOUCHSCREEN_FTS
    bool "Focaltech Touchscreen"
    default n
    help
      Say Y here if you have Focaltech touch panel.
      If unsure, say N.
      
config TOUCHSCREEN_FTS_DIRECTORY
    string "Focaltech ts directory name"
    default "focaltech_touch"
    depends on TOUCHSCREEN_FTS
    
config TOUCHSCREEN_FTS_BUS_SPI
    bool "Focaltech ts bus type is SPI"
    default n
    depends on TOUCHSCREEN_FTS
    help
        Set Y here if bus type is SPI
	If unsure, say N.
	
config TOUCHSCREEN_FTS_BUS_SPI_V2
    bool "Focaltech spi protocol is V2 or not"
    default n
    depends on TOUCHSCREEN_FTS && TOUCHSCREEN_FTS_BUS_SPI
    help
        Set Y here if spi protocol is V2(new)
	If unsure, say N.

config TOUCHSCRREN_FTS_HAVE_FLASH
	bool "Focaltech has flash stored firmware or not"
    default n
    depends on TOUCHSCREEN_FTS
    help
        Set Y here if having flash
	If unsure, say N.
```

## drivers/media/platform/msm/Kconfig
```kconfig
# SPDX-License-Identifier: GPL-2.0-only

menuconfig SPECTRA_CAMERA
    bool "Qualcomm Technologies, Inc. Spectra camera and video capture support"
    depends on ARCH_QCOM && VIDEO_V4L2 && I2C
    help
      Say Y here to enable selecting the video adapters for
      Qualcomm Technologies, Inc. Spectra camera and video capture.
      Enabling this adds support for the camera driver stack including sensor,
      IFE and postprocessing drivers.

source "drivers/media/platform/msm/vidc_3x/Kconfig"

menuconfig MSM_CAMERA
     bool "QTI MSM camera and video capture support"
     depends on ARCH_QCOM && VIDEO_V4L2 && I2C
     help
       Say Y here to enable selecting the video adapters for
       QTI msm camera and video capture drivers. enabling this
       adds support for the camera driver stack including sensor, isp
       and postprocessing drivers for legacy chipsets.

config MSM_CAMERA_DEBUG
     bool "QTI MSM camera debugging with printk"
     depends on MSM_CAMERA
     default n
     help
       Say Y here to enable selecting the video adapters for
       QTI msm camera and video capture drivers. enabling this
       adds support for the camera driver stack including sensor, isp
       and postprocessing drivers for legacy chipsets.
       Enable printk() debug for msm camera.

menuconfig MSMB_CAMERA
     bool "QTI MSM camera and video capture 2.0 support"
     depends on ARCH_QCOM && VIDEO_V4L2 && I2C
     help
       Say Y here to enable selecting the video adapters for
       QTI msm camera and video capture 2.0, enabling this
       adds support for the camera driver stack including sensor, isp
       and postprocessing drivers.

config MSMB_CAMERA_DEBUG
     bool "QTI MSM camera 2.0 debugging with printk"
     depends on MSMB_CAMERA
     help
       Say Y here to enable selecting the video adapters for
       QTI msm camera and video capture 2.0, enabling this
       adds support for the camera driver stack including sensor, isp
       and postprocessing drivers.
       Enable printk() debug for msm camera 2.0.

if MSMB_CAMERA
       source "drivers/media/platform/msm/camera_v2/Kconfig"
endif # MSMB_CAMERA

config NUM_ATTACHED_CAMERAS
    int "Number of attached cameras"
    default 8

config SPECTRA_CAMERA_CUSTOM
    bool "Spectra - Custom camera support"
    depends on SPECTRA_CAMERA

config SPECTRA_CAMERA_FACE_DETECTION
    bool "Spectra - Face detection support"
    depends on SPECTRA_CAMERA

config SPECTRA_CAMERA_ICP
    bool "Spectra - ICP support"
    depends on SPECTRA_CAMERA

config SPECTRA_CAMERA_JPEG
    bool "Spectra - JPEG support"
    depends on SPECTRA_CAMERA

config SPECTRA_CAMERA_LRME
    bool "Spectra - LRME support"
    depends on SPECTRA_CAMERA

config SPECTRA_CAMERA_ACTUATOR
    bool "Spectra - Actuator support"
    depends on SPECTRA_CAMERA

config SPECTRA_CAMERA_EEPROM
    bool "Spectra - EEPROM support"
    depends on SPECTRA_CAMERA

config SPECTRA_CAMERA_FLASH
    bool "Spectra - Flash support"
    depends on SPECTRA_CAMERA

config SPECTRA_CAMERA_OIS
    bool "Spectra - Image stabilization support"
    depends on SPECTRA_CAMERA

config SPECTRA_CAMERA_LOG_DEBUG
    bool "Spectra - Debug logs"
    depends on SPECTRA_CAMERA

config SPECTRA_CAMERA_LOG_INFO
    bool "Spectra - Info logs"
    depends on SPECTRA_CAMERA

config SPECTRA_CAMERA_LOG_WARN
    bool "Spectra - Warning logs"
    default y
    depends on SPECTRA_CAMERA

config SPECTRA_CAMERA_LOG_ERROR
    bool "Spectra - Error logs"
    default y
    depends on SPECTRA_CAMERA

config SPECTRA_CAMERA_SENSOR_ACCESS
    bool "Spectra - Camera sensor access support"
    default n
    depends on SPECTRA_CAMERA

source "drivers/media/platform/msm/cvp/Kconfig"
source "drivers/media/platform/msm/npu/Kconfig"
source "drivers/media/platform/msm/synx/Kconfig"
source "drivers/media/platform/msm/dvb/Kconfig"
source "drivers/media/platform/msm/broadcast/Kconfig"
source "drivers/media/platform/msm/sde/Kconfig"
```

## drivers/misc/oculus/Kconfig
```kconfig
config OCULUSSYNCBOSS
    tristate "Oculus Monterey SyncBoss Driver"
    depends on MISCFIFO && SPI
    default y
    help
    Oculus Monterey SyncBoss Driver

config SYNCBOSS_NUM_CAMERAS
    int
    prompt "Number of cameras in Oculus Syncboss"
    depends on OCULUSSYNCBOSS
    default 4
    help
    Number of cameras used in Oculus Syncboss driver
```
