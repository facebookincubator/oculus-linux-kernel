## drivers/gpu/msm/Kconfig
```kconfig
# SPDX-License-Identifier: GPL-2.0-only
config QCOM_KGSL
	tristate "Qualcomm Technologies, Inc. 3D Graphics driver"
	depends on ARCH_QCOM
	depends on QCOM_QFPROM
	select MSM_SUBSYSTEM_RESTART
	select GENERIC_ALLOCATOR
	select FW_LOADER
	select PM_DEVFREQ
	select QCOM_SCM
	select DEVFREQ_GOV_SIMPLE_ONDEMAND
	select DEVFREQ_GOV_PERFORMANCE
	select DEVFREQ_GOV_QCOM_ADRENO_TZ
	select DEVFREQ_GOV_QCOM_GPUBW_MON
	help
	  3D graphics driver for the Adreno family of GPUs from QTI.
	  Required to use hardware accelerated OpenGL, compute and Vulkan
	  on QTI targets. This includes power management, memory management,
	  and scheduling for the Adreno GPUs.

config DEVFREQ_GOV_QCOM_ADRENO_TZ
	tristate "Qualcomm Technologies, Inc. GPU frequency governor"
	depends on PM_DEVFREQ && QCOM_KGSL
	help
	  GPU frequency governor for the Adreno GPU. Sets the frequency
	  using an "on demand" algorithm in conjunction with other
	  components on Adreno platforms. This is not useful for non-Adreno
	  devices.

config DEVFREQ_GOV_QCOM_GPUBW_MON
	tristate "GPU BW voting governor"
	depends on DEVFREQ_GOV_QCOM_ADRENO_TZ
	help
	  This governor works together with Adreno Trustzone governor,
	  and select bus frequency votes using an "on-demand" alorithm.
	  This governor is unlikely to be useful for non-Adreno
	  devices.

config QCOM_ADRENO_DEFAULT_GOVERNOR
	string "devfreq governor for the adreno core"
	default "msm-adreno-tz" if DEVFREQ_GOV_QCOM_ADRENO_TZ
	default "simple_ondemand"
	depends on QCOM_KGSL

config QCOM_KGSL_CORESIGHT
	bool "Enable coresight support for the Adreno GPU"
	depends on QCOM_KGSL && CORESIGHT
	help
	  When enabled, the Adreno GPU is available as a source for Coresight
	  data. On a6xx targets there are two sources available for the GX and
	  CX domains respectively. Debug kernels should say 'Y' here.

config QCOM_KGSL_IOCOHERENCY_DEFAULT
	bool "Enable I/O coherency on cached GPU memory by default"
	depends on QCOM_KGSL
	default y if ARCH_LAHAINA
	help
	  Say 'Y' here to enable I/O cache coherency by default on targets that
	  support hardware I/O coherency. If enabled all cached GPU memory
	  will use I/O coherency regardless of the user flags. If not enabled
	  the user can still selectively enable I/O coherency with a flag.

config QCOM_KGSL_IOMMU
	bool
	default y if QCOM_KGSL && (MSM_IOMMU || ARM_SMMU)

config QCOM_KGSL_ENTRY_METADATA
	bool "Enable metadata field for KGSL memory entries"
	depends on QCOM_KGSL && DEBUG_FS
	help
	  Adds support for the metadata field for KGSL memory entries. This can
	  be used by applications to specially mark entries in when dumping
	  'mem' for a process in debugfs. This is never required for proper
	  functioning of the driver. Say 'N' unless there is a specific need
	  for this feature.

config QCOM_KGSL_PAGE_POOLING
	bool "Enable support for KGSL page pools"
	default y if QCOM_KGSL

config QCOM_KGSL_LAZY_ALLOCATION
	bool "Enable support for lazily allocated memory entries"
	depends on QCOM_KGSL
	depends on QCOM_KGSL_IOMMU && ARM_SMMU
	default y if QCOM_KGSL
	help
	  Allow lazy allocation of backing pages for GPU memory entries. This
	  can reduce RAM usage substantially and it defers the CPU usage of
	  memory allocation for entries from all-at-once at entry creation
	  (legacy behavior) to the first time each page is written to. This is
	  nominally identical to how memory allocation works for normal
	  userspace allocations. Say 'Y'.

config QCOM_KGSL_LAZY_POOL_SIZE
	int "Number of pages to keep in the non-secure lazy allocation pool"
	depends on QCOM_KGSL_LAZY_ALLOCATION
	range 16 4096
	default 512
	help
	  Size (in pages) of the non-secure lazy allocation pool for GPU memory
	  entries. This should be tuned to keep allocations fed while minimizing
	  the time spent in the slow path of directly allocating pages in the
	  page fault handler.

config QCOM_KGSL_SECURE_LAZY_ALLOCATION
	bool "Allow lazy allocation for secure memory entries"
	depends on QCOM_KGSL_LAZY_ALLOCATION
	depends on QCOM_SECURE_BUFFER
	help
	  Allows lazy allocation for secure memory entries. Secure faults are
	  somewhat more expensive to handle than non-secure page faults due to
	  having to lock the allocated pages. Say 'Y' unless testing shows this
	  performance hit to be unacceptable as the reduction in memory usage
	  is substantial.

config QCOM_KGSL_SECURE_LAZY_POOL_SIZE
	int "Number of pages to keep in the secure lazy allocation pool"
	depends on QCOM_KGSL_SECURE_LAZY_ALLOCATION
	range 16 4096
	default 128
	help
	  Size (in pages) of the secure lazy allocation pool for GPU memory
	  entries. This should be tuned to keep allocations fed while avoiding
	  allocation retries in the page fault handler.

config QCOM_KGSL_LAZY_GLOBALS
	bool "Lazily allocate memory for globals"
	depends on QCOM_KGSL_LAZY_ALLOCATION
	default y if QCOM_KGSL
	help
	  Enables lazy allocation for global memory entries. This reduces
	  memory consumption at a small initial performance cost as pages are
	  faulted in. If unsure, say 'Y'.

config QCOM_KGSL_LAZY_GPUREADONLY
	bool "Lazily allocate memory for GPU read-only entries"
	depends on QCOM_KGSL_LAZY_ALLOCATION
	default y if QCOM_KGSL
	help
	  Enables lazy allocation by default for entries that are marked GPU
	  read-only, i.e. they are only write-allocated via CPU access. This
	  reduces memory consumption at a small performance cost. If unsure,
	  say 'Y'.
```

## drivers/iio/accel/Kconfig
```kconfig
#
# Accelerometer drivers
#
# When adding new entries keep the list in alphabetical order

menu "Accelerometers"

config BMA180
	tristate "Bosch BMA180/BMA250 3-Axis Accelerometer Driver"
	depends on I2C
	select IIO_BUFFER
	select IIO_TRIGGERED_BUFFER
	help
	  Say Y here if you want to build a driver for the Bosch BMA180 or
	  BMA250 triaxial acceleration sensor.

	  To compile this driver as a module, choose M here: the
	  module will be called bma180.

config BMC150_ACCEL
	tristate "Bosch BMC150 Accelerometer Driver"
	depends on I2C
	select IIO_BUFFER
	select IIO_TRIGGERED_BUFFER
	help
	  Say yes here to build support for the following Bosch accelerometers:
	  BMC150, BMI055, BMA250E, BMA222E, BMA255, BMA280.

	  Currently this only supports the device via an i2c interface.

	  This is a combo module with both accelerometer and magnetometer.
	  This driver is only implementing accelerometer part, which has
	  its own address and register map.

config HID_SENSOR_ACCEL_3D
	depends on HID_SENSOR_HUB
	select IIO_BUFFER
	select IIO_TRIGGERED_BUFFER
	select HID_SENSOR_IIO_COMMON
	select HID_SENSOR_IIO_TRIGGER
	tristate "HID Accelerometers 3D"
	help
	  Say yes here to build support for the HID SENSOR
	  accelerometers 3D.

config IIO_ST_ACC33
	tristate "STMicroelectronics LIS3DH/LIS2DH/LSM303AGR Accelerometer driver"
	depends on (I2C || SPI_MASTER) && SYSFS
	select IIO_ST_ACC33_I2C if (I2C)
	select IIO_ST_ACC33_SPI if (SPI_MASTER)
	select IIO_BUFFER
	select IIO_KFIFO_BUF
	help
	  Say yes here to build support for STMicroelectronics accelerometers:
	  LIS3DH, LIS2DH, LSM303AGR.

	  This driver can also be built as a module. If so, will be created
	  these modules:
	  - st_ac33_core (core functions for the driver [it is mandatory]);
	  - st_ac33_i2c (necessary for the I2C devices [optional*]);
	  - st_ac33_spi (necessary for the SPI devices [optional*]);

	  (*) one of these is necessary to do something.

config IIO_ST_ACC33_I2C
	tristate
	depends on IIO_ST_ACC33

config IIO_ST_ACC33_SPI
	tristate
	depends on IIO_ST_ACC33

config IIO_ST_ACCEL_3AXIS
	tristate "STMicroelectronics accelerometers 3-Axis Driver"
	depends on (I2C || SPI_MASTER) && SYSFS
	select IIO_ST_SENSORS_CORE
	select IIO_ST_ACCEL_I2C_3AXIS if (I2C)
	select IIO_ST_ACCEL_SPI_3AXIS if (SPI_MASTER)
	select IIO_TRIGGERED_BUFFER if (IIO_BUFFER)
	help
	  Say yes here to build support for STMicroelectronics accelerometers:
	  LSM303DLH, LSM303DLHC, LIS3DH, LSM330D, LSM330DL, LSM330DLC,
	  LIS331DLH, LSM303DL, LSM303DLM, LSM330.

	  This driver can also be built as a module. If so, these modules
	  will be created:
	  - st_accel (core functions for the driver [it is mandatory]);
	  - st_accel_i2c (necessary for the I2C devices [optional*]);
	  - st_accel_spi (necessary for the SPI devices [optional*]);

	  (*) one of these is necessary to do something.

config IIO_ST_ACCEL_I2C_3AXIS
	tristate
	depends on IIO_ST_ACCEL_3AXIS
	depends on IIO_ST_SENSORS_I2C

config IIO_ST_ACCEL_SPI_3AXIS
	tristate
	depends on IIO_ST_ACCEL_3AXIS
	depends on IIO_ST_SENSORS_SPI

config KXSD9
	tristate "Kionix KXSD9 Accelerometer Driver"
	depends on SPI
	help
	  Say yes here to build support for the Kionix KXSD9 accelerometer.
	  Currently this only supports the device via an SPI interface.

config MMA8452
	tristate "Freescale MMA8452Q Accelerometer Driver"
	depends on I2C
	select IIO_BUFFER
	select IIO_TRIGGERED_BUFFER
	help
	  Say yes here to build support for the Freescale MMA8452Q 3-axis
	  accelerometer.

	  To compile this driver as a module, choose M here: the module
	  will be called mma8452.

config KXCJK1013
	tristate "Kionix 3-Axis Accelerometer Driver"
	depends on I2C
	select IIO_BUFFER
	select IIO_TRIGGERED_BUFFER
	help
	  Say Y here if you want to build a driver for the Kionix KXCJK-1013
	  triaxial acceleration sensor. This driver also supports KXCJ9-1008
	  and KXTJ2-1009.

	  To compile this driver as a module, choose M here: the module will
	  be called kxcjk-1013.

menuconfig IIO_ST_LIS2DS12
	tristate "STMicroelectronics LIS2DS12/LSM303AH Accelerometer Driver"
	depends on (I2C || SPI_MASTER) && SYSFS
	select IIO_BUFFER
	select IIO_TRIGGERED_BUFFER
	select IIO_ST_LIS2DS12_I2C if (I2C)
	select IIO_ST_LIS2DS12_SPI if (SPI)
	help
	  Say yes here to build support for the LIS2DS12 and LSM303AH
	  accelerometers.

if IIO_ST_LIS2DS12
config IIO_ST_LIS2DS12_I2C
	tristate
	depends on IIO_ST_LIS2DS12
	depends on I2C

config IIO_ST_LIS2DS12_SPI
	tristate
	depends on IIO_ST_LIS2DS12
	depends on SPI

config ST_LIS2DS12_IIO_LIMIT_FIFO
	int "Limit fifo read lenght (#n byte)"
	depends on IIO_ST_LIS2DS12
	range 0 1536
	default 0
	help
	  Limit atomic fifo read to #n byte. In some platform i2c/spi read
	  can be limited by software or hardware.

	  Set 0 to disable the limit.

endif #IIO_ST_LIS2DS12

config IIO_ST_LIS2DG
	tristate "STMicroelectronics LIS2DG Accelerometer Driver"
	depends on (I2C || SPI_MASTER) && SYSFS
	select IIO_BUFFER
	select IIO_TRIGGERED_BUFFER
	select IIO_ST_LIS2DS12
	help
	  Say yes here to build support for the LIS2DG accelerometer.

config IIO_ST_LIS2HH12
	tristate "STMicroelectronics LIS2HH12 Accelerometer driver"
	depends on (I2C || SPI_MASTER) && SYSFS
	select IIO_BUFFER
	select IIO_TRIGGERED_BUFFER
	select IIO_ST_LIS2HH12_I2C if (I2C)
	select IIO_ST_LIS2HH12_SPI if (SPI)
	help
	  Say yes here to build support for the LIS2HH12 accelerometer.

config IIO_ST_LIS2HH12_I2C
	tristate
	depends on IIO_ST_LIS2HH12
	depends on I2C

config IIO_ST_LIS2HH12_SPI
	tristate
	depends on IIO_ST_LIS2HH12
	depends on SPI

config IIO_ST_LIS2DW12
	tristate "STMicroelectronics LIS2DW12 Accelerometer Driver"
	depends on (I2C || SPI)
	select IIO_BUFFER
	select IIO_KFIFO_BUF
	select IIO_ST_LIS2DW12_I2C if (I2C)
	select IIO_ST_LIS2DW12_SPI if (SPI)
	help
	  Say yes here to build support for the LIS2DW12 accelerometer.

	  This driver can also be built as a module. If so, will be created
	  these modules:
	  - st_lisdw12 (core functions for the driver [it is mandatory]);
	  - st_lisdw12_i2c (necessary for the I2C devices [optional*]);
	  - st_lisdw12_spi (necessary for the SPI devices [optional*]);

	  (*) one of these is necessary to do something.

config IIO_ST_LIS2DW12_I2C
	tristate
	depends on IIO_ST_LIS2DW12
	depends on I2C

config IIO_ST_LIS2DW12_SPI
	tristate
	depends on IIO_ST_LIS2DW12
	depends on SPI

endmenu
```

## drivers/iio/imu/inv_mpu/Kconfig
```kconfig
#
# inv-mpu-iio driver for Invensense MPU devices
#

config INV_MPU_IIO
	tristate "Invensense ICM20xxx devices"
	depends on (I2C || SPI_MASTER) && SYSFS && IIO && !INV_MPU6050_IIO
	select IIO_BUFFER
	select IIO_KFIFO_BUF
	select IIO_TRIGGER
	select CRC32
	default n
	help
	  This driver supports the Invensense ICM20xxx devices.
	  This driver can be built as a module. The module will be called
	  inv-mpu-iio.

choice
	prompt "Chip name"
	depends on INV_MPU_IIO

config INV_MPU_IIO_ICM20648
	bool "ICM20648/ICM20948"
	help
	  Select this if you are using a ICM20648/ICM20948 chip.

config INV_MPU_IIO_ICM20608D
	bool "ICM20608D/ICM20609/ICM20689"
	help
	  Select this if you are using a ICM20608D/ICM20609/ICM20689 chip.

config INV_MPU_IIO_ICM20602
	bool "ICM20602"
	help
	  Select this if you are using a ICM20602 chip.

config INV_MPU_IIO_ICM20690
	bool "ICM20690"
	help
	  Select this if you are using a ICM20690 chip.

endchoice

config INV_MPU_IIO_I2C
	tristate "Invensense devices on I2C bus"
	depends on INV_MPU_IIO && I2C
	default n
	help
	  This driver supports Invensense devices on I2C bus.
	  This driver can be built as a module. The module will be called
	  inv-mpu-iio-i2c.

config INV_MPU_IIO_SPI
	tristate "Invensense devices on SPI bus"
	depends on INV_MPU_IIO && SPI_MASTER
	default n
	help
	  This driver supports Invensense devices on SPI bus.
	  This driver can be built as a module. The module will be called
	  inv-mpu-iio-spi.

config DTS_INV_MPU_IIO
	bool "Invensense driver using Device Tree Structure (DTS)"
	depends on INV_MPU_IIO
	default n
	help
	  This enables Invensense devices to use Device Tree Structure.
	  DTS must be enabled in the system.

config INV_MPU_DRAGON_IIO
	bool "Invensense driver for Dragon board"
	depends on INV_MPU_IIO
	default n
	help
	  This enables Invensense devices for dragon board platform.

source "drivers/iio/imu/inv_mpu/inv_test/Kconfig"
```

## drivers/iio/power/Kconfig
```kconfig
#
# Power sensors
#
# When adding new entries keep the list in alphabetical order

menu "Power sensors"

config PAC193X
	tristate "Microchip PAC193x Energy Monitor"
	depends on I2C
	help
	  If you say yes here you get support for the Microchip PAC193x
	  Energy Monitor.

	  This driver can also be built as a module.  If so, the module
	  will be called pac193x.

endmenu
```

## drivers/iio/temperature/hts221/Kconfig
```kconfig
config IIO_HTS221
	tristate "STMicroelectronics HTS221 sensor Driver"
	depends on (I2C || SPI) && SYSFS
	select IIO_BUFFER
	select IIO_TRIGGERED_BUFFER
	select IIO_HTS221_I2C if (I2C)
	select IIO_HTS221_SPI if (SPI_MASTER)
	help
	  Say yes here to build support for STMicroelectronics HTS221
	  temperature-humidity sensor

	  To compile this driver as a module, choose M here: the module
	  will be called hts221.

config IIO_HTS221_I2C
	tristate
	depends on IIO_HTS221

config IIO_HTS221_SPI
	tristate
	depends on IIO_HTS221
```

## drivers/input/fingerprint/Kconfig
```kconfig
#
# Fingerprints driver configuration
#
menuconfig INPUT_FINGERPRINT
	bool "FingerPrints"
	help
	  Say Y here, and a list of supported fingerprints will be displayed.
	  This option doesn't affect the kernel.

	  If unsure, say Y.

config GW39A1
        tristate "Goodix GW39A1 fingerprint drvier support"
		depends on SPI
	help
          Say Y here to enable goodix fingerprint driver support
```
