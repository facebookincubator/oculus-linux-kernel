/dts-v1/;
/plugin/;

#include "ukee-cdp.dtsi"
#include "waipio-pm8010-spmi.dtsi"

/ {
	model = "Qualcomm Technologies, Inc. Ukee ATP with PM8010";
	compatible = "qcom,ukee-atp", "qcom,ukee", "qcom,atp";
	qcom,msm-id = <591 0x10000>;
	qcom,board-id = <0x10021 0>;
};
