#include "waipio-vm.dtsi"

/ {
	model = "Qualcomm Technologies, Inc. Cape SVM";
	compatible = "qcom,cape";
	qcom,msm-id = <530 0x10000>, <531 0x10000>, <540 0x10000>;
};

&tlmm {
	compatible = "qcom,cape-vm-pinctrl";
	/* Valid pins */
	gpios = /bits/ 16 <64 65 66 67 0 4 86 87 16 17 18 19 20 21 186>;
};
