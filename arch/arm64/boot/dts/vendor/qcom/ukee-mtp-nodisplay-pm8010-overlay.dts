/dts-v1/;
/plugin/;

#include "ukee-mtp-nodisplay-pm8010.dtsi"

/ {
	model = "Qualcomm Technologies, Inc. Ukee MTP + nodisplay with PM8010";
	compatible = "qcom,ukee-mtp", "qcom,ukee", "qcom,mtp";
	qcom,msm-id = <591 0x10000>;
	qcom,board-id = <0x10008 2>;
};
