/dts-v1/;
/plugin/;

#include "ravelin-rumi.dtsi"

/ {
	model = "Qualcomm Technologies, Inc. Ravelin RUMI";
	compatible = "qcom,ravelin-rumi", "qcom,ravelin", "qcom,rumi";
	qcom,msm-id = <568 0x10000>;
	qcom,board-id = <0x1000F 0>;
};

