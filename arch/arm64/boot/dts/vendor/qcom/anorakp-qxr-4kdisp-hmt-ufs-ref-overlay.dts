/dts-v1/;
/plugin/;

#include "anorakp-qxr-4kdisp-hmt-ufs-ref.dtsi"

/ {
	model = "Qualcomm Technologies, Inc. AnorakP QXR HMT UFS REF + 4K Display";
	compatible = "qcom,anorakp-qxr", "qcom,anorakp";
	qcom,msm-id = <649 0x10000>;
	qcom,board-id = <0x10126 0x3>;
};
