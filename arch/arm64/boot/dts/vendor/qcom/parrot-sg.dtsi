#include "parrot.dtsi"

/ {

	model = "Qualcomm Technologies, Inc. Parrot SG";
	compatible = "qcom,parrot";
	qcom,msm-id = <633 0x10000>;
};

&msm_gpu {
	/delete-property/qcom,gpu-model;
	qcom,gpu-model = "AdrenoA21v1";
};
