/dts-v1/;

#include "ravelin-vm.dtsi"
#include "ravelin-vm-idp.dtsi"

/ {
	model = "Qualcomm Technologies, Inc. Montague VM QRD";
	compatible = "qcom,montague-idp", "qcom,montague", "qcom,idp";
	qcom,board-id = <0x10022 0x4>;
};
