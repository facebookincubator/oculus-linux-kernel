/dts-v1/;
/plugin/;

#include <dt-bindings/clock/qcom,gcc-anorak.h>
#include <dt-bindings/interrupt-controller/arm-gic.h>
#include <dt-bindings/interconnect/qcom,anorak.h>
#include <dt-bindings/regulator/qcom,rpmh-regulator-levels.h>

#include "anorak-audio.dtsi"

/ {
	model = "Qualcomm Technologies, Inc. Anorak SoC";
	compatible = "qcom,anorak";
	qcom,msm-id = <549 0x10000>,<649 0x10000>;
	qcom,board-id = <0 0>;
};
