/dts-v1/;
/plugin/;

#include <dt-bindings/clock/qcom,gcc-neo.h>
#include <dt-bindings/interrupt-controller/arm-gic.h>
#include <dt-bindings/interconnect/qcom,neo.h>
#include <dt-bindings/regulator/qcom,rpmh-regulator-levels.h>

#include "neo-audio.dtsi"

/ {
	model = "Qualcomm Technologies, Inc. Neo SoC";
	compatible = "qcom,neo";
	qcom,msm-id = <525 0x10000>, <554 0x10000>;
	qcom,board-id = <0 0>;
};
