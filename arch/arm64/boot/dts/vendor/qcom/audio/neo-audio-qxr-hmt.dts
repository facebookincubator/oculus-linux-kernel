/dts-v1/;
/plugin/;

#include "neo-audio-qxr.dtsi"

/ {
        model = "Qualcomm Technologies, Inc. NEO QXR HMT";
        compatible = "qcom,neo", "qcom,neo-qxr";
        qcom,msm-id = <525 0x10000>;
        qcom,board-id = <0x10026 1>;
};
