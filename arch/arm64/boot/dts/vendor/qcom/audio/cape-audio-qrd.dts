/dts-v1/;
/plugin/;

#include "cape-audio-qrd.dtsi"
 / {
	model = "Qualcomm Technologies, Inc. Cape LTE Only QRD";
	compatible = "qcom,cape-qrd", "qcom,cape", "qcom,qrd";
	qcom,msm-id = <530 0x10000>, <531 0x10000>, <540 0x10000>;
	qcom,board-id = <0x1000B 0>;
};
