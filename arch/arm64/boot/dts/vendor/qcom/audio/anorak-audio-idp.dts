/dts-v1/;
/plugin/;

#include "anorak-audio-idp.dtsi"

/ {
        model = "Qualcomm Technologies, Inc. Anorak IDP";
        compatible = "qcom,anorak-idp", "qcom,anorak", "qcom,idp", "qcom,anorak-atp", "qcom,atp";
        qcom,msm-id = <549 0x10000>;
        qcom,board-id = <0x10022 0x0>, <0x10022 0x2>, <0x10022 0x1>, <0x10022 0x3>, <0x10021 0x0>, <0x10022 0x4>, <0x10022 0x5>, <0x10022 0x6>;
};
