/dts-v1/;

#include "khajeg.dtsi"
#include "khajeg-qrd.dtsi"
#include "khaje-qrd-pm7250b.dtsi"
#include "khajeg-qrd-hvdcp3p5.dtsi"

/ {
	model = "Qualcomm Technologies, Inc. Khajeg QRD HVDCP3P5";
	compatible = "qcom,khajeg-qrd", "qcom,khajeg", "qcom,qrd";
	qcom,board-id = <0x1010B 0>;
	qcom,pmic-id = <0x2D 0x2E 0x0 0x0>;
};
