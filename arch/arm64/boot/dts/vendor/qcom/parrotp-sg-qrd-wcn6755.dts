/dts-v1/;

#include "parrotp-sg.dtsi"
#include "parrot-wcn6755.dtsi"
#include "parrotp-sg-qrd-wcn6750.dtsi"
#include "parrot-qrd-pm7250b.dtsi"

/ {
	model = "Qualcomm Technologies, Inc. ParrotP SG WCN6755 QRD";
	compatible = "qcom,parrotp-qrd", "qcom,parrotp", "qcom,qrd";
	qcom,board-id = <0x1000B 2>;
};
