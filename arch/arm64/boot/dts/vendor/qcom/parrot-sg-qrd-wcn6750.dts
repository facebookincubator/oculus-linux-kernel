/dts-v1/;

#include "parrot-sg.dtsi"
#include "parrot-wcn6750.dtsi"
#include "parrot-sg-qrd-wcn6750.dtsi"
#include "parrot-qrd-pm7250b.dtsi"

/ {
	model = "Qualcomm Technologies, Inc. Parrot SG WCN6750 QRD";
	compatible = "qcom,parrot-qrd", "qcom,parrot", "qcom,qrd";
	qcom,board-id = <0x1000B 1>;
};
