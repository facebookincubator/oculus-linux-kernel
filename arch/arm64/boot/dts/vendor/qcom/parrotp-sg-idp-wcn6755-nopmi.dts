/dts-v1/;

#include "parrotp-sg.dtsi"
#include "parrot-wcn6755.dtsi"
#include "parrotp-sg-idp.dtsi"

/ {
	model = "Qualcomm Technologies, Inc. ParrotP SG IDP + WCN6755";
	compatible = "qcom,parrotp-idp", "qcom,parrotp", "qcom,idp";
	qcom,board-id = <34 5>;
	qcom,pmic-id-size = <9>;
	qcom,pmic-id = <0x0 0x0 0x0 0x0 0x0 0x0 0x0 0x0 0x0>;
};
