/dts-v1/;

#include "ukee.dtsi"
#include "ukee-cdp-qhd-pm8008.dtsi"

/ {
	model = "Qualcomm Technologies, Inc. Ukee CDP + QHD with PM8008";
	compatible = "qcom,ukee-cdp", "qcom,ukee", "qcom,cdp";
	qcom,board-id = <0x10001 2>;
};
