&soc {
};

&qupv3_se1_i2c {
	status = "ok";
	focaltech@38 {
		compatible = "focaltech,fts_ts";
		reg = <0x38>;
		focaltech,display-coords = <0 0 1080 2408>;
		focaltech,max-touch-number = <5>;
		focaltech,ic-type = <0x8726081C>;
		focaltech,reset-gpio-base = <0xF10C000>;
		focaltech,intr-gpio-base = <0xF10D000>;

		focaltech,trusted-touch-mode = "vm_mode";
		focaltech,touch-environment = "tvm";
		focaltech,trusted-touch-type = "primary";
		focaltech,trusted-touch-spi-irq = <566>;
		focaltech,trusted-touch-io-bases = <0x984000 0x910000>;
		focaltech,trusted-touch-io-sizes = <0x1000 0x4000>;
		focaltech,trusted-touch-vm-gpio-list = <&tlmm 10 0 &tlmm 11 0
						&tlmm 12 0 &tlmm 13 0x2008>;
	};
};
