/dts-v1/;

#include "anorak.dtsi"
#include "anorak-idp-hsp-nodisplay.dtsi"

/ {
	model = "Qualcomm Technologies, Inc. Anorak IDP HSP with no display";
	compatible = "qcom,anorak-idp", "qcom,anorak", "qcom,idp";
	qcom,board-id = <0x10022 0x7>;
};
