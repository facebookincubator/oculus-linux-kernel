/dts-v1/;

#include "parrot-sg.dtsi"
#include "parrot-wcn6755.dtsi"
#include "parrot-sg-idp-wcn6750-amoled-rcm.dtsi"
#include "parrot-idp-pm7250b.dtsi"

/ {
	model = "Qualcomm Technologies, Inc. Parrot SG WCN6755 IDP + AMOLED + RCM";
	compatible = "qcom,parrot-idp", "qcom,parrot", "qcom,idp";
	qcom,board-id = <34 6>;
};
