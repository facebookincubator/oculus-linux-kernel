/dts-v1/;
/plugin/;

#include "ukee-mtp-120fps-pm8008.dtsi"

/ {
	model = "Qualcomm Technologies, Inc. Ukee MTP + 120fps with PM8008";
	compatible = "qcom,ukee-mtp", "qcom,ukee", "qcom,mtp";
	qcom,msm-id = <591 0x10000>;
	qcom,board-id = <0x10008 3>;
};
