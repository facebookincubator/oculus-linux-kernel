/dts-v1/;

#include "ravelinp-4gb.dtsi"
#include "ravelinp-idp-wcn3988-4gb.dtsi"

/ {
	model = "Qualcomm Technologies, Inc. RavelinP IDP 4GB DDR + WCN3988";
	compatible = "qcom,ravelinp-idp", "qcom,ravelinp", "qcom,idp";
	qcom,board-id = <34 0x601>;
};
