/dts-v1/;
/plugin/;

#include "ravelin-idp.dtsi"
#include "ravelin-adrastea.dtsi"

/ {
	model = "Qualcomm Technologies, Inc. Ravelin IDP";
	compatible = "qcom,ravelin-idp", "qcom,ravelin", "qcom,idp";
	qcom,msm-id = <568 0x10000>, <602 0x10000>;
	qcom,board-id = <34 0>;
};
