/dts-v1/;

#include "qrb5165-camslot5.dtsi"

/ {
	model = "Qualcomm Technologies, Inc. qrb5165 IOT RB5 CAMSLOT5";
	compatible = "qcom,kona-iot", "qcom,kona", "qcom,iot";
	qcom,board-id = <0x01020B 0x03>;
};
