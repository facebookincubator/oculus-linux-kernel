/dts-v1/;
/plugin/;

#include "neo-idp-e2e.dtsi"

/ {
	model = "Qualcomm Technologies, Inc. NEO IDP E2E";
	compatible = "qcom,neo-idp", "qcom,neo", "qcom,idp";
	qcom,msm-id = <525 0x10000>;
	qcom,board-id = <34 4>;
};

