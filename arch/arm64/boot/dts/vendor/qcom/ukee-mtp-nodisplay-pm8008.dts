/dts-v1/;

#include "ukee.dtsi"
#include "ukee-mtp-nodisplay-pm8008.dtsi"

/ {
	model = "Qualcomm Technologies, Inc. Ukee MTP + nodisplay with PM8008";
	compatible = "qcom,ukee-mtp", "qcom,ukee", "qcom,mtp";
	qcom,board-id = <0x10008 2>;
};
