/dts-v1/;

#include "parrot-vm.dtsi"
#include "parrot-vm-idp-wcn6750-amoled.dtsi"

/ {
	model = "Qualcomm Technologies, Inc. Parrot VM WCN6750 IDP + AMOLED";
	compatible = "qcom,parrot-idp", "qcom,parrot", "qcom,idp";
	qcom,board-id = <34 4>;
};
