&soc {
};

&qupv3_se9_i2c {
	status = "ok";
	novatek@62 {
		compatible = "novatek,NVT-ts";
		reg = <0x62>;
		novatek,trusted-touch-mode = "vm_mode";
		novatek,touch-environment = "tvm";
		novatek,trusted-touch-spi-irq = <566>;
		novatek,trusted-touch-io-bases = <0xa8c000 0xa10000>;
		novatek,trusted-touch-io-sizes = <0x1000 0x4000>;
		novatek,trusted-touch-vm-gpio-list = <&tlmm 10 0 &tlmm 11 0
						&tlmm 12 0 &tlmm 13 0x2008>;
	};
};
