/dts-v1/;

#include "montaguep.dtsi"
#include "montaguep-hsp.dtsi"

/ {
	model = "Qualcomm Technologies, Inc. Montaguep HSP IDP";
	compatible = "qcom,montaguep-idp", "qcom,montaguep", "qcom,idp";
	qcom,board-id = <0x10022 0x4>;
};

