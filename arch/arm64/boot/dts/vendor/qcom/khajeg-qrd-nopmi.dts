/dts-v1/;

#include "khajeg.dtsi"
#include "khajeg-qrd-nopmi.dtsi"

/ {
	model = "Qualcomm Technologies, Inc. Khajeg QRD nopmi";
	compatible = "qcom,khajeg-qrd", "qcom,khajeg", "qcom,qrd";
	qcom,board-id = <0x1000B 0>;
	qcom,pmic-id = <0x2D 0x0 0x0 0x0>;
};
