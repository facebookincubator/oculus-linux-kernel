/dts-v1/;

#include "anorakp.dtsi"
#include "anorakp-qxr-hmt.dtsi"

/ {
	model = "Qualcomm Technologies, Inc. AnorakP QXR HMT";
	compatible = "qcom,anorakp-qxr", "qcom,anorakp";
	qcom,board-id = <0x10026 0x1>;
};
