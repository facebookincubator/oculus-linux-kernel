/dts-v1/;

#include "ravelin-sg.dtsi"
#include "ravelin-adrastea.dtsi"
#include "ravelin-sg-idp.dtsi"

/ {
	model = "Qualcomm Technologies, Inc. Ravelin SG IDP";
	compatible = "qcom,ravelin-idp", "qcom,ravelin", "qcom,idp";
	qcom,board-id = <34 0>;
};

