/dts-v1/;

#include "ravelin-sg.dtsi"
#include "ravelin-sg-qrd.dtsi"

/ {
	model = "Qualcomm Technologies, Inc. Ravelin SG QRD";
	compatible = "qcom,ravelin-qrd", "qcom,ravelin", "qcom,qrd";
	qcom,board-id = <0x1000B 0>;
};


