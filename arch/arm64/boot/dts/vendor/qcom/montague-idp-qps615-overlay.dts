/dts-v1/;
/plugin/;

#include "montague-idp-qps615.dtsi"

/ {
	model = "Qualcomm Technologies, Inc. Montague IDP QPS615";
	compatible = "qcom,montague-idp", "qcom,montague", "qcom,idp";
	qcom,msm-id = <581 0x10000>, <582 0x10000>;
	qcom,board-id = <0x10022 0x9>;
};
