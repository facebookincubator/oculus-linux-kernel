/dts-v1/;

#include "ukee.dtsi"
#include "ukee-cdp.dtsi"
#include "waipio-pm8010-spmi.dtsi"

/ {
	model = "Qualcomm Technologies, Inc. Ukee ATP with PM8010";
	compatible = "qcom,ukee-atp", "qcom,ukee", "qcom,atp";
	qcom,board-id = <0x10021 0>;
};
