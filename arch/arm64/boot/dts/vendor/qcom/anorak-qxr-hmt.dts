/dts-v1/;

#include "anorak.dtsi"
#include "anorak-qxr-hmt.dtsi"

/ {
	model = "Qualcomm Technologies, Inc. Anorak QXR HMT";
	compatible = "qcom,anorak-qxr", "qcom,anorak";
	qcom,board-id = <0x10026 0x1>;
};
