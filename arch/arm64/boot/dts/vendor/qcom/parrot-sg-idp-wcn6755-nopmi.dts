/dts-v1/;

#include "parrot-sg.dtsi"
#include "parrot-wcn6755.dtsi"
#include "parrot-sg-idp.dtsi"

/ {
	model = "Qualcomm Technologies, Inc. Parrot SG IDP + WCN6755";
	compatible = "qcom,parrot-idp", "qcom,parrot", "qcom,idp";
	qcom,board-id = <34 5>;
	qcom,pmic-id-size = <9>;
	qcom,pmic-id = <0x0 0x0 0x0 0x0 0x0 0x0 0x0 0x0 0x0>;
};
