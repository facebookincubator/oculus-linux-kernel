/dts-v1/;

#include "kona-iot-v2.1.dtsi"
#include "kona-iot-v2.1-vc.dtsi"

/ {
	model = "Qualcomm Technologies, Inc. kona-iot VC";
	compatible = "qcom,kona-iot-hdk", "qcom,kona-iot", "qcom,hdk";
	qcom,board-id = <0x010020 0x07>;
};
