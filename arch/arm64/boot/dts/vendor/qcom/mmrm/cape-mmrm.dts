/dts-v1/;
/plugin/;

#include <dt-bindings/clock/qcom,camcc-waipio.h>
#include <dt-bindings/clock/qcom,videocc-waipio.h>
#include <dt-bindings/clock/qcom,dispcc-waipio.h>
#include "cape-mmrm.dtsi"

/ {
	model = "Qualcomm Technologies, Inc. Cape/Ukee SoC";
	compatible = "qcom,cape", "qcom,ukee";
	qcom,msm-id = <530 0x10000>, <531 0x10000>, <540 0x10000>, <591 0x10000>;
	qcom,board-id = <0 0>; /* required by merge_dtbs.py */
};
