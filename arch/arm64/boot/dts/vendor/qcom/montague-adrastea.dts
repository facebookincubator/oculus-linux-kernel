/dts-v1/;


#include "montague.dtsi"
#include "montague-adrastea.dtsi"

/ {
	model = "Qualcomm Technologies, Inc. Montague Adrastea IDP";
	compatible = "qcom,montague-idp", "qcom,montague", "qcom,idp";
	qcom,board-id = <0x10022 0x0>;
};
