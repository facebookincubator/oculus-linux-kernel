/dts-v1/;

#include "anorakp.dtsi"
#include "anorakp-idp-sd.dtsi"

/ {
	model = "Qualcomm Technologies, Inc. AnorakP IDP Single Display";
	compatible = "qcom,anorakp-idp", "qcom,anorakp", "qcom,idp";
	qcom,board-id = <0x10022 0x2>;
};
