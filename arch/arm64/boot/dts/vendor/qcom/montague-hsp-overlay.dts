/dts-v1/;
/plugin/;

#include "montague-hsp.dtsi"

/ {
	model = "Qualcomm Technologies, Inc. Montague HSP IDP";
	compatible = "qcom,montague-idp", "qcom,montague", "qcom,idp";
	qcom,msm-id = <581 0x10000>, <582 0x10000>;
	qcom,board-id = <0x10022 0x4>;
};

&reserved_memory {
	wlan_msa_mem: wlan_msa_mem_region@82a00000 {
		no-map;
		reg = <0x0 0x82a00000 0x0 0x0>;
	};
};
