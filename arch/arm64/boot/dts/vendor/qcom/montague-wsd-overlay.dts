/dts-v1/;
/plugin/;

#include "montague-wsd.dtsi"

/ {
	model = "Qualcomm Technologies, Inc. Montague WSD IDP";
	compatible = "qcom,montague-idp", "qcom,montague", "qcom,idp";
	qcom,msm-id = <581 0x10000>, <582 0x10000>;
	qcom,board-id = <0x10022 0x6>;
};
