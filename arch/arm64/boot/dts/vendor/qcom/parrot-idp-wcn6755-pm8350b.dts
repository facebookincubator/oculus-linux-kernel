/dts-v1/;

#include "parrot.dtsi"
#include "parrot-wcn6755.dtsi"
#include "parrot-idp.dtsi"
#include "parrot-idp-pm8350b.dtsi"

/ {
	model = "Qualcomm Technologies, Inc. Parrot IDP + WCN6755";
	compatible = "qcom,parrot-idp", "qcom,parrot", "qcom,idp";
	qcom,board-id = <34 5>;
};
