/dts-v1/;

#include "ravelin-4gb.dtsi"
#include "ravelin-sg-idp-wcn3988-4gb.dtsi"

/ {
	model = "Qualcomm Technologies, Inc. Ravelin SG IDP 4GB DDR + WCN3988";
	compatible = "qcom,ravelin-idp", "qcom,ravelin", "qcom,idp";
	qcom,board-id = <34 0x601>;
};
