/dts-v1/;

#include "parrot-vm.dtsi"
#include "parrot-vm-idp-wcn3990-amoled-rcm.dtsi"

/ {
	model = "Qualcomm Technologies, Inc. Parrot WCN3990 VM IDP + AMOLED + RCM";
	compatible = "qcom,parrot-idp", "qcom,parrot", "qcom,idp";
	qcom,board-id = <34 3>;
};
