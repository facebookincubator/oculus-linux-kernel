/dts-v1/;
/plugin/;

#include "foreseer-qxr-hmt.dtsi"

/ {
	model = "Qualcomm Technologies, Inc. Foreseer QXR HMT";
	compatible = "qcom,neo", "qcom,neo-qxr";
	qcom,msm-id = <525 0x10000>;
	qcom,board-id = <0x10026 0x3>;
};
