/dts-v1/;
/plugin/;

#include "ravelin-qrd.dtsi"

/ {
	model = "Qualcomm Technologies, Inc. Ravelin QRD";
	compatible = "qcom,ravelin-qrd", "qcom,ravelin", "qcom,qrd";
	qcom,msm-id = <568 0x10000>, <602 0x10000>, <581 0x10000>, <582 0x10000>;
	qcom,board-id = <0x1000B 0>;
};

