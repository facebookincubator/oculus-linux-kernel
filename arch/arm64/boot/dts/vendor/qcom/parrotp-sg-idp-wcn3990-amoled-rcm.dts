/dts-v1/;

#include "parrotp-sg.dtsi"
#include "parrot-wcn3990.dtsi"
#include "parrotp-sg-idp-wcn3990-amoled-rcm.dtsi"
#include "parrot-idp-pm7250b.dtsi"

/ {
	model = "Qualcomm Technologies, Inc. ParrotP SG WCN3990 IDP + AMOLED + RCM";
	compatible = "qcom,parrotp-idp", "qcom,parrotp", "qcom,idp";
	qcom,board-id = <34 3>;
};
