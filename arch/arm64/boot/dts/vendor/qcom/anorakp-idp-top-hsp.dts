/dts-v1/;

#include "anorakp.dtsi"
#include "anorakp-idp-top-hsp.dtsi"

/ {
	model = "Qualcomm Technologies, Inc. AnorakP IDP Topanga with EDP display + HSP";
	compatible = "qcom,anorakp-idp", "qcom,anorakp", "qcom,idp";
	qcom,board-id = <0x10022 0x4>;
};
