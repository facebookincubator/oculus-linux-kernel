/dts-v1/;

#include "parrot-sg.dtsi"
#include "parrot-wcn3990.dtsi"
#include "parrot-sg-atp.dtsi"

/ {
	model = "Qualcomm Technologies, Inc. Parrot SG ATP";
	compatible = "qcom,parrot-atp", "qcom,parrot", "qcom,atp";
	qcom,board-id = <33 0>;
};
