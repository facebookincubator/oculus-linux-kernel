/dts-v1/;
/plugin/;

#include <dt-bindings/interrupt-controller/arm-gic.h>
#include <dt-bindings/clock/qcom,gcc-monaco.h>
#include <dt-bindings/interconnect/qcom,monaco.h>
#include <dt-bindings/clock/qcom,gpucc-monaco.h>
#include "monaco-vidc.dtsi"

/ {
	model = "Qualcomm Technologies, Inc. monaco SoC";
	compatible = "qcom,monaco";
	qcom,msm-id = <486 0x10000>, <517 0x10000>;
	qcom,board-id = <0 0>;
};

