/dts-v1/;
/plugin/;

#include <dt-bindings/interrupt-controller/arm-gic.h>
#include <dt-bindings/clock/qcom,gcc-sm6115.h>
#include <dt-bindings/interconnect/qcom,bengal.h>
#include <dt-bindings/clock/qcom,sm6115-gpucc.h>
#include "khaje-vidc.dtsi"

/ {
	model = "Qualcomm Technologies, Inc. Bengal SoC";
	compatible = "qcom,bengal";
	qcom,msm-id = <417 0x10000>, <444 0x10000>, <469 0x10000>, <469 0x0>, <470 0x10000>, <470 0x0>;
	qcom,board-id = <0 0>;
};
