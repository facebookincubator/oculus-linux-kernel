/dts-v1/;
/plugin/;

#include <dt-bindings/interrupt-controller/arm-gic.h>
#include <dt-bindings/clock/qcom,gcc-anorak.h>
#include <dt-bindings/interconnect/qcom,anorak.h>
#include <dt-bindings/clock/qcom,videocc-anorak.h>
#include "anorak-vidc.dtsi"

/ {
	model = "Qualcomm Technologies, Inc. Anorak";
	compatible = "qcom,anorak";
	qcom,msm-id = <549 0x10000>;
	qcom,board-id = <0 0>, <0x10021 0x0>, <0x10022 0x0>, <0x10026 0x0>,
			<0x10022 0x1>, <0x10022 0x2>, <0x10022 0x3>, <0x10022 0x4>,
			<0x10022 0x5>, <0x10022 0x6>, <0x10022 0x7>, <0x10026 0x1>,
			<0x10126 0x2>, <0x10126 0x3>;
};
