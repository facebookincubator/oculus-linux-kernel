/dts-v1/;
/plugin/;

#include <dt-bindings/interrupt-controller/arm-gic.h>
#include <dt-bindings/clock/qcom,gcc-diwali.h>
#include <dt-bindings/interconnect/qcom,diwali.h>
#include <dt-bindings/clock/qcom,videocc-diwali.h>
#include "diwali-vidc.dtsi"

/ {
	model = "Qualcomm Technologies, Inc. Diwali SoC";
	compatible = "qcom,diwali";
	qcom,msm-id = <506 0x10000> , <547 0x10000>, <564 0x10000>;
	qcom,board-id = <0 0>, <0 2>;
};
