/dts-v1/;
/plugin/;

#include <dt-bindings/interrupt-controller/arm-gic.h>
#include <dt-bindings/clock/qcom,gcc-khaje.h>
#include <dt-bindings/interconnect/qcom,bengal.h>
#include <dt-bindings/clock/qcom,gpucc-khaje.h>
#include "khaje-vidc-iot.dtsi"

/ {
	model = "Qualcomm Technologies, Inc. Khaje IOT SoC";
	compatible = "qcom,khaje";
	qcom,msm-id = <586 0x10000>;
	qcom,board-id = <0 0>, <0 0x500>;
};
