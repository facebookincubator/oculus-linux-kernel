/dts-v1/;
/plugin/;

#include <dt-bindings/interrupt-controller/arm-gic.h>
#include <dt-bindings/clock/qcom,gcc-scuba.h>
#include <dt-bindings/interconnect/qcom,scuba.h>
//#include <dt-bindings/clock/qcom,gpucc-scuba.h>
#include "scuba-vidc.dtsi"

/ {
	model = "Qualcomm Technologies, Inc. Scuba SoC";
	compatible = "qcom,scuba";
	qcom,msm-id = <441 0x10000>, <473 0x10000>, <474 0x10000>;
	qcom,board-id = <0 0>, <34 0>;
};
