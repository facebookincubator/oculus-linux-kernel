/dts-v1/;
/plugin/;

#include <dt-bindings/interrupt-controller/arm-gic.h>
#include <dt-bindings/clock/qcom,gcc-waipio.h>
#include <dt-bindings/interconnect/qcom,waipio.h>
#include <dt-bindings/clock/qcom,videocc-waipio.h>
#include "waipio-vidc.dtsi"

/ {
	model = "Qualcomm Technologies, Inc. ukee v1 SoC";
	compatible = "qcom,ukee";
	qcom,msm-id = <591 0x10000>;
	qcom,board-id = <0 0>;
};

&msm_vidc {
	compatible = "qcom,msm-vidc", "qcom,msm-vidc-waipio", "qcom,msm-vidc-iris2", "qcom,msm-vidc-ukee";
};
