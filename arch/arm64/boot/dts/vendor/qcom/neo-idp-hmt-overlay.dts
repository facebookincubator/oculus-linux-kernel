/dts-v1/;
/plugin/;

#include "neo-idp-hmt.dtsi"

/ {
	model = "Qualcomm Technologies, Inc. NEO IDP";
	compatible = "qcom,neo-idp", "qcom,neo", "qcom,idp";
	qcom,msm-id = <525 0x10000>;
	qcom,board-id = <34 1>;
};
