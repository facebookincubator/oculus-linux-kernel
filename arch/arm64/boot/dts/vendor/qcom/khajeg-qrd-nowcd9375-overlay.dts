/dts-v1/;
/plugin/;

#include <dt-bindings/interrupt-controller/arm-gic.h>
#include "khajeg-qrd.dtsi"
#include "khaje-qrd-pm7250b.dtsi"
#include "khajeg-qrd-nowcd9375.dtsi"

/ {
	model = "Qualcomm Technologies, Inc. Khajeg QRD NOWCD9375";
	compatible = "qcom,khajeg-qrd", "qcom,khajeg", "qcom,qrd";
	qcom,msm-id = <585 0x10000>;
	qcom,board-id = <0x2010B 0>;
	qcom,pmic-id = <0x2D 0x2E 0x0 0x0>;
};
