/dts-v1/;

#include "montaguep.dtsi"
#include "montaguep-idp-qps615.dtsi"

/ {
	model = "Qualcomm Technologies, Inc. Montague IDP QPS615";
	compatible = "qcom,montague-idp", "qcom,montague", "qcom,idp";
	qcom,board-id = <0x10022 0x9>;
};
