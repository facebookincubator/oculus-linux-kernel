/dts-v1/;

#include "neo_luna-v2.dtsi"
#include "neo_luna-v2-sg-idp-dual-display.dtsi"

/ {
	model = "Qualcomm Technologies, Inc. NEO LUNA-V2 SG IDP DD";
	compatible = "qcom,neo-idp", "qcom,neo", "qcom,idp";
	qcom,board-id = <34 2>;
};

