/dts-v1/;
/plugin/;

#include "ravelin-atp.dtsi"

/ {
	model = "Qualcomm Technologies, Inc. Ravelin ATP";
	compatible = "qcom,ravelin-atp", "qcom,ravelin", "qcom,atp";
	qcom,msm-id = <568 0x10000>, <602 0x10000>;
	qcom,board-id = <33 0>;
};
