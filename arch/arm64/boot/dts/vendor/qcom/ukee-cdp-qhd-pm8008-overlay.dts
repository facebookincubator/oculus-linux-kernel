/dts-v1/;
/plugin/;

#include "ukee-cdp-qhd-pm8008.dtsi"

/ {
	model = "Qualcomm Technologies, Inc. Ukee CDP + QHD with PM8008";
	compatible = "qcom,ukee-cdp", "qcom,ukee", "qcom,cdp";
	qcom,msm-id = <591 0x10000>;
	qcom,board-id = <0x10001 2>;
};
