/dts-v1/;

#include "neo_la.dtsi"
#include "neo-sg-idp-pm8008.dtsi"

/ {
	model = "Qualcomm Technologies, Inc. Neo SG IDP";
	compatible = "qcom,neo-idp", "qcom,neo", "qcom,idp";
	qcom,board-id = <34 3>;
};

