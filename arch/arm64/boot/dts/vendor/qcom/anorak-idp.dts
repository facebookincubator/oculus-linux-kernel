/dts-v1/;

#include "anorak.dtsi"
#include "anorak-idp.dtsi"

/ {
	model = "Qualcomm Technologies, Inc. Anorak IDP";
	compatible = "qcom,anorak-idp", "qcom,anorak", "qcom,idp";
	qcom,board-id = <0x10022 0x0>;
};
