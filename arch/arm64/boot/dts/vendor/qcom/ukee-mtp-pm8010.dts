/dts-v1/;

#include "ukee.dtsi"
#include "ukee-mtp.dtsi"
#include "waipio-pm8010-spmi.dtsi"

/ {
	model = "Qualcomm Technologies, Inc. Ukee MTP with PM8010";
	compatible = "qcom,ukee-mtp", "qcom,ukee", "qcom,mtp";
	qcom,board-id = <0x10008 0>;
};
