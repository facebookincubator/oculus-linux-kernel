/dts-v1/;
/plugin/;

#include "neo-qxr-e2e.dtsi"

/ {
	model = "Qualcomm Technologies, Inc. NEO QXR E2E";
	compatible = "qcom,neo", "qcom,neo-qxr";
	qcom,msm-id = <525 0x10000>;
	qcom,board-id = <0x10026 0x2>;
};
