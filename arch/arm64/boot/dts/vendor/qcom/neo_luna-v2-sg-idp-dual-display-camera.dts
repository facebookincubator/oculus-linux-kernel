/dts-v1/;

#include "neo_luna-v2.dtsi"
#include "neo_luna-v2-sg-idp-dual-display-camera.dtsi"

/ {
	model = "Qualcomm Technologies, Inc. NEO LUNA-V2 SG IDP DD CAMERA";
	compatible = "qcom,neo-idp", "qcom,neo", "qcom,idp";
	qcom,board-id = <34 5>;
};

