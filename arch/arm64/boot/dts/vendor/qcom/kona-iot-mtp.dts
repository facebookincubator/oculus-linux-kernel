/dts-v1/;

#include "kona-iot.dtsi"
#include "kona-iot-mtp.dtsi"

/ {
	model = "Qualcomm Technologies, Inc. kona-iot MTP";
	compatible = "qcom,kona-iot-mtp", "qcom,kona-iot", "qcom,mtp";
	qcom,board-id = <0x10008 0>;
};
