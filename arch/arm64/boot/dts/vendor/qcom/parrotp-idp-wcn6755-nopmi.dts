/dts-v1/;

#include "parrotp.dtsi"
#include "parrot-wcn6755.dtsi"
#include "parrotp-idp.dtsi"

/ {
	model = "Qualcomm Technologies, Inc. ParrotP IDP + WCN6755";
	compatible = "qcom,parrotp-idp", "qcom,parrotp", "qcom,idp";
	qcom,board-id = <34 5>;
	qcom,pmic-id-size = <9>;
	qcom,pmic-id = <0x0 0x0 0x0 0x0 0x0 0x0 0x0 0x0 0x0>;
};
