/dts-v1/;
/plugin/;

#include "ukee-atp.dtsi"
#include "waipio-pm8008.dtsi"

/ {
	model = "Qualcomm Technologies, Inc. Ukee ATP with PM8008";
	compatible = "qcom,ukee-atp", "qcom,ukee", "qcom,atp";
	qcom,msm-id = <591 0x10000>;
	qcom,board-id = <0x10021 0>;
};
