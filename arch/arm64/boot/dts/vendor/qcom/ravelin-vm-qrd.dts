/dts-v1/;

#include "ravelin-vm.dtsi"
#include "ravelin-vm-qrd.dtsi"

/ {
	model = "Qualcomm Technologies, Inc. Ravelin VM QRD";
	compatible = "qcom,ravelin-qrd", "qcom,ravelin", "qcom,qrd";
	qcom,board-id = <0x1000B 0>;
};
