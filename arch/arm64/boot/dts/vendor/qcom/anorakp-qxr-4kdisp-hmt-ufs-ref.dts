/dts-v1/;

#include "anorakp.dtsi"
#include "anorakp-qxr-4kdisp-hmt-ufs-ref.dtsi"

/ {
	model = "Qualcomm Technologies, Inc. AnorakP QXR HMT UFS REF + 4K Display";
	compatible = "qcom,anorakp-qxr", "qcom,anorakp";
	qcom,board-id = <0x10126 0x3>;
};
