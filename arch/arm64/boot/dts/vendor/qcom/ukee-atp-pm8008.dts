/dts-v1/;

#include "ukee.dtsi"
#include "ukee-atp.dtsi"
#include "waipio-pm8008.dtsi"

/ {
	model = "Qualcomm Technologies, Inc. Ukee ATP with PM8008";
	compatible = "qcom,ukee-atp", "qcom,ukee", "qcom,atp";
	qcom,board-id = <0x10021 0>;
};
