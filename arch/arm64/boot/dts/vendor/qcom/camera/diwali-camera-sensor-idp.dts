/dts-v1/;
/plugin/;

#include <dt-bindings/clock/qcom,gcc-diwali.h>
#include <dt-bindings/clock/qcom,camcc-diwali.h>
#include <dt-bindings/interconnect/qcom,diwali.h>
#include <dt-bindings/interrupt-controller/arm-gic.h>
#include <dt-bindings/regulator/qcom,rpmh-regulator-levels.h>

#include "diwali-camera-sensor-idp.dtsi"
/ {
	model = "Qualcomm Technologies, Inc. Diwali IDP";
	compatible = "qcom,diwali";
	qcom,msm-id = <506 0x10000>;
	qcom,board-id = <34 0>, <34 3>;
};