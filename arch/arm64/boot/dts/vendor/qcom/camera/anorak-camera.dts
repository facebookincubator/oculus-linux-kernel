/dts-v1/;
/plugin/;

#include <dt-bindings/clock/qcom,gcc-anorak.h>
#include <dt-bindings/clock/qcom,camcc-anorak.h>
#include <dt-bindings/interconnect/qcom,anorak.h>
#include <dt-bindings/interrupt-controller/arm-gic.h>
#include <dt-bindings/regulator/qcom,rpmh-regulator-levels.h>

#include "anorak-camera.dtsi"
/ {
	model = "Qualcomm Technologies, Inc. Anorak";
	compatible = "qcom,anorak";
	qcom,msm-id = <549 0x10000>;
	qcom,board-id = <0 0>;
};
