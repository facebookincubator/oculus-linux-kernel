/dts-v1/;
/plugin/;

#include <dt-bindings/clock/qcom,gcc-diwali.h>
#include <dt-bindings/clock/qcom,camcc-diwali.h>
#include <dt-bindings/interconnect/qcom,diwali.h>
#include <dt-bindings/interrupt-controller/arm-gic.h>
#include <dt-bindings/regulator/qcom,rpmh-regulator-levels.h>

#include "diwali-camera.dtsi"
/ {
	model = "Qualcomm Technologies, Inc. Diwali v1 SoC";
	compatible = "qcom,diwali";
	qcom,msm-id = <506 0x10000>;
	qcom,board-id = <0 0>;
};
