/dts-v1/;
/plugin/;

#include "montague-rcm.dtsi"

/ {
	model = "Qualcomm Technologies, Inc. Montague RCM IDP";
	compatible = "qcom,montague-qrd", "qcom,montague", "qcom,idp";
	qcom,msm-id = <581 0x10000>, <582 0x10000>;
	qcom,board-id = <0x10022 0x5>;
};

