/dts-v1/;

#include "montaguep.dtsi"
#include "montaguep-moselle.dtsi"

/ {
	model = "Qualcomm Technologies, Inc. Montaguep Moselle IDP";
	compatible = "qcom,montaguep-idp", "qcom,montaguep", "qcom,idp";
	qcom,board-id = <0x10022 3>;
};

