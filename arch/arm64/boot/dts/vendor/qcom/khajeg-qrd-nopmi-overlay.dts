/dts-v1/;
/plugin/;

#include <dt-bindings/interrupt-controller/arm-gic.h>
#include "khajeg-qrd-nopmi.dtsi"

/ {
	model = "Qualcomm Technologies, Inc. Khajeg QRD nopmi overlay";
	compatible = "qcom,khajeg-qrd", "qcom,khajeg", "qcom,qrd";
	qcom,msm-id = <585 0x10000>;
	qcom,board-id = <0x1000B 0>;
	qcom,pmic-id = <0x2D 0x0 0x0 0x0>;
};
