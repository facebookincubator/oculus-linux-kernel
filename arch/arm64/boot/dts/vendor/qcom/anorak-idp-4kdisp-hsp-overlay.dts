/dts-v1/;
/plugin/;

#include "anorak-idp-4kdisp-hsp.dtsi"

/ {
	model = "Qualcomm Technologies, Inc. Anorak IDP 4K display + HSP";
	compatible = "qcom,anorak-idp", "qcom,anorak", "qcom,idp";
	qcom,msm-id = <549 0x10000>;
	qcom,board-id = <0x10022 0x5>;
};
