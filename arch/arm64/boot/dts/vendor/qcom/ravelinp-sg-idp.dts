/dts-v1/;

#include "ravelinp-sg.dtsi"
#include "ravelin-adrastea.dtsi"
#include "ravelinp-sg-idp.dtsi"

/ {
	model = "Qualcomm Technologies, Inc. RavelinP SG IDP";
	compatible = "qcom,ravelinp-idp", "qcom,ravelinp", "qcom,idp";
	qcom,board-id = <34 0>;
};

