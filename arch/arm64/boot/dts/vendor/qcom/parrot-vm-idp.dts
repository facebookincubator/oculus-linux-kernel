/dts-v1/;

#include "parrot-vm.dtsi"
#include "parrot-vm-idp.dtsi"

/ {
	model = "Qualcomm Technologies, Inc. Parrot SVM IDP";
	compatible = "qcom,parrot-idp", "qcom,parrot", "qcom,idp";
	qcom,board-id = <34 0>;
};
