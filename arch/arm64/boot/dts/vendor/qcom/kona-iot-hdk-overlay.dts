/dts-v1/;
/plugin/;

#include <dt-bindings/clock/qcom,gcc-kona.h>
#include <dt-bindings/clock/qcom,camcc-kona.h>
#include <dt-bindings/clock/qcom,rpmh.h>
#include <dt-bindings/interrupt-controller/arm-gic.h>

#include "kona-iot-hdk.dtsi"

/ {
	model = "Qualcomm Technologies, Inc. kona-iot HDK";
	compatible = "qcom,kona-iot-hdk", "qcom,kona-iot", "qcom,hdk";
	qcom,board-id = <0x01001F 0x01>;
};
