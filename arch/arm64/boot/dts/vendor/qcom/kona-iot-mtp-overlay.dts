/dts-v1/;
/plugin/;

#include <dt-bindings/clock/qcom,gcc-kona.h>
#include <dt-bindings/clock/qcom,camcc-kona.h>
#include <dt-bindings/clock/qcom,rpmh.h>
#include <dt-bindings/interrupt-controller/arm-gic.h>

#include "kona-iot-mtp.dtsi"

/ {
	model = "Qualcomm Technologies, Inc. kona-iot MTP";
	compatible = "qcom,kona-iot-mtp", "qcom,kona-iot", "qcom,mtp";
	qcom,board-id = <0x10008 0>;
};

