/dts-v1/;

#include "ukee.dtsi"
#include "ukee-mtp-120fps-pm8010.dtsi"

/ {
	model = "Qualcomm Technologies, Inc. Ukee MTP + 120fps with PM8010";
	compatible = "qcom,ukee-mtp", "qcom,ukee", "qcom,mtp";
	qcom,board-id = <0x10008 3>;
};
