/dts-v1/;

#include "ukee.dtsi"
#include "ukee-mtp.dtsi"
#include "waipio-pm8008.dtsi"

/ {
	model = "Qualcomm Technologies, Inc. Ukee MTP with PM8008";
	compatible = "qcom,ukee-mtp", "qcom,ukee", "qcom,mtp";
	qcom,board-id = <0x10008 0>;
};
