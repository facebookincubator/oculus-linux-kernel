/dts-v1/;

#include "anorakp.dtsi"
#include "anorakp-idp.dtsi"

/ {
	model = "Qualcomm Technologies, Inc. AnorakP IDP";
	compatible = "qcom,anorakp-idp", "qcom,anorakp", "qcom,idp";
	qcom,board-id = <0x10022 0x0>;
};
