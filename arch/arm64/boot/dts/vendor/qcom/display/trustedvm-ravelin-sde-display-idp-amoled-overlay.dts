/dts-v1/;
/plugin/;

#include "trustedvm-ravelin-sde.dtsi"
#include "trustedvm-ravelin-sde-display-idp-amoled.dtsi"

/ {
	model = "Qualcomm Technologies, Inc. Ravelin VM WCN3950 IDP + AMOLED + RCM";
	compatible = "qcom,ravelin-idp", "qcom,ravelin", "qcom,idp";
	qcom,msm-id = <568 0x10000>, <581 0x10000>, <582 0x10000>, <653 0x10000>, <654 0x10000>;
	qcom,board-id = <34 2>;
};
