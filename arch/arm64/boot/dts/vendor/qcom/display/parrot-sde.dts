/dts-v1/;
/plugin/;

#include "parrot-sde.dtsi"

/ {
	qcom,msm-id = <537 0x10000>, <583 0x10000>, <613 0x10000>, <631 0x10000>, <633 0x10000>, <634 0x10000>, <638 0x10000>, <663 0x10000>;
	qcom,board-id = <0 0>, <0 0x600>;
};
