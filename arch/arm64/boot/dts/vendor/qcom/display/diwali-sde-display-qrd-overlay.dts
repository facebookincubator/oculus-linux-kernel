/dts-v1/;
/plugin/;

#include "diwali-sde-display-qrd.dtsi"

/ {
	model = "Qualcomm Technologies, Inc. Diwali QRD";
	compatible = "qcom,diwali-qrd", "qcom,diwali", "qcom,qrd";
	qcom,msm-id = <506 0x10000>, <547 0x10000>, <564 0x10000>;
	qcom,board-id = <0x1000B 0>;
};
