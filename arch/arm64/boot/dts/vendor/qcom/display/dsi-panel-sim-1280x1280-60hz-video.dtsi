&mdss_mdp {
	dsi_sim_1280x1280_60hz_video: qcom,mdss_dsi_sim_1280x1280_60hz_video {
		qcom,mdss-dsi-panel-name =
			"sim video mode dsi panel without DSC";
		qcom,mdss-dsi-panel-type = "dsi_video_mode";
		qcom,mdss-dsi-panel-physical-type = "oled";
		qcom,mdss-dsi-virtual-channel-id = <0>;
		qcom,mdss-dsi-stream = <0>;
		qcom,mdss-dsi-bpp = <24>;
		qcom,mdss-dsi-border-color = <0>;
		qcom,dsi-ctrl-num = <0>;
		qcom,dsi-phy-num = <0>;
		qcom,dsi-sec-ctrl-num = <1>;
		qcom,dsi-sec-phy-num = <1>;
		qcom,mdss-dsi-traffic-mode = "non_burst_sync_event";
		qcom,mdss-dsi-bllp-eof-power-mode;
		qcom,mdss-dsi-bllp-power-mode;
		qcom,mdss-dsi-lane-0-state;
		qcom,mdss-dsi-lane-1-state;
		qcom,mdss-dsi-lane-2-state;
		qcom,mdss-dsi-lane-3-state;
		qcom,mdss-dsi-dma-trigger = "trigger_sw";
		qcom,mdss-dsi-mdp-trigger = "none";
		qcom,mdss-dsi-reset-sequence = <1 10>, <0 10>, <1 20>;
		qcom,mdss-dsi-te-using-wd;

		qcom,mdss-dsi-display-timings {
			timing@0 {
				cell-index = <0>;
				qcom,mdss-dsi-panel-framerate = <60>;
				qcom,mdss-dsi-panel-width = <1280>;
				qcom,mdss-dsi-panel-height = <1280>;
				qcom,mdss-dsi-h-front-porch = <64>;
				qcom,mdss-dsi-h-back-porch = <32>;
				qcom,mdss-dsi-h-pulse-width = <32>;
				qcom,mdss-dsi-h-sync-skew = <0>;
				qcom,mdss-dsi-v-back-porch = <14>;
				qcom,mdss-dsi-v-front-porch = <44>;
				qcom,mdss-dsi-v-pulse-width = <2>;
				qcom,mdss-dsi-h-left-border = <0>;
				qcom,mdss-dsi-h-right-border = <0>;
				qcom,mdss-dsi-v-top-border = <0>;
				qcom,mdss-dsi-v-bottom-border = <0>;

				qcom,mdss-dsi-on-command =
					[32 01 00 00 00 00 02 00 00];
				qcom,mdss-dsi-off-command =
					[22 01 00 00 00 00 02 00 00];

				qcom,mdss-dsi-on-command-state = "dsi_lp_mode";
				qcom,mdss-dsi-off-command-state = "dsi_hs_mode";
				qcom,mdss-dsi-h-sync-pulse = <0>;
			};
		};
	};
};
