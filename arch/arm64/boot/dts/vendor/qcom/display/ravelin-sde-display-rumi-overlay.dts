/dts-v1/;
/plugin/;

#include "ravelin-sde-display-rumi.dtsi"

/ {
	model = "Qualcomm Technologies, Inc. Ravelin RUMI";
	compatible = "qcom,ravelin-rumi", "qcom,ravelin", "qcom,rumi";
	qcom,msm-id = <568 0x10000>, <602 0x10000>,
			<581 0x10000>, <582 0x10000>,
			<653 0x10000>, <654 0x10000>,
			<734 0x10000>;
	qcom,board-id = <0x1000F 0>;
};
