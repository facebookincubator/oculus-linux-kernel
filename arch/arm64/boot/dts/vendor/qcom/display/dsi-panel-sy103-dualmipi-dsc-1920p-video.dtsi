&mdss_mdp0 {
	dsi_sy103_dual_dsc_1920p_90hz_video: qcom,mdss_dsi_sy103_dual_dsc_1920p_90hz_video {
		qcom,mdss-dsi-panel-name =
			"sy103 amoled video mode panel with DSC";
		qcom,mdss-dsi-panel-type = "dsi_video_mode";
		qcom,mdss-dsi-panel-physical-type = "oled";
		qcom,mdss-dsi-virtual-channel-id = <0>;
		qcom,mdss-dsi-stream = <0>;
		qcom,mdss-dsi-bpp = <24>;
		qcom,mdss-dsi-border-color = <0>;
		qcom,dsi-ctrl-num = <0 1>;
		qcom,dsi-phy-num = <0 1>;
		qcom,mdss-dsi-traffic-mode = "non_burst_sync_event";
		qcom,mdss-dsi-bllp-eof-power-mode;
		qcom,mdss-dsi-bllp-power-mode;
		qcom,mdss-dsi-lane-0-state;
		qcom,mdss-dsi-lane-1-state;
		qcom,mdss-dsi-lane-2-state;
		qcom,mdss-dsi-lane-3-state;
		qcom,mdss-dsi-dma-trigger = "trigger_sw";
		qcom,mdss-dsi-mdp-trigger = "none";
		qcom,mdss-dsi-reset-sequence = <1 10>, <0 10>, <1 20>;

		qcom,mdss-dsi-wr-mem-start = <0x2c>;
		qcom,mdss-dsi-wr-mem-continue = <0x3c>;
		qcom,mdss-dsi-display-timings {
			timing@0 {
				cell-index = <0>;
				qcom,mdss-dsi-panel-framerate = <90>;
				qcom,mdss-dsi-panel-width = <1920>;
				qcom,mdss-dsi-panel-height = <1920>;
				qcom,mdss-dsi-h-front-porch = <64>;
				qcom,mdss-dsi-h-back-porch = <32>;
				qcom,mdss-dsi-h-pulse-width = <32>;
				qcom,mdss-dsi-h-sync-skew = <0>;
				qcom,mdss-dsi-v-back-porch = <12>;
				qcom,mdss-dsi-v-front-porch = <45>;
				qcom,mdss-dsi-v-pulse-width = <3>;
				qcom,mdss-dsi-h-left-border = <0>;
				qcom,mdss-dsi-h-right-border = <0>;
				qcom,mdss-dsi-v-top-border = <0>;
				qcom,mdss-dsi-v-bottom-border = <0>;

				qcom,mdss-dsi-on-command = [
					15 01 00 00 00 00 02 03 81
					15 01 00 00 00 00 02 53 29
					39 01 00 00 00 00 03 51 FF 01
					15 01 00 00 00 00 02 69 02
					15 01 00 00 00 00 02 6B 00
					39 01 00 00 00 00 2D 70 11 00 00 89 30
					   80 07 80 03 c0 07 80 03 c0 03 c0 02
					   00 02 e0 00 20 03 f6 00 0d 00 0C 03
					   19 01 CA 18 00 10 F0 03 0C 20 00 06
					   0B 0B 33
					39 01 00 00 00 00 05 80 01 40 40 11
					39 01 00 00 00 00 08 81 02 0a 00 0f 00
					   2d 00
					39 01 00 00 00 00 08 82 02 0a 00 0f 00
					   2d 00
					15 01 00 00 00 00 02 35 00
					15 01 00 00 00 00 02 25 01
					39 01 00 00 00 00 03 F0 AA 10
					39 01 00 00 00 00 02 D1 02
					39 01 00 00 00 00 03 F0 AA 11
					39 01 00 00 00 00 04 C0 00 04 00
					39 01 00 00 00 00 0A C2 01 50 01 50 01
					   50 00 90 02
					39 01 00 00 00 00 03 F0 AA 12
					15 01 00 00 00 00 02 D3 20
					39 01 00 00 00 00 03 BF 37 BE
					39 01 00 00 00 00 03 FF 5A 81
					15 01 00 00 00 00 02 65 0B
					39 01 00 00 14 00 0E F9 58 5F 66 6D 74
					   7B 82 89 90 97 9E A5 AC
					05 01 00 00 64 00 01 11
					05 01 00 00 14 00 01 29
					39 01 00 00 00 00 03 F0 AA 11
					15 01 00 00 00 00 02 C0 FF

				];

				qcom,mdss-dsi-off-command = [
					05 01 00 00 14 00 02 28 00
					05 01 00 00 78 00 02 10 00];
				qcom,mdss-dsi-on-command-state = "dsi_lp_mode";
				qcom,mdss-dsi-off-command-state = "dsi_hs_mode";
				qcom,mdss-dsi-timing-switch-command-state =
					"dsi_lp_mode";
				qcom,mdss-dsi-h-sync-pulse = <0>;
				qcom,compression-mode = "dsc";
				qcom,mdss-dsc-slice-height = <32>;
				qcom,mdss-dsc-slice-width = <960>;
				qcom,mdss-dsc-slice-per-pkt = <1>;
				qcom,mdss-dsc-bit-per-component = <8>;
				qcom,mdss-dsc-bit-per-pixel = <8>;
				qcom,mdss-dsc-block-prediction-enable;
			};
		};
	};
};
