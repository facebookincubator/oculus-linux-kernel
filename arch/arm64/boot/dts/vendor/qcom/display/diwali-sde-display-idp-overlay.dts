/dts-v1/;
/plugin/;

#include "diwali-sde-display-idp.dtsi"

/ {
	model = "Qualcomm Technologies, Inc. Diwali IDP";
	compatible = "qcom,diwali-idp", "qcom,diwali", "qcom,idp";
	qcom,msm-id = <506 0x10000>, <547 0x10000>, <564 0x10000>;
	qcom,board-id = <34 0>, <34 1>, <34 2>;
};
