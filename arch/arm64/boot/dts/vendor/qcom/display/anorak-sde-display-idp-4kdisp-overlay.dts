/dts-v1/;
/plugin/;

#include "anorak-sde-display-idp-4kdisp.dtsi"

/ {
	model = "Qualcomm Technologies, Inc. Anorak IDP 4K display";
	compatible = "qcom,anorak-idp", "qcom,anorak", "qcom,idp";
	qcom,msm-id = <549 0x10000>;
	qcom,board-id = <0x10022 0x5>, <0x10022 0x6>;
};
