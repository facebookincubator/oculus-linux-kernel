/dts-v1/;
/plugin/;

#include "anorak-sde-display-qxr.dtsi"

/ {
	model = "Qualcomm Technologies, Inc. Anorak QXR";
	compatible = "qcom,anorak-qxr", "qcom,anorak";
	qcom,msm-id = <549 0x10000>;
	qcom,board-id = <0x10026 0x0>, <0x10026 0x1>, <0x10126 0x2>;
};