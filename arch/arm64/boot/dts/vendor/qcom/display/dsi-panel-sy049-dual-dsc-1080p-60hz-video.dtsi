&mdss_mdp {
	dsi_sy049_dual_dsc_60hz_video: qcom,mdss_dsi_sy049_dual_dsc_60hz_video {
	qcom,mdss-dsi-panel-name =
		"sy049wdm02 uoled video mode dsi seeya 60Hz panel with DSC";
	qcom,mdss-dsi-panel-type = "dsi_video_mode";
	qcom,dsi-ctrl-num = <0 1>;
	qcom,dsi-phy-num = <0 1>;

	qcom,mdss-dsi-virtual-channel-id = <0>;
	qcom,mdss-dsi-stream = <0>;
	qcom,mdss-dsi-bpp = <24>;
	qcom,mdss-dsi-border-color = <0>;
	qcom,mdss-dsi-traffic-mode = "non_burst_sync_event";
	qcom,mdss-dsi-bllp-eof-power-mode;
	qcom,mdss-dsi-bllp-power-mode;
	qcom,mdss-dsi-lane-0-state;
	qcom,mdss-dsi-lane-1-state;
	qcom,mdss-dsi-dma-trigger = "trigger_sw";
	qcom,mdss-dsi-mdp-trigger = "none";
	qcom,mdss-dsi-reset-sequence = <1 20>, <0 20>, <1 50>;
	qcom,adjust-timer-wakeup-ms = <1>;
	qcom,mdss-dsi-panel-peak-brightness = <4200000>;
	qcom,mdss-dsi-panel-blackness-level = <3230>;

	qcom,mdss-dsi-display-timings {
		timing@0 {
			qcom,mdss-dsi-panel-width = <1920>;
			qcom,mdss-dsi-panel-height = <1080>;
			qcom,mdss-dsi-h-front-porch = <88>;
			qcom,mdss-dsi-h-back-porch = <148>;
			qcom,mdss-dsi-h-pulse-width = <44>;
			qcom,mdss-dsi-h-sync-skew = <0>;
			qcom,mdss-dsi-v-back-porch = <12>;
			qcom,mdss-dsi-v-front-porch = <16>;
			qcom,mdss-dsi-v-pulse-width = <4>;
			qcom,mdss-dsi-h-left-border = <0>;
			qcom,mdss-dsi-panel-framerate = <60>;
			qcom,mdss-dsi-on-command = [
				15 01 00 00 00 00 02 53 29
				39 01 00 00 00 00 03 51 FF 01
				15 01 00 00 00 00 02 03 01
				39 01 00 00 00 00 07 80 00 E0 E0 0E 00
				   31
				39 01 00 00 00 00 08 81 03 F5 00 10 00
				   10 00
				39 01 00 00 00 00 08 82 03 F5 00 10 00
				   10 01
				15 01 00 00 00 00 02 35 00
				15 01 00 00 00 00 02 26 20
				15 01 00 00 00 00 02 6B 02
				39 01 00 00 00 00 11 70 11 00 00 89 30
				   80 04 38 07 80 00 1E 07 80 07 80
				15 01 00 00 00 00 02 65 10
				39 01 00 00 00 00 11 70 02 00 04 C0 00
				   20 04 88 00 1A 00 0C 03 50 00 F5
				15 01 00 00 00 00 02 65 20
				39 01 00 00 00 00 0D 70 18 00 10 F0 03
				   0C 20 00 06 0B 0B 33
				39 01 00 00 00 00 03 F0 AA 11
				15 01 00 00 00 00 02 C0 00
				39 01 00 00 00 00 0A C2 00 66 00 66 00
				   66 00 66 02
				39 01 00 00 00 00 03 F0 AA 12
				39 01 00 00 00 00 03 BF 17 A9
				39 01 00 00 00 00 03 FF 5A 80
				39 01 00 00 00 00 02 65 2F
				39 01 00 00 00 00 02 F2 01
				39 01 00 00 00 00 02 36 02
				39 01 00 80 00 00 03 FF 5A 80
				39 01 00 80 00 00 02 65 2F
				39 01 00 80 00 00 02 F2 01
				39 01 00 80 00 00 02 36 01
				39 01 00 80 00 00 03 F0 AA 13
				39 01 00 80 00 00 02 65 01
				39 01 00 80 00 00 02 C1 A2
				39 01 00 80 00 00 07 C4 12 53 64 31 42
				   56
				39 01 00 80 00 00 03 F0 AA 16
				39 01 00 80 00 00 07 B6 12 53 64 31 42
				   56
				39 01 00 80 00 00 03 B0 00 55
				39 01 00 80 00 00 03 F0 AA 10
				15 01 00 00 00 00 02 B8 F1
				39 01 00 00 00 00 03 FF 5A 80
				15 01 00 00 00 00 02 65 2F
				15 01 00 00 00 00 02 F2 01
				39 01 00 00 00 00 03 FF 5A 81
				15 01 00 00 00 00 02 65 05
				15 01 00 00 00 00 02 F2 22
				15 01 00 00 00 00 02 65 0A
				15 01 00 00 00 00 02 F2 00
				15 01 00 00 00 00 02 65 17
				39 01 00 00 00 00 0E F9 5E 62 66 6A 6F
				   73 77 7B 7F 84 88 8C 90
				05 01 00 00 cb 00 02 11 00
				05 01 00 00 00 00 02 29 00
				39 01 00 00 00 00 03 F0 AA 11
				15 01 00 00 00 00 02 C0 FF
			];
			qcom,mdss-dsi-off-command = [
				05 01 00 00 0a 00 02 28 00
				05 01 00 00 3c 00 02 10 00];

			qcom,mdss-dsi-on-command-state = "dsi_lp_mode";
			qcom,mdss-dsi-off-command-state = "dsi_hs_mode";
			qcom,compression-mode = "dsc";
			qcom,mdss-dsc-slice-height = <30>;
			qcom,mdss-dsc-slice-width = <1920>;
			qcom,mdss-dsc-pic-width-slice = <2>;
			qcom,mdss-dsc-slice-per-pkt = <1>;
			qcom,mdss-dsc-bit-per-component = <8>;
			qcom,mdss-dsc-bit-per-pixel = <8>;
			qcom,mdss-dsc-block-prediction-enable;
			};
		};
	};
};
