/dts-v1/;
/plugin/;

#include "parrot-sde-display-rumi.dtsi"

/ {
	model = "Qualcomm Technologies, Inc. Parrot Rumi";
	compatible = "qcom,parrot-rumi", "qcom,parrot", "qcom,rumi";
	qcom,msm-id = <537 0x10000>, <583 0x10000>, <613 0x10000>, <631 0x10000>, <633 0x10000>, <634 0x10000>, <638 0x10000>, <663 0x10000>;
	qcom,board-id = <0x1000F 0>;
};
