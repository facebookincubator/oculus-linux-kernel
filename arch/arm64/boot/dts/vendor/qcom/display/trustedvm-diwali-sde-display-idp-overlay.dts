/dts-v1/;
/plugin/;

#include "trustedvm-diwali-sde.dtsi"
#include "trustedvm-diwali-sde-display-idp.dtsi"

/ {
	model = "Qualcomm Technologies, Inc. Diwali IDP";
	compatible = "qcom,diwali-idp", "qcom,diwali", "qcom,idp";
	qcom,msm-id = <506 0x10000>, <547 0x10000>, <564 0x10000>;
	qcom,board-id = <34 0>;
};
