/dts-v1/;
/plugin/;

#include "trustedvm-cape-sde.dtsi"
#include "trustedvm-cape-sde-display-cdp.dtsi"

/ {
	model = "Qualcomm Technologies, Inc. Cape CDP";
	compatible = "qcom,cape-cdp", "qcom,cape", "qcom,cdp";
	qcom,msm-id = <530 0x10000>, <531 0x10000>, <540 0x10000>, <591 0x10000>;
	qcom,board-id = <0x10001 0>;
};
