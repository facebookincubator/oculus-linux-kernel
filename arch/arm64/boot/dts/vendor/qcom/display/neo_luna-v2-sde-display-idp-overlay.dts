/dts-v1/;
/plugin/;

#include "neo_luna-v2-sde-display-idp.dtsi"

/ {
	model = "Qualcomm Technologies, Inc. NEO LUNA V2 IDP";
	compatible = "qcom,neo-idp", "qcom,neo", "qcom,idp";
	qcom,msm-id = <579 0x10000>;
	qcom,board-id = <34 1>, <34 3>;
};
