/dts-v1/;
/plugin/;

#include "anorak-sde-display-idp.dtsi"

/ {
	model = "Qualcomm Technologies, Inc. Anorak IDP";
	compatible = "qcom,anorak-idp", "qcom,anorakp-idp", "qcom,anorak", "qcom,idp";
	qcom,msm-id = <549 0x10000>, <649 0x10000>;
	qcom,board-id = <0x10022 0x0>, <0x10022 0x1>, <0x10022 0x3>;
};
