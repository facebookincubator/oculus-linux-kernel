/dts-v1/;
/plugin/;

#include "trustedvm-cape-sde.dtsi"
#include "trustedvm-cape-sde-display-qrd.dtsi"

/ {
	model = "Qualcomm Technologies, Inc. Cape QRD";
	compatible = "qcom,cape-qrd", "qcom,cape", "qcom,qrd", "qcom,cape-v2-qrd", "qcom,cape-v2";
	qcom,msm-id = <530 0x10000>, <531 0x10000>, <540 0x10000>, <591 0x10000>;
	qcom,board-id = <0x1000B 0>;
};
