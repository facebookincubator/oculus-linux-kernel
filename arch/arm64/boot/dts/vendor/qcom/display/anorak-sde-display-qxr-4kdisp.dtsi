#include "anorak-sde-display-qxr.dtsi"

&sde_dsi {
	qcom,dsi-default-panel = <&dsi_sony_dual_dsc_3552x3840_90hz_video>;
};

&sde_dsi1 {
	qcom,dsi-default-panel = <&dsi_sony_dual_dsc_3552x3840_90hz_video>;
};

&battery_charger {
	qcom,display-panels = <&dsi_sony_dual_dsc_3552x3840_90hz_video>;
};
