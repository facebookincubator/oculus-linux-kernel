/dts-v1/;
/plugin/;

#include "parrot-sde-display-idp-amoled.dtsi"

/ {
	model = "Qualcomm Technologies, Inc. Parrot IDP + AMOLED";
	compatible = "qcom,parrot-idp", "qcom,parrot", "qcom,idp";
	qcom,msm-id = <537 0x10000>, <583 0x10000>, <613 0x10000>, <631 0x10000>, <633 0x10000>, <634 0x10000>, <638 0x10000>, <663 0x10000>;
	qcom,board-id = <34 2>, <34 3>, <34 4>, <34 0x602>, <34 0x603>, <34 0x604>, <34 6>;
};
