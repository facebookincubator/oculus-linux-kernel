/dts-v1/;
/plugin/;

#include "trustedvm-parrot-sde.dtsi"
#include "trustedvm-parrot-sde-display-idp.dtsi"

/ {
	model = "Qualcomm Technologies, Inc. Parrot IDP";
	compatible = "qcom,parrot-idp", "qcom,parrot", "qcom,idp";
	qcom,msm-id = <537 0x10000>;
	qcom,board-id = <34 0>, <34 1>;
};
