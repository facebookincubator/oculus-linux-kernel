#include "neo-sde-display.dtsi"

&dsi_sy049_dual_dsc_60hz_video {
	qcom,panel-supply-entries = <&dsi_panel_pwr_supply>;
	qcom,mdss-dsi-bl-pmic-control-type = "bl_ctrl_dcs";
	qcom,mdss-dsi-bl-ctrl-dcs-subtype = <0xC2>;
	qcom,mdss-dsi-bl-min-level = <1>;
	qcom,mdss-dsi-bl-max-level = <1023>;
	qcom,mdss-brightness-max-level = <1023>;
	qcom,platform-reset-gpio = <&tlmm 12 0>;
	qcom,platform-bklight-en-gpio = <&tlmm 93 0>;
};

&dsi_sy049_quad_lm_dual_dsc_90hz_video {
	qcom,panel-supply-entries = <&dsi_panel_pwr_supply>;
	qcom,mdss-dsi-bl-pmic-control-type = "bl_ctrl_dcs";
	qcom,mdss-dsi-bl-ctrl-dcs-subtype = <0xC2>;
	qcom,mdss-dsi-bl-min-level = <1>;
	qcom,mdss-dsi-bl-max-level = <1023>;
	qcom,mdss-brightness-max-level = <1023>;
	qcom,platform-reset-gpio = <&tlmm 12 0>;
	qcom,platform-bklight-en-gpio = <&tlmm 93 0>;
};

&dsi_sy049_dual_lm_dual_dsc_90hz_video {
	qcom,panel-supply-entries = <&dsi_panel_pwr_supply>;
	qcom,mdss-dsi-bl-pmic-control-type = "bl_ctrl_dcs";
	qcom,mdss-dsi-bl-ctrl-dcs-subtype = <0xC2>;
	qcom,mdss-dsi-bl-min-level = <1>;
	qcom,mdss-dsi-bl-max-level = <1023>;
	qcom,mdss-brightness-max-level = <1023>;
	qcom,platform-reset-gpio = <&tlmm 12 0>;
	qcom,platform-bklight-en-gpio = <&tlmm 93 0>;
};

&sde_dsi {
	qcom,dsi-default-panel = <&dsi_sy049_dual_lm_dual_dsc_90hz_video>;
};
