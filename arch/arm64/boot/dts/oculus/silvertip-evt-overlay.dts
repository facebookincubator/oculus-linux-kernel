/dts-v1/;
/plugin/;

#include "silvertip.dtsi"

/ {
	model = "Silvertip EVT";
	compatible = "meta,florian", "meta,silvertip", "meta,silvertip-evt";
	qcom,msm-id = <554 0x10000>;
	qcom,board-id = <59 0x52>;
};
