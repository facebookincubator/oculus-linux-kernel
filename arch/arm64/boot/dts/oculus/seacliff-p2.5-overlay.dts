/dts-v1/;
/plugin/;

#include "seacliff-p2.5.dtsi"

/ {
	model = "Seacliff (P2.5)";
	compatible = "qcom,kona";
	qcom,board-id = <66 66>;
};

&qupv3_se0_spi {
	oculusnrf@0 {
		oculus,syncboss-has-no-prox-cal;
	};
};
