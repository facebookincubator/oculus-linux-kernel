// SPDX-License-Identifier: GPL-2.0
// JDI-NVT-LCD CPHY panels, DSC,  2064*2208 @ 90Hz


&mdss_mdp {
	dsi_jdi_nvt_4k_90Hz_dsc_video: qcom,mdss_dsi_jdi_nvt_4k_90Hz_dsc_video {
		qcom,mdss-dsi-panel-name = "JDI novatek dual video mode dsi panel with dsc 90Hz";
		qcom,mdss-dsi-panel-type = "dsi_video_mode";
		qcom,dsi-ctrl-num = <0 1>;
		qcom,dsi-phy-num = <0 1>;
		qcom,mdss-dsi-bpp = <24>;

		qcom,mdss-dsi-virtual-channel-id = <0>; //TODO
		qcom,mdss-dsi-stream = <0>; //TODO
		qcom,mdss-dsi-border-color = <0>; //TODO
		qcom,mdss-dsi-traffic-mode = "burst_mode";
		qcom,mdss-dsi-bllp-eof-power-mode;
		qcom,mdss-dsi-bllp-power-mode;// JDI-NVT-LCD CPHY panels, DSC,  2064*2208 @ 120Hz
		qcom,mdss-dsi-lane-0-state;
		qcom,mdss-dsi-lane-1-state;
		qcom,mdss-dsi-lane-2-state;
		qcom,mdss-dsi-dma-trigger = "trigger_sw";
		qcom,mdss-dsi-mdp-trigger = "none";
		qcom,mdss-dsi-reset-sequence = <0 20>, <1 20>;
		qcom,adjust-timer-wakeup-ms = <1>;
		qcom,mdss-dsi-pan-enable-dynamic-fps;
		qcom,mdss-dsi-pan-fps-update = "dfps_immediate_porch_mode_vfp";
		qcom,mdss-dsi-min-refresh-rate = <60>;
		qcom,mdss-dsi-max-refresh-rate = <90>;
		qcom,mdss-dsi-lp11-init;
		qcom,mdss-dsi-tx-eot-append;
		qcom,cmd-sync-wait-broadcast;

		qcom,panel-cphy-mode;
		qcom,mdss-dsi-display-timings {
			timing@0{
				qcom,mdss-dsi-panel-width = <2064>;
				qcom,mdss-dsi-panel-height = <2208>;
				qcom,mdss-dsi-h-front-porch = <55>;
				qcom,mdss-dsi-h-back-porch = <54>;
				qcom,mdss-dsi-h-pulse-width = <2>;
				qcom,mdss-dsi-h-sync-skew = <0>;
				qcom,mdss-dsi-v-front-porch = <1110>;
				qcom,mdss-dsi-v-back-porch = <30>;
				qcom,mdss-dsi-v-pulse-width = <2>;
				qcom,mdss-dsi-h-sync-pulse = <0>;
				qcom,mdss-dsi-panel-framerate = <90>;

				qcom,mdss-dsi-bpp = <24>;

				qcom,mdss-dsi-on-command = [
					29 01 00 00 00 00 02 FF D0
					29 01 00 00 00 00 02 FB 01
					29 01 00 00 00 00 02 10 33
					29 01 00 00 00 00 02 02 D5
					29 01 00 00 00 00 02 13 99
					29 01 00 00 00 00 02 14 09
					29 01 00 00 00 00 02 FF 20
					29 01 00 00 00 00 02 7F 06
					29 01 00 00 00 00 02 FB 01
					29 01 00 00 00 00 02 FF 23
					29 01 00 00 00 00 02 00 00
					29 01 00 00 00 00 02 B4 30
					29 01 00 00 00 00 02 8F 02
					29 01 00 00 00 00 02 90 69
					29 01 00 00 00 00 02 D2 14
					29 01 00 00 00 00 02 D3 F7
					29 01 00 00 00 00 02 D0 02
					29 01 00 00 00 00 02 D1 01
					29 01 00 00 00 00 02 FB 01
					29 01 00 00 00 00 02 FF 25
					29 01 00 00 00 00 02 CC 00
					29 01 00 00 00 00 02 CD 20
					29 01 00 00 00 00 02 CE 00
					29 01 00 00 00 00 02 CF 20
					29 01 00 00 00 00 02 D0 00
					29 01 00 00 00 00 02 D1 20
					29 01 00 00 00 00 02 D2 00
					29 01 00 00 00 00 02 D3 20
					29 01 00 00 00 00 02 77 00
					29 01 00 00 00 00 02 78 20
					29 01 00 00 00 00 02 79 00
					29 01 00 00 00 00 02 7A 20
					29 01 00 00 00 00 02 7B 00
					29 01 00 00 00 00 02 7C 20
					29 01 00 00 00 00 02 7D 00
					29 01 00 00 00 00 02 7E 20
					29 01 00 00 00 00 02 D4 0F
					29 01 00 00 00 00 02 D5 5C
					29 01 00 00 00 00 02 D6 0F
					29 01 00 00 00 00 02 D7 5C
					29 01 00 00 00 00 02 D8 0F
					29 01 00 00 00 00 02 D9 5C
					29 01 00 00 00 00 02 DA 0F
					29 01 00 00 00 00 02 DB 5C
					29 01 00 00 00 00 02 BC FF
					29 01 00 00 00 00 02 BD FF
					29 01 00 00 00 00 02 BE FF
					29 01 00 00 00 00 02 BF FF
					29 01 00 00 00 00 02 C0 FF
					29 01 00 00 00 00 02 C1 FF
					29 01 00 00 00 00 02 C2 FF
					29 01 00 00 00 00 02 C3 FF
					29 01 00 00 00 00 02 E0 04
					29 01 00 00 00 00 02 E1 B0
					29 01 00 00 00 00 02 FB 01
					29 01 00 00 00 00 02 FF E0
					29 01 00 00 00 00 02 87 40
					29 01 00 00 00 00 02 FB 01
					15 01 00 00 00 00 02 FF 10
					15 01 00 00 00 00 02 03 01
					15 01 00 00 00 00 02 BB 13
					29 01 00 00 00 00 02 C0 03
					29 01 00 00 00 00 11 C1 89 28 00 10 C2 00 03 04 01 FD 00 0E 06 67 03 54
					29 01 00 00 00 00 03 C2 10 F0
					15 01 00 00 00 00 02 35 00
					15 01 00 00 00 00 02 36 00
					15 01 00 00 00 00 02 3A 77
					39 01 00 00 00 00 02 44 00
					29 01 00 00 00 00 02 51 FF
					15 01 00 00 00 00 02 53 24
					15 01 00 00 00 00 02 55 00
					15 01 00 00 00 00 02 FB 01
					05 01 00 00 78 00 01 11
					05 01 00 00 78 00 01 29
				];

				qcom,mdss-dsi-off-command = [
					05 01 00 00 78 00 01 28
					05 01 00 00 00 00 01 34
					05 01 00 00 78 00 01 10
				];

				// before video is on, the DSI panels typically
				// accept either hs or lp, but lp is prefered.
				qcom,mdss-dsi-on-command-state = "dsi_lp_mode";
				// once video is on, the DSI panels typically
				// only accept hs mode commands
				qcom,mdss-dsi-off-command-state = "dsi_hs_mode";
				qcom,compression-mode = "dsc";
				qcom,mdss-dsc-slice-height = <16>;
				qcom,mdss-dsc-slice-width = <1032>;
				qcom,mdss-dsc-slice-per-pkt = <2>;
				qcom,mdss-dsc-bit-per-component = <8>;
				qcom,mdss-dsc-bit-per-pixel = <8>;
				qcom,mdss-dsc-block-prediction-enable;
			};
		};
	};
};
