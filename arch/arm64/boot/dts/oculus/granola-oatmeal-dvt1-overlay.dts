// SPDX-License-Identifier: GPL-2.0

/dts-v1/;
/plugin/;

#include "oatmeal-dvt-common.dtsi"
#include "granola-oatmeal-panel.dtsi"

/ {
	model = "Granola Oatmeal DVT1";
	compatible = "meta,oatmeal", "meta,granola-oatmeal-dvt1";
	qcom,msm-id = <579 0x10000>;
	qcom,board-id = <34 0xca>;
};
