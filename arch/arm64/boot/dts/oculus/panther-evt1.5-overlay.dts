// SPDX-License-Identifier: GPL-2.0

/dts-v1/;
/plugin/;

#include "panther-evt1-common.dtsi"
#include "panther-evt1-mr-button.dtsi"

/ {
	model = "Panther (EVT1.5)";
	compatible = "oculus,panther-evt1.5", "oculus,panther", "qcom,anorak";
	qcom,msm-id = <549 0x10000>;
	qcom,board-id = <0x10543 0x2>;  // board-id = <(major)(minor)(product) (subtype)>

};

&wlan {
	cal-file-prefix = "panther_evt1.5_";
};
