/dts-v1/;
/plugin/;

#include "lager.dtsi"

/ {
	model = "Lager P1";
	compatible = "meta,florian", "meta,lager", "meta,lager-p1";
	qcom,msm-id = <554 0x10000>;
	qcom,board-id = <60 0x90>;
};

&generic_virtual_sensor {
        status = "disabled";
};

&outdoor_virtual_sensor {
	status = "disabled";
};
