// SPDX-License-Identifier: GPL-2.0

/dts-v1/;

#include "vendor-base/qcom/kona-v2.dtsi"
#include "kona-oculus-prune.dtsi"

/ {
	model = "Qualcomm Technologies, Inc. kona v2 SoC";
	compatible = "qcom,kona";
	qcom,board-id = <0 0>;
};
