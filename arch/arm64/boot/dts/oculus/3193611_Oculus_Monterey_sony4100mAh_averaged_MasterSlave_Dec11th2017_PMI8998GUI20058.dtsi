qcom,3193611_oculus_monterey_sony4100mah_averaged_masterslave_dec11th2017 {
	qcom, = <24>;
	/* #3193611_Oculus_Monterey_sony4100mAh_averaged_MasterSlave_Dec11th2017*/
	qcom,max-voltage-uv = <4300000>;
	qcom,nom-batt-capacity-mah = <4100>;
	qcom,fastchg-current-ma = <1900>;
	qcom,fg-cc-cv-threshold-mv = <4285>;
	qcom,batt-id-kohm = <19>;
	qcom,battery-beta = <3380>;
	qcom,battery-type = "3193611_oculus_monterey_sony4100mah_averaged_masterslave_dec11th2017";
	qcom,checksum = <0x7B7E>;
	qcom,gui-version = "PMI8998GUI - 2.0.0.58";
	qcom,fg-profile-data = [
		 7E 1F A1 05
		 79 0A 95 FC
		 C6 1C 3B 01
		 31 F2 59 05
		 AE 17 BA 22
		 5D 3C 55 4B
		 55 00 00 00
		 12 00 00 00
		 00 00 89 C2
		 67 CD F2 C2
		 25 00 08 00
		 6A DC B9 DC
		 84 05 7D FA
		 A7 05 C8 02
		 DF F2 B3 3A
		 1F 06 09 20
		 27 00 14 00
		 8E 1F D2 05
		 4F 0A E9 FC
		 04 1D E2 F3
		 75 03 AB 15
		 3D 18 1A 23
		 52 45 59 53
		 55 00 00 00
		 0E 00 00 00
		 00 00 6E CD
		 27 B2 08 B5
		 1E 00 00 00
		 8A EA B9 DC
		 8F 05 65 FA
		 D6 06 13 03
		 68 E3 E1 1A
		 B3 33 CC FF
		 07 10 00 00
		 84 10 66 46
		 1E 00 40 00
		 3A 01 0A FA
		 FF 00 00 00
		 00 00 00 00
		 00 00 00 00
		 00 00 00 00
		 00 00 00 00
		 00 00 00 00
		 00 00 00 00
		 00 00 00 00
		 00 00 00 00
		 00 00 00 00
		 00 00 00 00
		 00 00 00 00
		 00 00 00 00
		 00 00 00 00
		 00 00 00 00
		 00 00 00 00
		 00 00 00 00
		 00 00 00 00
		 00 00 00 00
	];
};
