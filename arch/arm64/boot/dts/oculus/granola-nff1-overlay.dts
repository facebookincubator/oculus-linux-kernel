/dts-v1/;
/plugin/;

#include "granola.dtsi"
#include "granola-nff1-jbd2520-display.dtsi"

/ {
	model = "Granola NFF1";
	compatible = "meta,oatmeal", "meta,granola-nff1";
	qcom,msm-id = <579 0x10000>;
	qcom,board-id = <34 0xcd>;
};
