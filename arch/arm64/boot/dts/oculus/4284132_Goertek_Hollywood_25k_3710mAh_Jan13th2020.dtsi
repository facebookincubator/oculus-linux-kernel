
qcom,4284132_goertek_hollywood_25k_3710mah_jan13th2020 {
	qcom,profile-revision = <24>;
	/* #4284132_Goertek_RongyaoDesay_3710mAh_averaged_MasterSlave_Jan13th2020*/
	qcom,max-voltage-uv = <4400000>;
	qcom,fastchg-current-ma = <1820>;/* 0.5C */
	qcom,jeita-fcc-ranges-0 = <50 100  720000
				101 200  1820000
				201 450  1820000
				451 550  720000>;
	qcom,jeita-fcc-ranges-1 = <50 100  720000
				101 200  1820000
				201 450  1820000
				451 550  720000>;
	qcom,jeita-fv-ranges-0 = <50  100  4400000
				101 200  4400000
				201 450  4400000
				451 550  4200000>;
	qcom,jeita-fv-ranges-1 = <50  100  4100000
				101 200  4100000
				201 450  4100000
				451 550  3900000>;
	qcom,cycle-fcc-ranges-0 = <0  300  1820000
				301 500  1820000
				501 800  1820000>;
	qcom,cycle-fcc-ranges-1 = <0  300  1820000
				301 500  1820000
				501 800  1820000>;
	qcom,cycle-fv-ranges-0 = <0   300  4400000
				301 500  4400000
				501 800  4300000>;
	qcom,cycle-fv-ranges-1 = <0   300  4100000
				301 500  4100000
				501 800  4000000>;
	qcom,chg-disable-ranges-0 = <3600000 4100000 0
				4101000 4400000 0>;
	qcom,chg-disable-ranges-1 = <3600000 4100000 0
				4101000 4400000 1>;
	qcom,rblt-support;
	qcom,rblt-missing-range = <200000 250000>;
	qcom,rblt-ok-range = <119000 200000>;
	qcom,rblt-warn-range = <59000 119000>;
	qcom,rblt-crit-range = <0 59000>;
	/* 1 - OK, 2 - warn, 3 - crit, 4 - missing, 5 - unknown */
	qcom,rblt-ranges = <1 1 4400000
				2 2 4200000
				3 3 4100000
				4 4 4200000
				5 5 4200000>;
	qcom,fct-support;
	qcom,fct-ok-range = <0 590>;
	qcom,fct-warn-range-1 = <590 830>;
	qcom,fct-warn-range-2 = <830 1050>;
	qcom,fct-warn-range-3 = <1050 1190>;
	qcom,fct-crit-range = <1190 20414092>;
	/* 0 - OK, 1 - warn-1, 2- warn-2, 3 - warn-3, 4 - crit, 5 - unknown */
	qcom,fct-ranges = <4400000 4350000 4340000 4320000 4310000 4400000>;
	/* UT LT STL RT STH HT OT */
	qcom,fct-weights = <3172 12602 112952 353955 609793 1721395 14297025>;
	/* Denominator in FCT weights math */
	qcom,fct-weights-div = <1000000 1000000 1000000 1000000 1000000 1000000 1000000>;
	qcom,step-chg-ranges-0 = <3600000 4060000 1820000
				4061000 4400000 1820000>;
	qcom,step-chg-ranges-1 = <3600000 4060000 1820000
				4061000 4400000 1820000>;
	/* COLD = 0 DegC, HOT = 52 DegC */
	qcom,jeita-hard-thresholds = <0x58cd 0x1882>;
	/* COOL = 10 DegC, WARM = 45 DegC */
	qcom,jeita-soft-thresholds = <0x4ccc 0x20b8>;
	/* COLD hys = 12 DegC, WARM hys = 43 DegC */
	qcom,jeita-soft-hys-thresholds = <0x4a2a 0x22b8>;
	qcom,jeita-soft-fcc-ua = <720000 720000>;/* 0.2C */
	qcom,jeita-soft-fv-uv = <4300000 4300000>;
	qcom,ocv-based-step-chg;
	qcom,fg-cc-cv-threshold-mv = <4390>;
	qcom,nom-batt-capacity-mah = <3710>;
	qcom,batt-id-kohm = <25>;
	qcom,battery-beta = <4250>;
	qcom,therm-room-temp = <100000>;
	qcom,battery-type = "4284132_goertek_hollywood_25k_3710mah_jan13th2020";
	qcom,therm-coefficients = <0x2318 0xd0c 0xdaf7 0xc556 0x848d>;
	qcom,therm-center-offset = <0x70>;
	qcom,therm-pull-up = <100>;
	qcom,rslow-normal-coeffs = <0x73 0x05 0x73 0x0b>;
	qcom,rslow-low-coeffs = <0xc7 0x15 0x71 0xd3>;
	qcom,checksum = <0xEB20>;
	qcom,gui-version = "PM855GUI - 1.0.0.13";
	qcom,fg-profile-data = [
		 09 00 F9 E3
		 BE E5 43 00
		 B7 E5 00 00
		 70 BD C9 8A
		 F8 87 B4 8A
		 A0 9C 65 80
		 1F 00 73 05
		 73 0B 99 05
		 14 01 CE 07
		 32 00 95 EA
		 26 ED 09 D2
		 84 0A 89 E4
		 A5 C5 8C 1A
		 C4 03 26 C2
		 60 00 44 00
		 4D 00 4A 00
		 34 00 31 00
		 35 00 3D 00
		 3F 00 40 00
		 3D 00 60 00
		 35 00 46 00
		 4E 00 45 00
		 3C 00 79 00
		 5F 64 4E 00
		 44 00 41 08
		 60 F8 58 00
		 63 00 99 10
		 7A 10 63 00
		 C4 28 93 48
		 76 60 60 0C
		 62 00 D8 F8
		 32 1F F9 05
		 22 02 7D 05
		 6E 1C 6C 0B
		 7D 0D D2 2A
		 97 17 6F 4A
		 02 5D 8B 02
		 61 0E 81 1E
		 F5 FD C1 02
		 67 F7 CB 1C
		 68 02 D0 04
		 C3 03 DE 17
		 1D 22 BE 45
		 50 5B 60 10
		 CC 1E 5D E5
		 35 CB B2 CC
		 E3 1C A6 A9
		 0E 05 6D BB
		 B3 17 E1 8B
		 55 84 5F 9A
		 7B A0 09 80
		 A7 03 4A 04
		 24 03 85 04
		 00 F8 5A DD
		 6E E3 F3 F7
		 F2 EB C8 CC
		 63 18 17 00
		 D1 E6 88 02
		 B9 05 A6 01
		 CE 07 32 00
		 D7 02 3A 02
		 EA 04 0B 02
		 FA 05 8D 02
		 9F 02 AA 02
		 B4 05 56 00
		 36 00 42 00
		 45 64 49 00
		 47 F8 46 00
		 48 F8 46 00
		 49 00 4B 10
		 40 10 3F 00
		 51 28 53 48
		 5F 60 70 0C
		 49 00 57 00
		 60 08 67 F8
		 48 00 48 00
		 4B 10 59 10
		 51 00 6C 28
		 82 48 4D 60
		 63 0C 68 00
		 62 00 43 08
		 D8 00 AE 1F
		 0F 04 E2 0B
		 C7 0D D7 1C
		 25 23 E6 45
		 30 5A 51 18
		 46 02 34 05
		 61 02 6A 10
		 3F 0A 98 1F
		 E0 05 36 02
		 2B 05 BE 1C
		 30 03 CE 05
		 62 02 6A 18
		 2E 02 53 05
		 46 02 67 00
		 CC 1F 9A 05
		 71 02 5A 06
		 F3 1C 0C 02
		 D1 05 63 02
		 A5 18 5B 03
		 C2 04 28 02
		 7B 00 32 01
		 C0 00 FA 00
		 9F 0E 00 00
	];
};
