/dts-v1/;
/plugin/;

#include "silvertip.dtsi"

/ {
	model = "Silvertip DVT";
	compatible = "meta,florian", "meta,silvertip", "meta,silvertip-dvt";
	qcom,msm-id = <554 0x10000>;
	qcom,board-id = <59 0x53>;
};
