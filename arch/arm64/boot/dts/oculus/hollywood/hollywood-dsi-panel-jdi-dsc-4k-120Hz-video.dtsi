/* Copyright (c) 2016-2017, The Linux Foundation. All rights reserved.
 *
 * This program is free software; you can redistribute it and/or modify
 * it under the terms of the GNU General Public License version 2 and
 * only version 2 as published by the Free Software Foundation.
 *
 * This program is distributed in the hope that it will be useful,
 * but WITHOUT ANY WARRANTY; without even the implied warranty of
 * MERCHANTABILITY or FITNESS FOR A PARTICULAR PURPOSE.  See the
 * GNU General Public License for more details.
 */

//JDI panel 3664x1920(24bpp) @ 120Hz


&mdss_mdp {
	dsi_jdi_4k_120Hz_dsc_video: qcom,mdss_dsi_jdi_4k_120Hz_dsc_video {
		qcom,mdss-dsi-panel-name = "jdi 4k 120Hz video mode dsc dsi panel";
		qcom,dsi-ctrl-num = <0 1>;
		qcom,dsi-phy-num = <0 1>;
		qcom,mdss-dsi-panel-type = "dsi_video_mode";
		qcom,mdss-dsi-virtual-channel-id = <0>;
		qcom,mdss-dsi-stream = <0>;
		qcom,mdss-dsi-bpp = <24>; /* TBD */
		qcom,mdss-dsi-border-color = <0>;
		qcom,mdss-dsi-traffic-mode = "non_burst_sync_event";
		qcom,mdss-dsi-bllp-eof-power-mode;
		qcom,mdss-dsi-bllp-power-mode;
		qcom,mdss-dsi-lane-0-state;
		qcom,mdss-dsi-lane-1-state;
		qcom,mdss-dsi-lane-2-state;
		qcom,mdss-dsi-lane-3-state;
		qcom,mdss-dsi-dma-trigger = "trigger_sw";
		qcom,mdss-dsi-mdp-trigger = "none";
		qcom,mdss-dsi-reset-sequence = <0 5>, <1 25>;
		qcom,adjust-timer-wakeup-ms = <1>;
		qcom,mdss-dsi-pan-enable-dynamic-fps;
		qcom,mdss-dsi-pan-fps-update = "dfps_immediate_porch_mode_vfp";
		qcom,mdss-dsi-min-refresh-rate = <60>;
		qcom,mdss-dsi-max-refresh-rate = <120>;
		qcom,mdss-dsi-display-timings {
			timing@0{
				qcom,mdss-dsi-panel-width = <960>;
				qcom,mdss-dsi-panel-height = <3664>;
				qcom,mdss-dsi-h-front-porch = <56>;
				qcom,mdss-dsi-h-back-porch = <44>;
				qcom,mdss-dsi-h-pulse-width = <12>;
				qcom,mdss-dsi-h-sync-skew = <0>;
				qcom,mdss-dsi-v-back-porch = <7>;
				qcom,mdss-dsi-v-front-porch = <14>;
				qcom,mdss-dsi-v-pulse-width = <1>;
				qcom,mdss-dsi-h-sync-pulse = <0>;
				qcom,mdss-dsi-panel-framerate = <120>;

				qcom,mdss-dsi-on-command = [
					23 01 00 00 00 00 02 B0 04
					23 01 00 00 00 00 02 D6 00
					29 01 00 00 00 00 0A B6 30 6B 00 06 33 8A 00 1A 7A
					29 01 00 00 00 00 05 B7 52 00 00 00
					29 01 00 00 00 00 11 B9 0C F4 01 71 00 00 00 00 05 B4 01 71 00 00 00 00
					29 01 00 00 00 00 02 F1 0E
					29 01 00 00 00 00 02 BE FF
					29 01 00 00 00 00 09 C0 47 86 0D 00 0E 50 00 09
					29 01 00 00 00 00 02 F1 12
					29 01 00 00 00 00 02 C6 40
					29 01 00 00 00 00 02 F1 1E
					29 01 00 00 00 00 11 C6 80 07 80 02 1D 4F 0E 00 00 00 00 00 00 00 00 00
					29 01 00 00 00 00 02 CD 00
					29 01 00 00 00 00 08 CF 8B 00 80 46 61 00 8B
					29 01 00 00 00 00 06 EC 00 00 00 00 00
					29 01 00 00 00 00 7D E6 11 00 00 89 30 80 0E 50 07 80 00 10 01 E0 01 E0 02 00 01 F0 00 20 01 6D 00 06 00 0C 06 67 07 27 18 00 10 F0 03 0C 20 00 06 0B 0B 33 0E 1C 2A 38 46 54 62 69 70 77 79 7B 7D 7E 01 02 01 00 09 40 09 BE 19 FC 19 FA 19 F8 1A 38 1A 78 1A B6 2A F6 2B 34 2B 74 3B 74 63 F4 00 00 00 00 00 00 00 00 00 00 00 00 00 00 00 00 00 00 00 00 00 00 00 00 00 00 00 00 00 00 00 00 00 00 00 00
					39 01 00 00 00 00 02 03 01
					39 01 00 00 00 00 03 44 00 00
					15 01 00 00 00 00 02 35 00
					15 01 00 00 00 00 02 36 00
					15 01 00 00 20 00 02 3A 77
					05 01 00 00 78 00 01 29
					05 01 00 00 78 00 01 11
					23 01 00 00 00 00 02 D6 80
					23 01 00 00 00 00 02 B0 03
				];
				qcom,mdss-dsi-on-command-state = "dsi_lp_mode";
				qcom,mdss-dsi-off-command = [
					05 01 00 00 78 00 01 28
					05 01 00 00 00 00 01 34
					05 01 00 00 78 00 01 10
				];
				qcom,mdss-dsi-off-command-state = "dsi_hs_mode";
				qcom,compression-mode = "dsc";
				qcom,mdss-dsc-slice-height = <16>;
				qcom,mdss-dsc-slice-width = <480>;
				qcom,mdss-dsc-slice-per-pkt = <2>;
				qcom,mdss-dsc-bit-per-component = <8>;
				qcom,mdss-dsc-bit-per-pixel = <8>;
				qcom,mdss-dsc-block-prediction-enable;
			};
		};
	};
};
