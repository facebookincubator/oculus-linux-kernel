/* Copyright (c) 2016-2017, The Linux Foundation. All rights reserved.
 *
 * This program is free software; you can redistribute it and/or modify
 * it under the terms of the GNU General Public License version 2 and
 * only version 2 as published by the Free Software Foundation.
 *
 * This program is distributed in the hope that it will be useful,
 * but WITHOUT ANY WARRANTY; without even the implied warranty of
 * MERCHANTABILITY or FITNESS FOR A PARTICULAR PURPOSE.  See the
 * GNU General Public License for more details.
 */

//BOE panel 3664x1920(24bpp) @ 72Hz


&mdss_mdp {
	dsi_boe_4k_72Hz_dsc_video: qcom,mdss_dsi_boe_4k_72Hz_dsc_video {
		qcom,mdss-dsi-panel-name = "boe 4k 72Hz video mode dsc dsi panel";
		qcom,dsi-ctrl-num = <0 1>;
		qcom,dsi-phy-num = <0 1>;
		qcom,mdss-dsi-panel-type = "dsi_video_mode";
		qcom,mdss-dsi-virtual-channel-id = <0>;
		qcom,mdss-dsi-stream = <0>;
		qcom,mdss-dsi-bpp = <24>; /* TBD */
		qcom,mdss-dsi-border-color = <0>;
		qcom,mdss-dsi-traffic-mode = "non_burst_sync_event";
		qcom,mdss-dsi-bllp-eof-power-mode;
		qcom,mdss-dsi-bllp-power-mode;
		qcom,mdss-dsi-lane-0-state;
		qcom,mdss-dsi-lane-1-state;
		qcom,mdss-dsi-lane-2-state;
		qcom,mdss-dsi-lane-3-state;
		qcom,mdss-dsi-dma-trigger = "trigger_sw";
		qcom,mdss-dsi-mdp-trigger = "none";
		qcom,mdss-dsi-reset-sequence = <0 5>, <1 25>;
		qcom,adjust-timer-wakeup-ms = <1>;
		qcom,dsi-supported-dfps-list = <72 60>;
		qcom,mdss-dsi-pan-enable-dynamic-fps;
		qcom,mdss-dsi-pan-fps-update = "dfps_immediate_porch_mode_vfp";
		qcom,mdss-dsi-min-refresh-rate = <60>;
		qcom,mdss-dsi-max-refresh-rate = <72>;
		qcom,mdss-dsi-display-timings {
			timing@0{
				qcom,mdss-dsi-panel-width = <960>;
				qcom,mdss-dsi-panel-height = <3664>;
				qcom,mdss-dsi-h-front-porch = <56>;
				qcom,mdss-dsi-h-back-porch = <44>;
				qcom,mdss-dsi-h-pulse-width = <12>;
				qcom,mdss-dsi-h-sync-skew = <0>;
				qcom,mdss-dsi-v-back-porch = <20>;
				qcom,mdss-dsi-v-front-porch = <2459>;
				qcom,mdss-dsi-v-pulse-width = <1>;
				qcom,mdss-dsi-h-sync-pulse = <0>;
				qcom,mdss-dsi-panel-framerate = <72>;

				qcom,mdss-dsi-on-command = [
					23 01 00 00 00 00 02 B0 04
					23 01 00 00 00 00 02 D6 00
					29 01 00 00 00 00 0D B9 15 D7 01 F2 00 00 00 00 16 99 01 F2
					29 01 00 00 00 00 12 C0 49 86 1A 00 0E 50 00 0E 00 00 08 49 00 00 0E 00 0E
                                        29 01 00 00 00 00 6D C2 05 46 02 02 00 17 04 00 00 00 00 00 00 00 00 00 00 00 00 00 00 05 46 04 04 01 01 01 00 10 0E 73 00 00 00 08 00 00 00 00 00 00 00 00 00 00 00 00 00 00 00 00 00 00 00 00 00 00 00 00 00 00 00 00 00 00 00 00 00 00 00 00 00 00 00 00 00 00 00 00 00 00 00 00 00 00 00 00 00 00 00 00 00 00 00 00 00 0F 00 00 00 00 00 00 00 00 00 00
                                        29 01 00 00 00 00 55 C3 00 00 01 00 01 0E 75 00 00 00 60 00 00 00 00 00 00 00 00 00 00 00 60 00 00 00 00 00 00 00 00 00 00 00 60 00 00 00 00 00 00 00 00 00 00 00 60 00 00 00 00 00 00 00 00 00 00 00 60 00 00 00 00 00 00 00 00 00 00 00 60 00 00 00 00 00 00 00 00 00 00 00 60 00
                                        29 01 00 00 00 00 4A EF 0A 28 00 00 19 19 00 00 00 00 00 00 00 00 00 00 00 00 00 00 00 00 00 00 00 00 00 00 00 00 00 00 00 00 1A 0E 69 00 00 00 00 00 0A 0A 0C 0C 00 03 11 00 01 00 00 00 00 00 00 00 00 00 00 00 00 00 00 00 00 00 00 00 00 00 00
					29 01 00 00 00 00 02 D6 00
					29 01 00 00 00 00 7D E6 11 00 00 89 30 80 0E 50 07 80 00 10 01 E0 01 E0 02 00 01 F0 00 20 01 6D 00 06 00 0C 06 67 07 27 18 00 10 F0 03 0C 20 00 06 0B 0B 33 0E 1C 2A 38 46 54 62 69 70 77 79 7B 7D 7E 01 02 01 00 09 40 09 BE 19 FC 19 FA 19 F8 1A 38 1A 78 1A B6 2A F6 2B 34 2B 74 3B 74 63 F4 00 00 00 00 00 00 00 00 00 00 00 00 00 00 00 00 00 00 00 00 00 00 00 00 00 00 00 00 00 00 00 00 00 00 00 00
					29 01 00 00 00 00 02 B0 03
					39 01 00 00 0F 00 02 35 00
					05 01 00 00 00 00 01 29
					05 01 00 00 C8 00 01 11
				];
				qcom,mdss-dsi-on-command-state = "dsi_lp_mode";
				qcom,mdss-dsi-off-command = [
					05 01 00 00 78 00 01 28
					05 01 00 00 78 00 01 10
				];
				qcom,mdss-dsi-off-command-state = "dsi_hs_mode";
				qcom,compression-mode = "dsc";
				qcom,mdss-dsc-slice-height = <16>;
				qcom,mdss-dsc-slice-width = <480>;
				qcom,mdss-dsc-slice-per-pkt = <2>;
				qcom,mdss-dsc-bit-per-component = <8>;
				qcom,mdss-dsc-bit-per-pixel = <8>;
				qcom,mdss-dsc-block-prediction-enable;
			};
		};
	};
};
