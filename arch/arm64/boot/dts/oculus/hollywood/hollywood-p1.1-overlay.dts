/dts-v1/;
/plugin/;

#include <dt-bindings/clock/qcom,gcc-kona.h>
#include <dt-bindings/clock/qcom,camcc-kona.h>
#include <dt-bindings/clock/qcom,rpmh.h>
#include <dt-bindings/interrupt-controller/arm-gic.h>

#include "hollywood.dtsi"

/ {
	model = "Hollywood (P1.1)";
	compatible = "qcom,kona";
	qcom,board-id = <64 14>;
};

&pm8150a_l1 {
	qcom,init-mode = <4>; /* RPMH_REGULATOR_MODE_HPM */
	regulator-always-on;
};
