&mdss_mdp {
	dsi_jbd4020_uled_640x480_60: qcom,mdss_dsi_jbd4020_vga_60hz_vid {
		qcom,mdss-dsi-panel-name =
			"jbd4020 video mode uLED panel";
		qcom,mdss-dsi-panel-type = "dsi_video_mode";
		qcom,mdss-dsi-virtual-channel-id = <0>;
		qcom,mdss-dsi-stream = <0>;
		qcom,mdss-dsi-bpp = <24>;
		qcom,mdss-dsi-border-color = <0>;
		qcom,dsi-ctrl-num = <0>;
		qcom,dsi-phy-num = <0>;
		qcom,mdss-dsi-traffic-mode = "non_burst_sync_event";
		qcom,mdss-dsi-bllp-eof-power-mode;
		qcom,mdss-dsi-bllp-power-mode;
		qcom,mdss-dsi-lane-0-state;
		qcom,mdss-dsi-dma-trigger = "trigger_sw";
		qcom,mdss-dsi-mdp-trigger = "none";
		qcom,mdss-dsi-reset-sequence = <1 1>, <0 1>, <1 1>;

		qcom,dsi-select-clocks = "pll_byte_clk0", "pll_dsi_clk0";
		/delete-property/ qcom,esd-check-enabled;
		qcom,mdss-dsi-panel-status-check-mode = "reg_read";
		qcom,mdss-dsi-panel-status-command = [06 01 00 01 00 00 01 0A];
		qcom,mdss-dsi-panel-status-command-state = "dsi_lp_mode";
		qcom,mdss-dsi-panel-status-value = <0x9c>;
		qcom,mdss-dsi-panel-status-read-length = <1>;

		qcom,mdss-dsi-wr-mem-start = <0x2c>;
		qcom,mdss-dsi-wr-mem-continue = <0x3c>;

		/delete-property/ qcom,panel-supply-entries;
		qcom,mdss-dsi-bl-pmic-control-type = "bl_ctrl_dcs";
		qcom,mdss-dsi-bl-min-level = <10>;
		qcom,mdss-dsi-bl-max-level = <4095>;
		qcom,mdss-brightness-max-level = <8191>;
		qcom,mdss-dsi-bl-inverted-dbv;
		qcom,mdss-dsi-ext-bridge-mode;
		/delete-property/ qcom,platform-reset-gpio;

		qcom,mdss-dsi-display-timings {
			timing@0 {
				cell-index = <0>;
				qcom,mdss-dsi-panel-framerate = <75>;
				qcom,mdss-dsi-panel-width = <640>;
				qcom,mdss-dsi-panel-height = <480>;
				qcom,mdss-dsi-h-front-porch = <20>;
				qcom,mdss-dsi-h-back-porch = <20>;
				qcom,mdss-dsi-h-pulse-width = <4>;
				qcom,mdss-dsi-h-sync-skew = <0>;
				qcom,mdss-dsi-v-back-porch = <2>;
				qcom,mdss-dsi-v-front-porch = <30>;
				qcom,mdss-dsi-v-pulse-width = <2>;
				qcom,mdss-dsi-h-left-border = <0>;
				qcom,mdss-dsi-h-right-border = <0>;
				qcom,mdss-dsi-v-top-border = <0>;
				qcom,mdss-dsi-v-bottom-border = <0>;

				qcom,mdss-dsi-on-command = [
					29 01 00 00 00 00 04 ff 00 00 00
					39 01 00 00 00 00 05 F0 5A 5A 00 00
					29 01 00 00 00 00 04 ff 01 00 11
					39 01 00 00 00 00 05 50 10 00 00 00
					29 01 00 00 00 00 04 ff 02 00 20
					39 01 00 00 00 00 05 67 FF FF FF FF
					29 01 00 00 00 00 04 ff 02 00 24
					39 01 00 00 00 00 05 67 FF FF FF FF
					29 01 00 00 00 00 04 ff 02 00 28
					39 01 00 00 00 00 05 67 FF FF FF FF
					29 01 00 00 00 00 04 ff 02 00 40
					39 01 00 00 00 00 05 67 FF FF FF FF
					29 01 00 00 00 00 04 ff 02 00 28
					39 01 00 00 00 00 05 72 FF 33 0C 00
					29 01 00 00 00 00 04 ff 02 00 10
					39 01 00 00 00 00 05 70 04 00 00 00
					29 01 00 00 00 00 04 ff 02 00 FC
					39 01 00 00 00 00 05 7D FF FF FF FF
					29 01 00 00 00 00 04 ff 02 00 C0
					39 01 00 00 00 00 05 72 01 00 00 00
					29 01 00 00 00 00 04 ff 02 00 C0
					39 01 00 00 00 00 05 72 00 00 00 00
					29 01 00 00 00 00 04 ff 02 00 0C
					39 01 00 00 00 00 05 60 01 00 00 00
					29 01 00 00 00 00 04 ff 02 00 A8
					39 01 00 00 00 00 05 60 63 22 00 00
					29 01 00 00 00 00 04 ff 02 00 14
					39 01 00 00 00 00 05 60 00 02 00 00
					29 01 00 00 00 00 04 ff 02 00 00
					39 01 00 00 00 00 05 62 01 00 00 00
					29 01 00 00 00 00 04 ff 02 00 30
					39 01 00 00 00 00 05 62 00 00 00 00
					29 01 00 00 00 00 04 ff 02 00 00
					39 01 00 00 00 00 05 67 FF FF 1F 00
					29 01 00 00 00 00 04 ff 02 00 04
					39 01 00 00 00 00 05 67 FF FF 3F 00
					29 01 00 00 00 00 04 ff 02 00 08
					39 01 00 00 00 00 05 67 FF 1B 18 00
					29 01 00 00 00 00 04 ff 02 00 60
					39 01 00 00 00 00 05 61 FF FF 01 00
					29 01 00 00 00 00 04 ff 02 00 88
					39 01 00 00 00 00 05 67 1F 00 00 02
					29 01 00 00 00 00 04 ff 02 00 00
					39 01 00 00 00 00 05 60 02 00 02 00
					29 01 00 00 00 00 04 ff 01 00 90
					39 01 00 00 00 00 05 00 86 0F 60 00
					29 01 00 00 00 00 04 ff 02 00 00
					39 01 00 00 00 00 05 60 02 00 00 00
					29 01 00 00 00 00 04 ff 03 00 D0
					39 01 00 00 00 00 05 00 7f 02 DF 01
					29 01 00 00 00 00 04 ff 03 00 80
					39 01 00 00 00 00 05 00 00 01 00 00
					29 01 00 00 00 00 04 ff 03 03 00
					39 01 00 00 00 00 05 03 00 00 00 00
					29 01 00 00 00 00 04 ff 03 04 04
					39 01 00 00 00 00 05 10 01 00 00 00
					29 01 00 00 00 00 04 ff 01 00 3C
					39 01 00 00 00 00 05 00 3F 00 43 22
					29 01 00 00 00 00 04 ff 02 00 30
					39 01 00 00 00 00 05 00 03 FF 00 00
					29 01 00 00 00 00 04 ff 03 03 00
					39 01 00 00 00 00 05 01 11 00 00 80
					29 01 00 00 00 00 04 ff 01 00 AC
					39 01 00 00 00 00 05 00 05 00 08 00
					29 01 00 00 00 00 04 ff 01 00 AC
					39 01 00 00 00 00 05 00 01 00 08 00
					29 01 00 00 00 00 04 ff 01 00 E4
					39 01 00 00 00 00 05 00 05 00 08 00
					29 01 00 00 00 00 04 ff 01 00 E4
					39 01 00 00 00 00 05 00 01 00 08 00
					29 01 00 00 00 00 04 ff 01 00 EC
					39 01 00 00 00 00 05 00 05 00 08 00
					29 01 00 00 00 00 04 ff 01 00 EC
					39 01 00 00 00 00 05 00 01 00 08 00
					29 01 00 00 00 00 04 ff 01 00 AC
					39 01 00 00 00 00 05 00 03 00 08 00
					29 01 00 00 00 00 04 ff 01 00 E4
					39 01 00 00 00 00 05 00 03 00 08 00
					29 01 00 00 00 00 04 ff 01 00 EC
					39 01 00 00 00 00 05 00 03 00 08 00
					29 01 00 00 00 00 04 ff 01 00 02
					39 01 00 00 00 00 05 00 00 00 00 00
					29 01 00 00 00 00 04 ff 01 00 2c
					39 01 00 00 00 00 05 00 00 00 00 00
					29 01 00 00 00 00 04 ff 02 00 40
					39 01 00 00 00 00 05 00 09 C2 20 00
					29 01 00 00 00 00 04 ff 02 00 44
					39 01 00 00 00 00 05 00 8A 44 00 00
					29 01 00 00 00 00 04 ff 02 00 48
					39 01 00 00 00 00 05 00 88 20 00 00
					29 01 00 00 00 00 04 ff 03 02 68
					39 01 00 00 00 00 05 AE 01 00 00 00
					29 01 00 00 00 00 04 ff 02 00 04
					39 01 00 00 00 00 05 30 5B 63 03 00
					29 01 00 00 00 00 04 ff 02 00 04
					39 01 00 00 00 00 05 30 A5 DB B1 05
					29 01 00 00 00 00 04 ff 02 00 04
					39 01 00 00 00 00 05 00 02 02 00 00
					29 01 00 00 00 00 04 ff 02 00 1C
					39 01 00 00 00 00 05 50 20 60 00 00
					29 01 00 00 00 00 04 ff 03 00 90
					39 01 00 00 00 00 05 00 00 00 00 C0
					29 01 00 00 00 00 04 ff 02 00 04
					39 01 00 00 00 00 05 00 00 02 00 00
					29 01 00 00 00 00 04 ff 01 00 38
					39 01 00 00 00 00 05 10 01 00 00 00
					/* gamma table */
					29 01 00 00 00 00 04 ff 03 02 00
					39 01 00 00 00 00 31 AF 64 00 64 00 64 00 64 00 63 00 64 00 5E 00 60 00 59 00 5C 00 55 00 57 00 50 00 53 00 4C 00 4E 00 48 00 4A 00 45 00 47 00 41 00 43 00 3E 00 40 00
					29 01 00 00 00 00 04 ff 03 02 30
					39 01 00 00 00 00 31 AF 3B 00 3C 00 38 00 39 00 35 00 36 00 32 00 34 00 30 00 31 00 2D 00 2F 00 2B 00 2C 00 29 00 2A 00 27 00 28 00 25 00 26 00 23 00 24 00 21 00 22 00
					29 01 00 00 00 00 04 ff 03 02 60
					39 01 00 00 00 00 31 AF 20 00 20 00 1E 00 1F 00 1C 00 1D 00 1B 00 1C 00 1A 00 1A 00 18 00 19 00 17 00 18 00 16 00 16 00 15 00 15 00 14 00 14 00 13 00 13 00 12 00 12 00
					29 01 00 00 00 00 04 ff 03 02 90
					39 01 00 00 00 00 31 AF 11 00 11 00 10 00 10 00 0F 00 10 00 0E 00 0F 00 0E 00 00 00 00 00 00 00 00 00 00 00 00 00 00 00 00 00 00 00 00 00 00 00 00 00 00 00 00 00 00 00
					29 01 00 00 00 00 04 ff 03 02 C0
					39 01 00 00 00 00 31 AF 00 00 00 00 00 00 00 00 00 00 00 00 00 00 00 00 00 00 00 00 00 00 00 00 00 00 00 00 00 00 00 00 00 00 00 00 00 00 00 00 00 00 00 00 00 00 00 00
					29 01 00 00 00 00 04 ff 03 02 F0
					39 01 00 00 00 00 31 AF 00 00 00 00 00 00 00 00 00 00 00 00 00 00 00 00 00 00 00 00 00 00 00 00 00 00 00 00 00 00 00 00 00 00 00 00 00 00 00 00 00 00 00 00 00 00 00 00
					29 01 00 00 00 00 04 ff 03 02 20
					39 01 00 00 00 00 31 B0 00 00 00 00 00 00 00 00 00 00 00 00 00 00 00 00 00 00 00 00 00 00 00 00 00 00 00 00 00 00 00 00 00 00 00 00 00 00 00 00 00 00 00 00 00 00 00 00
					29 01 00 00 00 00 04 ff 03 02 50
					39 01 00 00 00 00 31 B0 00 00 00 00 00 00 00 00 00 00 00 00 00 00 00 00 00 00 00 00 00 00 00 00 00 00 00 00 00 00 00 00 00 00 00 00 00 00 00 00 00 00 00 00 00 00 00 00
					29 01 00 00 00 00 04 ff 03 02 80
					39 01 00 00 00 00 31 B0 00 00 00 00 00 00 00 00 00 00 00 00 00 00 00 00 00 00 00 00 00 00 00 00 00 00 00 00 00 00 00 00 00 00 00 00 00 00 00 00 00 00 00 00 00 00 00 00
					29 01 00 00 00 00 04 ff 03 02 B0
					39 01 00 00 00 00 31 B0 00 00 00 00 00 00 00 00 00 00 00 00 00 00 00 00 00 00 00 00 00 00 00 00 00 00 00 00 00 00 00 00 00 00 00 00 00 00 00 00 00 00 00 00 00 00 00 00
					29 01 00 00 00 00 04 ff 03 02 E0
					39 01 00 00 00 00 31 B0 00 00 00 00 00 00 00 00 00 00 00 00 00 00 00 00 00 00 00 00 00 00 00 00 00 00 00 00 00 00 00 00 00 00 00 00 00 00 00 00 00 00 00 00 00 00 00 00
					29 01 00 00 00 00 04 ff 03 02 10
					39 01 00 00 00 00 31 B1 00 00 00 00 00 00 00 00 00 00 00 00 00 00 00 00 00 00 00 00 00 00 00 00 00 00 00 00 00 00 00 00 00 00 00 00 00 00 00 00 00 00 00 00 00 00 00 00
					29 01 00 00 00 00 04 ff 03 02 40
					39 01 00 00 00 00 31 B1 00 00 00 00 00 00 00 00 00 00 00 00 00 00 00 00 00 00 00 00 00 00 00 00 00 00 00 00 00 00 00 00 00 00 00 00 00 00 00 00 00 00 00 00 00 00 00 00
					29 01 00 00 00 00 04 ff 03 02 70
					39 01 00 00 00 00 31 B1 00 00 00 00 00 00 00 00 00 00 00 00 00 00 00 00 00 00 00 00 00 00 00 00 00 00 00 00 00 00 00 00 00 00 00 00 00 00 00 00 00 00 00 00 00 00 00 00
					29 01 00 00 00 00 04 ff 03 02 A0
					39 01 00 00 00 00 31 B1 00 00 00 00 00 00 00 00 00 00 00 00 00 00 00 00 00 00 00 00 00 00 00 00 00 00 00 00 00 00 00 00 00 00 00 00 00 00 00 00 00 00 00 00 00 00 00 00
					29 01 00 00 00 00 04 ff 03 02 D0
					39 01 00 00 00 00 31 B1 00 00 00 00 00 00 00 00 00 00 00 00 00 00 00 00 00 00 00 00 00 00 00 00 00 00 00 00 00 00 00 00 00 00 00 00 00 00 00 00 00 00 00 00 00 00 00 00
					29 01 00 00 00 00 04 ff 03 02 00
					39 01 00 00 00 00 31 B2 00 00 00 00 00 00 00 00 00 00 00 00 00 00 00 00 00 00 00 00 00 00 00 00 00 00 00 00 00 00 00 00 00 00 00 00 00 00 00 00 00 00 00 00 00 00 00 00
					29 01 00 00 00 00 04 ff 03 02 30
					39 01 00 00 00 00 31 B2 00 00 00 00 00 00 00 00 00 00 00 00 00 00 00 00 00 00 00 00 00 00 00 00 00 00 00 00 00 00 00 00 00 00 00 00 00 00 00 00 00 00 00 00 00 00 00 00
					29 01 00 00 00 00 04 ff 03 02 60
					39 01 00 00 00 00 31 B2 00 00 00 00 00 00 00 00 00 00 00 00 00 00 00 00 00 00 00 00 00 00 00 00 00 00 00 00 00 00 00 00 00 00 00 00 00 00 00 00 00 00 00 00 00 00 00 00
					29 01 00 00 00 00 04 ff 03 02 90
					39 01 00 00 00 00 31 B2 00 00 00 00 00 00 00 00 00 00 00 00 00 00 00 00 00 00 00 00 00 00 00 00 00 00 00 00 00 00 00 00 00 00 00 00 00 00 00 00 00 00 00 00 00 00 00 00
					29 01 00 00 00 00 04 ff 03 02 C0
					39 01 00 00 00 00 31 B2 00 00 00 00 00 00 00 00 00 00 00 00 00 00 00 00 00 00 00 00 00 00 00 00 00 00 00 00 00 00 00 00 00 00 00 00 00 00 00 00 00 00 00 00 00 00 00 00
					29 01 00 00 00 00 04 ff 03 02 F0
					39 01 00 00 00 00 31 B2 00 00 00 00 00 00 00 00 00 00 00 00 00 00 00 00 00 00 00 00 00 00 00 00 00 00 00 00 00 00 00 00 00 00 00 00 00 00 00 00 00 00 00 00 00 00 00 00
					29 01 00 00 00 00 04 ff 03 02 20
					39 01 00 00 00 00 31 B3 00 00 00 00 00 00 00 00 00 00 00 00 00 00 00 00 00 00 00 00 00 00 00 00 00 00 00 00 00 00 00 00 00 00 00 00 00 00 00 00 00 00 00 00 00 00 00 00
					29 01 00 00 00 00 04 ff 03 02 50
					39 01 00 00 00 00 31 B3 00 00 00 00 00 00 00 00 00 00 00 00 00 00 00 00 00 00 00 00 00 00 00 00 00 00 00 00 00 00 00 00 00 00 00 00 00 00 00 00 00 00 00 00 00 00 00 00
					29 01 00 00 00 00 04 ff 03 02 80
					39 01 00 00 00 00 31 B3 00 00 00 00 00 0A 0A 0A 14 0A 1E 0A 00 00 00 00 00 00 08 00 AB AA 02 00 00 00 02 00 00 00 02 00 00 00 02 00 00 00 01 00 00 00 01 00 00 00 01 00
					29 01 00 00 00 00 04 ff 03 02 B0
					39 01 00 00 00 00 31 B3 00 00 01 00 00 00 01 00 00 00 01 00 00 00 01 00 00 00 01 00 00 00 01 00 00 00 01 00 00 00 01 00 00 00 01 00 00 00 01 00 00 00 01 00 00 00 01 00
					29 01 00 00 00 00 04 ff 03 02 E0
					39 01 00 00 00 00 31 B3 00 00 01 00 00 00 01 00 00 00 01 00 00 00 01 00 00 00 01 00 00 00 01 00 00 00 01 00 00 00 01 00 00 00 01 00 00 00 01 00 00 00 01 00 00 00 01 00
					29 01 00 00 00 00 04 ff 03 02 10
					39 01 00 00 00 00 31 B4 00 00 01 00 00 00 01 00 42 08 01 00 64 6E 78 82 8C 96 A0 AA B4 BE C8 D2 DC E6 F0 FA FF FF FF FF FF FF FF FF FF FF FF FF FF FF FF FF FF FF FF FF
					29 01 00 00 00 00 04 ff 03 02 40
					39 01 00 00 00 00 31 B4 FF FF FF FF 00 00 E8 03 D0 07 B8 0B A0 0F 88 13 70 17 58 1B 40 1F FF 1F 1A 04 83 04 EC 04 55 05 BE 05 27 06 90 06 F9 06 62 07 CB 07 34 08 9D 08
					29 01 00 00 00 00 04 ff 03 02 70
					39 01 00 00 00 00 31 B4 06 09 6F 09 D8 09 41 0A AA 0A 13 0B 7C 0B E5 0B 4E 0C B7 0C 20 0D 89 0D F2 0D 5B 0E C4 0E 2D 0F 96 0F FF 0F 00 00 0A 00 14 00 1E 00 28 00 32 00
					29 01 00 00 00 00 04 ff 03 02 A0
					39 01 00 00 00 00 31 B4 3C 00 BC 02 50 00 5A 00 64 00 6E 00 78 00 82 00 8C 00 96 00 A0 00 AA 00 B4 00 BE 00 C8 00 D2 00 DC 00 E6 00 F0 00 FA 00 04 01 0E 01 18 01 22 01
					29 01 00 00 00 00 04 ff 03 02 D0
					39 01 00 00 00 00 31 B4 2C 01 36 01 40 01 4A 01 54 01 5E 01 68 01 72 01 7C 01 86 01 00 10 00 01 20 C0 00 04 60 00 02 0A C0 80 03 10 20 01 05 16 80 81 06 1C E0 01 08 22
					29 01 00 00 00 00 04 ff 03 02 00
					39 01 00 00 00 00 31 B5 40 82 09 28 A0 02 0B 2E 00 83 0C 34 60 03 0E 3A C0 83 FF 3F 00 00 00 00 00 00 00 00 00 00 00 00 00 00 00 00 00 00 00 00 00 00 00 00 00 00 00 00
					29 01 00 00 00 00 04 ff 03 02 30
					39 01 00 00 00 00 31 B5 00 00 00 00 00 00 00 00 00 00 00 00 00 00 00 00 00 00 00 00 00 00 00 00 00 00 00 00 00 00 00 00 00 00 00 00 00 00 00 00 00 00 00 00 00 00 00 00
					29 01 00 00 00 00 04 ff 03 02 60
					39 01 00 00 00 00 31 B5 02 30 00 00 05 70 00 00 09 F0 00 00 14 A0 01 00 21 80 02 00 30 A0 03 00 44 F0 04 00 5B 70 06 00 75 40 08 00 93 40 0A 00 B5 80 0C 00 DB 00 0F 00
					29 01 00 00 00 00 04 ff 03 02 90
					39 01 00 00 00 00 31 B5 05 C1 11 00 33 C1 14 00 66 01 18 00 9C 81 1B 00 D6 41 1F 00 00 10 00 00 03 70 00 00 0A E0 00 00 12 E0 01 00 28 40 03 00 41 00 05 00 61 30 07 00
					29 01 00 00 00 00 04 ff 03 02 C0
					39 01 00 00 00 00 31 B5 88 D0 09 00 B5 F0 0C 00 EA 80 10 00 27 81 14 00 6B 01 19 00 B7 01 1E 00 0B 82 23 00 67 82 29 00 CB 02 30 00 37 13 37 00 AC 83 3E 00 00 10 00 00
					29 01 00 00 00 00 04 ff 03 02 F0
					39 01 00 00 00 00 31 B5 05 A0 00 00 10 50 01 00 1B D0 02 00 3D E0 04 00 62 80 07 00 91 D0 0A 00 CB C0 0E 00 10 61 13 00 5F B1 18 00 BA C1 1E 00 20 82 25 00 92 02 2D 00
					29 01 00 00 00 00 04 ff 03 02 20
					39 01 00 00 00 00 31 B6 10 43 35 00 9A 43 3E 00 31 04 48 00 D3 94 52 00 83 C5 5D 00 00 20 00 00 07 E0 00 00 15 C0 01 00 24 D0 03 00 51 80 06 00 83 10 0A 00 C2 70 0E 00
					29 01 00 00 00 00 04 ff 03 02 50
					39 01 00 00 00 00 31 B6 0F B1 13 00 6A E1 19 00 D5 F1 20 00 4E 02 29 00 D6 02 32 00 6E 03 3C 00 16 04 47 00 CE 04 53 00 96 05 60 00 6F 26 6E 00 59 07 7D 00 00 20 00 00
					29 01 00 00 00 00 04 ff 03 02 80
					39 01 00 00 00 00 31 B6 09 10 01 00 1A 30 02 00 2D C0 04 00 65 20 08 00 A3 90 0C 00 F2 00 12 00 53 A1 18 00 C5 51 20 00 4A 32 29 00 E1 42 33 00 8B 83 3E 00 49 04 4B 00
					29 01 00 00 00 00 04 ff 03 02 B0
					39 01 00 00 00 00 31 B6 1B C5 58 00 01 C6 67 00 FC 06 78 00 0B A8 89 00 2F 49 9C 00 00 30 00 00 0A 50 01 00 1F A0 02 00 35 B0 05 00 79 C0 09 00 C4 10 0F 00 23 A1 15 00
					29 01 00 00 00 00 04 ff 03 02 E0
					39 01 00 00 00 00 31 B6 97 81 1D 00 20 C2 26 00 BF 72 31 00 74 83 3D 00 41 04 4B 00 25 05 5A 00 21 86 6A 00 35 87 7C 00 61 18 90 00 A6 39 A5 00 05 8B BB 00 00 30 00 00
					29 01 00 00 00 00 04 ff 03 02 10
					39 01 00 00 00 00 31 B7 0C 80 01 00 24 10 03 00 3E A0 06 00 8D 60 0B 00 E5 90 11 00 53 41 19 00 DA 71 22 00 7A 42 2D 00 34 B3 39 00 08 C4 47 00 F6 84 57 00 00 06 69 00
					29 01 00 00 00 00 04 ff 03 02 40
					39 01 00 00 00 00 31 B7 26 37 7C 00 68 48 91 00 C7 19 A8 00 42 BB C0 00 DB CC DA 00 00 30 00 00 0E C0 01 00 2A 80 03 00 47 90 07 00 A1 00 0D 00 05 11 14 00 84 E1 1C 00
					29 01 00 00 00 00 04 ff 03 02 70
					39 01 00 00 00 00 31 B7 1E 62 27 00 D5 B2 33 00 A9 E3 41 00 9B 04 52 00 AC 05 64 00 DC 06 78 00 2B F8 8D 00 9B 09 A6 00 2C 1B C0 00 DE 3C DC 00 B1 0E FA 00 00 40 00 00
					29 01 00 00 00 00 04 ff 03 02 A0
					39 01 00 00 00 00 31 B7 0E C0 01 00 2B 90 03 00 49 C0 07 00 A5 50 0D 00 0B 91 14 00 8D 81 1D 00 2B 52 28 00 E6 F2 34 00 BF 73 43 00 B7 F4 53 00 CE 65 66 00 06 D7 7A 00
					29 01 00 00 00 00 04 ff 03 02 D0
					39 01 00 00 00 00 31 B7 5D 58 91 00 D6 F9 A9 00 70 AB C4 00 2C 7D E1 00 0B FF FF 00 00 00 01 00 40 00 08 00 C0 00 10 00 80 01 20 00 00 03 40 00 04 06 80 00 08 8A C0 00
					29 01 00 00 00 00 04 ff 03 02 00
					39 01 00 00 00 00 31 B8 8C CD F0 00 F0 0F FF 00 F0 0F FF 00 F0 0F FF 00 F0 0F FF 00 F0 0F FF 00 F0 0F FF 00 F0 0F FF 00 F0 0F FF 00 F0 0F FF 00 F0 0F FF 00 00 00 00 00
					29 01 00 00 00 00 04 ff 03 02 30
					39 01 00 00 00 00 31 B8 00 00 00 00 00 00 00 00 00 00 00 00 00 00 00 00 00 00 00 00 00 00 00 00 00 00 00 00 00 00 00 00 00 00 00 00 00 00 00 00 00 00 00 00 00 00 00 00
					29 01 00 00 00 00 04 ff 03 02 60
					39 01 00 00 00 00 31 B8 00 00 00 00 00 00 00 00 00 00 00 00 00 00 00 00 00 00 00 00 00 00 00 00 00 00 00 00 00 00 00 00 00 00 00 00 00 00 00 00 00 00 00 00 00 00 00 00
					29 01 00 00 00 00 04 ff 03 02 90
					39 01 00 00 00 00 31 B8 00 00 00 00 00 00 00 00 00 00 00 00 00 00 00 00 00 00 00 00 00 00 00 00 00 00 00 00 00 00 00 00 00 00 00 00 00 00 00 00 00 00 00 00 00 00 00 00
					29 01 00 00 00 00 04 ff 03 02 C0
					39 01 00 00 00 00 31 B8 00 00 00 00 00 00 00 00 00 00 00 00 00 00 00 00 00 00 00 00 00 00 00 00 00 00 00 00 00 00 00 00 00 00 00 00 00 00 00 00 00 00 00 00 00 00 00 00
					29 01 00 00 00 00 04 ff 03 02 F0
					39 01 00 00 00 00 31 B8 00 00 00 00 00 00 00 00 00 00 00 00 00 00 00 00 00 00 00 00 00 00 00 00 00 00 00 00 00 00 00 00 00 00 00 00 00 00 00 00 00 00 00 00 00 00 00 00
					29 01 00 00 00 00 04 ff 03 02 20
					39 01 00 00 00 00 31 B9 00 00 00 00 00 00 00 00 00 00 00 00 00 00 00 00 00 00 00 00 00 00 00 00 00 00 00 00 00 00 00 00 00 00 00 00 00 00 00 00 00 00 00 00 00 00 00 00
					29 01 00 00 00 00 04 ff 03 02 50
					39 01 00 00 00 00 31 B9 00 00 00 00 00 00 00 00 00 00 00 00 00 00 00 00 00 00 00 00 00 00 00 00 00 00 00 00 00 00 00 00 00 00 00 00 00 00 00 00 00 00 00 00 00 00 00 00
					29 01 00 00 00 00 04 ff 03 02 80
					39 01 00 00 00 00 31 B9 00 00 00 00 00 00 00 00 00 00 00 00 00 00 00 00 00 00 00 00 00 00 00 00 00 00 00 00 00 00 00 00 00 00 00 00 00 00 00 00 00 00 00 00 00 00 00 00
					29 01 00 00 00 00 04 ff 03 02 B0
					39 01 00 00 00 00 31 B9 00 00 00 00 00 00 00 00 00 00 00 00 00 00 00 00 00 00 00 00 00 00 00 00 00 00 00 00 00 00 00 00 00 00 00 00 00 00 00 00 00 00 00 00 00 00 00 00
					29 01 00 00 00 00 04 ff 03 02 E0
					39 01 00 00 00 00 31 B9 00 00 00 00 00 00 00 00 00 00 00 00 00 00 00 00 00 00 00 00 00 00 00 00 00 00 00 00 00 00 00 00 00 00 00 00 00 00 00 00 00 00 00 00 00 00 00 00
					29 01 00 00 00 00 04 ff 03 02 10
					39 01 00 00 00 00 31 BA 00 00 00 00 00 00 00 00 00 00 00 00 00 00 00 00 00 00 00 00 00 00 00 00 00 00 00 00 00 00 00 00 00 00 00 00 00 00 00 00 00 00 00 00 00 00 00 00
					29 01 00 00 00 00 04 ff 03 02 40
					39 01 00 00 00 00 31 BA 00 00 00 00 00 00 00 00 00 00 00 00 00 00 00 00 00 00 00 00 00 00 00 00 00 00 00 00 00 00 00 00 00 00 00 00 00 00 00 00 00 00 00 00 00 00 00 00
					29 01 00 00 00 00 04 ff 03 02 70
					39 01 00 00 00 00 31 BA 00 00 00 00 00 00 00 00 00 00 00 00 00 00 00 00 00 00 00 00 00 00 00 00 00 00 00 00 00 00 00 00 00 00 00 00 00 00 00 00 00 00 00 00 00 00 00 00
					29 01 00 00 00 00 04 ff 03 02 A0
					39 01 00 00 00 00 31 BA 00 00 00 00 00 00 00 00 00 00 00 00 00 00 00 00 00 00 00 00 00 00 00 00 00 00 00 00 00 00 00 00 00 00 00 00 00 00 00 00 00 00 00 00 00 00 00 00
					29 01 00 00 00 00 04 ff 03 02 D0
					39 01 00 00 00 00 31 BA 00 00 00 00 00 00 00 00 00 00 00 00 00 00 00 00 00 00 00 00 00 00 00 00 00 00 00 00 00 00 00 00 00 00 00 00 00 00 00 00 00 00 00 00 00 00 00 00
					29 01 00 00 00 00 04 ff 03 02 00
					39 01 00 00 00 00 31 BB 00 00 00 00 00 00 00 00 00 00 00 00 00 00 00 00 00 00 00 00 00 00 00 00 00 00 00 00 00 00 00 00 00 00 00 00 00 00 00 00 00 00 00 00 00 00 00 00
					29 01 00 00 00 00 04 ff 03 02 30
					39 01 00 00 00 00 31 BB 00 00 00 00 00 00 00 00 00 00 00 00 00 00 00 00 00 00 00 00 00 00 00 00 00 00 00 00 00 00 00 00 00 00 00 00 00 00 00 00 00 00 00 00 00 00 00 00
					29 01 00 00 00 00 04 ff 03 02 60
					39 01 00 00 00 00 31 BB 00 00 00 00 00 00 00 00 00 00 00 00 00 00 00 00 00 00 00 00 00 00 00 00 00 00 00 00 00 00 00 00 00 00 00 00 00 00 00 00 00 00 00 00 00 00 00 00
					29 01 00 00 00 00 04 ff 03 02 90
					39 01 00 00 00 00 31 BB 00 00 00 00 00 00 00 00 00 00 00 00 00 00 00 00 00 00 00 00 00 00 00 00 00 00 00 00 00 00 00 00 00 00 00 00 00 00 00 00 00 00 00 00 00 00 00 00
					29 01 00 00 00 00 04 ff 03 02 C0
					39 01 00 00 00 00 31 BB 00 00 00 00 00 00 00 00 00 00 00 00 00 00 00 00 00 00 00 00 00 00 00 00 00 00 00 00 00 00 00 00 00 00 00 00 00 00 00 00 00 00 00 00 00 00 00 00
					29 01 00 00 00 00 04 ff 03 02 F0
					39 01 00 00 00 00 31 BB 00 00 00 00 00 00 00 00 00 00 00 00 00 00 00 00 00 00 00 00 00 00 00 00 00 00 00 00 00 00 00 00 00 00 00 00 00 00 00 00 00 00 00 00 00 00 00 00
					29 01 00 00 00 00 04 ff 03 02 20
					39 01 00 00 00 00 31 BC 00 00 00 00 00 00 00 00 00 00 00 00 00 00 00 00 00 00 00 00 00 00 00 00 00 00 00 00 00 00 00 00 00 00 00 00 00 00 00 00 00 00 00 00 00 00 00 00
					29 01 00 00 00 00 04 ff 03 02 50
					39 01 00 00 00 00 31 BC 00 00 00 00 00 00 00 00 00 00 00 00 00 00 00 00 00 00 00 00 00 00 00 00 00 00 00 00 00 00 00 00 00 00 00 00 00 00 00 00 00 00 00 00 00 00 00 00
					29 01 00 00 00 00 04 ff 03 02 80
					39 01 00 00 00 00 31 BC 00 00 00 00 00 00 00 00 00 00 00 00 00 00 00 00 00 00 00 00 00 00 00 00 00 00 00 00 00 00 00 00 00 00 00 00 00 00 00 00 00 00 00 00 00 00 00 00
					29 01 00 00 00 00 04 ff 03 02 B0
					39 01 00 00 00 00 31 BC 00 00 00 00 00 00 00 00 00 00 00 00 00 00 00 00 00 00 00 00 00 00 00 00 00 00 00 00 00 00 00 00 00 00 00 00 00 00 00 00 00 00 00 00 00 00 00 00
					29 01 00 00 00 00 04 ff 03 02 E0
					39 01 00 00 00 00 31 BC 00 00 00 00 00 00 00 00 00 00 00 00 00 00 00 00 00 00 00 00 00 00 00 00 00 00 00 00 00 00 00 00 00 00 00 00 00 00 00 00 00 00 00 00 00 00 00 00
					29 01 00 00 00 00 04 ff 03 02 10
					39 01 00 00 00 00 31 BD 00 00 00 00 00 00 00 00 00 00 00 00 00 00 00 00 00 00 00 00 00 00 00 00 00 00 00 00 00 00 00 00 00 00 00 00 00 00 00 00 00 00 00 00 00 00 00 00
					29 01 00 00 00 00 04 ff 03 02 40
					39 01 00 00 00 00 31 BD 00 00 00 00 00 00 00 00 00 00 00 00 00 00 00 00 00 00 00 00 00 00 00 00 00 00 00 00 00 00 00 00 00 00 00 00 00 00 00 00 00 00 00 00 00 00 00 00
					29 01 00 00 00 00 04 ff 03 02 70
					39 01 00 00 00 00 31 BD 00 00 00 00 00 00 00 00 00 00 00 00 00 00 00 00 00 00 00 00 00 00 00 00 00 00 00 00 00 00 00 00 00 00 00 00 00 00 00 00 00 00 00 00 00 00 00 00
					29 01 00 00 00 00 04 ff 03 02 A0
					39 01 00 00 00 00 31 BD 00 00 00 00 00 00 00 00 00 00 00 00 00 00 00 00 00 00 00 00 00 00 00 00 00 00 00 00 00 00 00 00 00 00 00 00 00 00 00 00 00 00 00 00 00 00 00 00
					29 01 00 00 00 00 04 ff 03 02 D0
					39 01 00 00 00 00 31 BD 00 00 00 00 00 00 00 00 00 00 00 00 00 00 00 00 00 00 00 00 00 00 00 00 00 00 00 00 00 00 00 00 00 00 00 00 00 00 00 00 00 00 00 00 00 00 00 00
					29 01 00 00 00 00 04 ff 03 02 00
					39 01 00 00 00 00 31 BE 00 00 00 00 00 00 00 00 00 00 00 00 00 00 00 00 00 00 00 00 00 A0 00 00 14 E0 01 00 28 20 03 00 3C 60 04 00 50 A0 05 00 64 E0 06 00 78 20 08 00
					29 01 00 00 00 00 04 ff 03 02 30
					39 01 00 00 00 00 31 BE 8C 60 09 00 A0 A0 0A 00 B4 E0 0B 00 C8 20 0D 00 DC 60 0E 00 F0 A0 0F 00 04 E1 10 00 18 21 12 00 2C 61 13 00 40 A1 14 00 54 E1 15 00 00 00 00 00
					29 01 00 00 00 00 04 ff 03 02 60
					39 01 00 00 00 00 31 BE 00 00 00 00 00 00 00 00 00 00 00 00 00 00 00 00 00 00 00 00 00 00 00 00 00 00 00 00 00 00 00 00 00 00 00 00 00 00 00 00 00 00 00 00 00 00 00 00
					29 01 00 00 00 00 04 ff 03 02 90
					39 01 00 00 00 00 31 BE 00 00 00 00 00 00 00 00 00 00 00 00 00 00 00 00 00 00 00 00 00 00 00 00 00 00 00 00 00 00 00 00 00 00 00 00 00 00 00 00 00 00 00 00 00 00 00 00
					29 01 00 00 00 00 04 ff 03 02 C0
					39 01 00 00 00 00 31 BE 00 00 00 00 00 00 00 00 00 00 00 00 00 00 00 00 00 00 00 00 00 00 00 00 00 00 00 00 00 00 00 00 00 00 00 00 00 00 00 00 00 00 00 00 04 80 00 00
					29 01 00 00 00 00 04 ff 03 02 F0
					39 01 00 00 00 00 31 BE 0C 00 01 00 14 80 01 00 1C 00 02 00 24 80 02 00 2C 00 03 00 34 80 03 00 3C 00 04 00 44 80 04 00 4C 00 05 00 54 80 05 00 5C 00 06 00 64 80 06 00
					29 01 00 00 00 00 04 ff 03 02 20
					39 01 00 00 00 00 31 BF 6C 00 07 00 74 80 07 00 7C 00 08 00 84 80 08 00 8C 00 09 00 00 00 00 00 00 00 00 00 00 00 00 00 00 00 00 00 00 00 00 00 00 00 00 00 00 00 00 00
					29 01 00 00 00 00 04 ff 03 02 50
					39 01 00 00 00 00 31 BF 00 00 00 00 00 00 00 00 00 00 00 00 00 00 00 00 00 00 00 00 00 00 00 00 00 00 00 00 00 00 00 00 00 00 00 00 00 00 00 00 00 00 00 00 08 00 01 00
					29 01 00 00 00 00 04 ff 03 02 80
					39 01 00 00 00 00 31 BF 18 00 02 00 28 00 03 00 38 F0 FF 00 48 00 05 00 58 00 06 00 68 00 07 00 78 B0 32 00 EE 0C 09 00 98 00 0A 00 EB 07 0B 00 B8 00 0C 00 C8 00 0D 00
					29 01 00 00 00 00 04 ff 03 02 B0
					39 01 00 00 00 00 31 BF D8 00 0E 00 E8 00 0F 00 F8 00 10 00 08 01 11 00 18 01 12 00 00 00 00 00 00 00 00 00 00 00 00 00 00 00 00 00 00 00 00 00 00 00 00 00 00 00 00 00
					29 01 00 00 00 00 04 ff 03 02 E0
					39 01 00 00 00 00 31 BF 00 00 00 00 00 00 00 00 00 00 00 00 00 00 00 00 00 00 00 00 00 00 00 00 00 00 00 00 00 00 00 00 00 00 00 00 00 00 00 00 00 00 00 00 10 00 02 00
					29 01 00 00 00 00 04 ff 03 02 10
					39 01 00 00 00 00 31 C0 30 00 04 00 50 00 06 00 70 00 08 00 90 00 0A 00 B0 00 0C 00 D0 00 0E 00 F0 00 10 00 10 01 12 00 30 01 14 00 50 01 16 00 70 01 18 00 90 01 1A 00
					29 01 00 00 00 00 04 ff 03 02 40
					39 01 00 00 00 00 15 C0 B0 01 1C 00 D0 01 1E 00 F0 01 20 00 10 02 22 00 30 02 24 00
					29 01 00 00 00 00 04 ff 03 02 00
					39 01 00 00 00 00 05 AE 80 03 00 00
					29 01 00 00 00 00 04 ff 03 02 04
					39 01 00 00 00 00 05 AE 1E 10 04 01
					29 01 00 00 00 00 04 ff 03 00 00
					39 01 00 00 00 00 05 02 18 00 00 00
					29 01 00 00 00 00 04 ff 03 02 00
					39 01 00 00 00 00 05 C6 50 C8 1C 00
					29 01 00 00 00 00 04 ff 03 03 1C
					39 01 00 00 00 00 05 03 00 00 00 00
					29 01 00 00 00 00 04 ff 03 03 20
					39 01 00 00 00 00 05 03 00 00 00 00
					29 01 00 00 00 00 04 ff 03 03 24
					39 01 00 00 00 00 05 03 00 00 00 00
					29 01 00 00 00 00 04 ff 03 03 28
					39 01 00 00 00 00 05 03 00 00 00 00
					29 01 00 00 00 00 04 ff 03 03 2C
					39 01 00 00 00 00 05 03 00 00 00 00
					05 01 00 00 78 00 02 11 00
					05 01 00 00 78 00 02 29 00
				];

				qcom,mdss-dsi-off-command = [
					05 01 00 00 78 00 02 28 00
					05 01 00 00 78 00 02 10 00];
				qcom,mdss-dsi-on-command-state = "dsi_lp_mode";
				qcom,mdss-dsi-off-command-state = "dsi_hs_mode";
				qcom,mdss-dsi-timing-switch-command-state =
					"dsi_lp_mode";
				qcom,mdss-dsi-h-sync-pulse = <0>;
				qcom,mdss-dsi-panel-phy-timings = [
					00 10 03 03 11 1E 04
					04 03 02 04 00 0E 09];
				qcom,display-topology = <1 0 1>;
				qcom,default-topology-index = <0>;
			};
		};
	};
};
