&mdss_mdp {
	dsi_jbd2520_600x800_60hz_left: qcom,mdss_dsi_jbd2520_600x800_60hz_video_left {
		qcom,mdss-dsi-panel-name =
			"jbd2520 video mode uLED panel left";
		qcom,mdss-dsi-panel-type = "dsi_video_mode";
		qcom,mdss-dsi-virtual-channel-id = <0>;
		qcom,mdss-dsi-stream = <0>;
		qcom,mdss-dsi-bpp = <24>;
		qcom,mdss-dsi-border-color = <0>;
		qcom,dsi-ctrl-num = <0>;
		qcom,dsi-phy-num = <0>;
		qcom,display-type = "primary";
		qcom,mdss-dsi-traffic-mode = "non_burst_sync_event";
		qcom,mdss-dsi-bllp-eof-power-mode;
		qcom,mdss-dsi-bllp-power-mode;
		qcom,mdss-dsi-lane-0-state;
		qcom,mdss-dsi-dma-trigger = "trigger_sw";
		qcom,mdss-dsi-mdp-trigger = "none";
		qcom,mdss-dsi-reset-sequence = <1 1>, <0 1>, <1 1>;

		qcom,dsi-select-clocks = "pll_byte_clk0", "pll_dsi_clk0";
		qcom,mdss-dsi-panel-status-check-mode = "reg_read";
		qcom,mdss-dsi-panel-status-command = [06 01 00 01 00 00 01 0A];
		qcom,mdss-dsi-panel-status-command-state = "dsi_lp_mode";
		qcom,mdss-dsi-panel-status-value = <0x9c>;
		qcom,mdss-dsi-panel-status-read-length = <1>;

		qcom,mdss-dsi-wr-mem-start = <0x2c>;
		qcom,mdss-dsi-wr-mem-continue = <0x3c>;

		qcom,mdss-dsi-bl-pmic-control-type = "bl_ctrl_dcs";
		qcom,mdss-dsi-bl-min-level = <0>;
		qcom,mdss-dsi-bl-max-level = <15>;
		qcom,mdss-dsi-bl-ctrl-dcs-subtype = <0xBA>;
		qcom,mdss-dsi-ext-bridge-mode;

		qcom,mdss-dsi-display-timings {
			timing@0 {
				cell-index = <0>;
				qcom,mdss-dsi-panel-framerate = <60>;
				qcom,mdss-dsi-panel-width = <600>;
				qcom,mdss-dsi-panel-height = <800>;
				qcom,mdss-dsi-h-front-porch = <81>;
				qcom,mdss-dsi-h-back-porch = <12>;
				qcom,mdss-dsi-h-pulse-width = <4>;
				qcom,mdss-dsi-v-back-porch = <18>;
				qcom,mdss-dsi-v-front-porch = <36>;
				qcom,mdss-dsi-v-pulse-width = <2>;

				qcom,mdss-dsi-on-command = [
					/* Green Module Select On */
					15 01 00 00 00 00 02 92 00
					/* Level2 Key Enable */
					39 01 00 00 00 00 03 F0 5A 5A
					/* Set video information */
					39 01 00 00 00 00 0D BF 03 20 02 58 00 14 00 24 00 10 00 51
					/* Input frame rate 60Hz */
					15 01 00 00 00 00 02 BE 01
					/* Refresh rate 240Hz, on_duty 1200 */
					39 01 00 00 00 00 06 B6 01 00 04 B0 02
					/* Panel Update */
					15 01 00 00 00 00 02 F4 01
					/* Sleep out, delay 5ms after send this command */
					05 01 00 00 05 00 01 11
					/* Display On */
					05 01 00 00 00 00 01 29
					/* Level2 Key Enable */
					39 01 00 00 00 00 03 F0 A5 A5
					/* Green Module Select Off */
					15 01 00 00 00 00 02 95 00
				];

				qcom,mdss-dsi-off-command = [
					/* Green Module Select On */
					15 01 00 00 00 00 02 92 00
					/* Level2 Key Enable */
					39 01 00 00 00 00 03 F0 5A 5A
					/* Display Off, delay 5ms after send this command */
					05 01 00 00 05 00 01 28
					/* Sleep in */
					05 01 00 00 00 00 01 10
					/* Level2 Key Enable */
					39 01 00 00 00 00 03 F0 A5 A5
					/* Green Module Select Off */
					15 01 00 00 00 00 02 95 00
				];

				qcom,mdss-dsi-on-command-state = "dsi_lp_mode";
				qcom,mdss-dsi-off-command-state = "dsi_hs_mode";
				qcom,mdss-dsi-h-sync-pulse = <0>;
				qcom,mdss-dsi-panel-phy-timings = [
					00 16 06 05 14 1F 06
					06 06 02 04 00 14 0B];
				qcom,display-topology = <1 0 1>;
				qcom,default-topology-index = <0>;
			};
		};
	};
};
