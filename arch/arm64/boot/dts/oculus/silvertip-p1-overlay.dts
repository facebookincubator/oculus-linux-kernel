/dts-v1/;
/plugin/;

#include "silvertip.dtsi"

/ {
	model = "Silvertip P1";
	compatible = "meta,florian", "meta,silvertip", "meta,silvertip-p1";
	qcom,msm-id = <554 0x10000>;
	qcom,board-id = <59 0x50>;
};
