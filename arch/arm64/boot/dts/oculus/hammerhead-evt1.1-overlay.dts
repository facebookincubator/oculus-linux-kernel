/dts-v1/;
/plugin/;

#include "hammerhead.dtsi"

/ {
	model = "Hammerhead EVT1.1";
	compatible = "meta,hammerhead", "meta,hammerhead-evt1.1";
	qcom,msm-id = <554 0x10000>;
	qcom,board-id = <34 0xa5>;
};
