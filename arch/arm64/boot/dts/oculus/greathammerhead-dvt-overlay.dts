#include "greathammerhead.dtsi"

/ {
	model = "Greathammerhead DVT";
	compatible = "meta,hammerhead", "meta,greathammerhead", "meta,greathammerhead-dvt";
	qcom,msm-id = <554 0x10000>;
	qcom,board-id = <34 0x63>;
};
