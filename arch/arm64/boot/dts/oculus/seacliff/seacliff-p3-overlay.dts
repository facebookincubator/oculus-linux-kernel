// SPDX-License-Identifier: GPL-2.0

/dts-v1/;
/plugin/;

#include "seacliff.dtsi"
#include "seacliff-adc-usbc.dtsi"

/ {
	model = "Seacliff (P3)";
	compatible = "qcom,kona";
	qcom,board-id = <66 68>;
};

&qupv3_se0_spi {
	syncboss_nrf@0 {
		swd@0 {
			meta,fw-path = "syncboss-ipl-spl.bin";
		};
	};
};
