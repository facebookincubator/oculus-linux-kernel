
qcom,5854977_Meta_Seacliff_5514mAH_averaged_MasterSlave_Jun30th2022 {
	qcom,profile-revision = <24>;
	/* 5854977_Meta_Seacliff_5514mAH_averaged_MasterSlave_Jun30th2022 */
	qcom,max-voltage-uv = <4400000>;
	qcom,fastchg-current-ma = <4813>;/* 0.9C */
	qcom,jeita-fcc-ranges-0 = <10 100  534000
				101 150  1069000
				151 200  2139000
				201 250  3208000
				251 450  4813000
				451 550  1069000>;
	qcom,jeita-fcc-ranges-1 = <10 100  534000
				101 150  1069000
				151 200  2139000
				201 250  3208000
				251 450  4813000
				451 550  1069000>;
	qcom,jeita-fv-ranges-0 = <10  100  4400000
				101 200  4400000
				201 450  4400000
				451 550  4200000>;
	qcom,jeita-fv-ranges-1 = <10  100  4100000
				101 200  4100000
				201 450  4100000
				451 550  3900000>;
	qcom,cycle-fcc-ranges-0 = <0  500  4813000
				501 800  4813000>;
	qcom,cycle-fcc-ranges-1 = <0  500  1604000
				501 800  1604000>;
	qcom,cycle-fv-ranges-0 = <0   500  4400000
				501 800  4300000>;
	qcom,cycle-fv-ranges-1 = <0   500  4100000
				501 800  4000000>;
	qcom,chg-disable-ranges-0 = <3600000 4100000 0
				4101000 4400000 0>;
	qcom,chg-disable-ranges-1 = <3600000 4100000 0
				4101000 4400000 1>;
	qcom,rblt-support;
	qcom,rblt-limited-check;
	qcom,rblt-missing-range = <138400 171800>;
	qcom,rblt-ok-range = <127300 138400>;
	qcom,rblt-warn-range = <65000 127300>;
	qcom,rblt-crit-range = <0 65000>;
	/* 1 - OK, 2 - warn, 3 - crit, 4 - missing, 5 - unknown */
	qcom,rblt-ranges = <1 1 4400000
				2 2 4200000
				3 3 4100000
				4 4 4200000
				5 5 4200000>;
	qcom,fct-support;
	qcom,fct-ok-range = <0 765>;
	qcom,fct-warn-range-1 = <765 1530>;
	qcom,fct-warn-range-2 = <1530 3060>;
	qcom,fct-warn-range-3 = <3060 6120>;
	qcom,fct-crit-range = <6120 14057998>;
	/* 0 - OK, 1 - warn-1, 2- warn-2, 3 - warn-3, 4 - crit, 5 - unknown */
	qcom,fct-ranges = <4400000 4350000 4350000 4350000 4350000 4400000>;
	/* UT LT STL RT STH HT OT */
	qcom,fct-weights = <15183 5149 4931 197 381 986 101633>;
	/* Denominator in FCT weights math */
	qcom,fct-weights-div = <10000000 1000000 100000 1000 1000 1000 10000>;
	qcom,step-chg-ranges-0 = <3000000 4200000 4813000
				4201000 4400000 1604000>;
	qcom,step-chg-ranges-1 = <3000000 4000000 1604000
				4001000 4400000 1604000>;
	/* COLD = 0 DegC, HOT = 52 DegC */
	qcom,jeita-hard-thresholds = <0x58cd 0x1882>;
	/* COOL = 10 DegC, WARM = 45 DegC */
	qcom,jeita-soft-thresholds = <0x4ccc 0x20b8>;
	/* COLD hys = 12 DegC, WARM hys = 43 DegC */
	qcom,jeita-soft-hys-thresholds = <0x4a2a 0x22b8>;
	qcom,jeita-soft-fcc-ua = <1069000 1069000>;/* 0.2C */
	qcom,jeita-soft-fv-uv = <4200000 4200000>;
	qcom,vnow-based-step-chg;
	qcom,taper-fcc;
	qcom,fg-cc-cv-threshold-mv = <4390>;
	qcom,nom-batt-capacity-mah = <5514>;/* typical fresh */
	qcom,batt-id-kohm = <300>;
	qcom,battery-beta = <4250>;
	qcom,therm-room-temp = <100000>;
	qcom,battery-type = "5854977_Meta_Seacliff_5514mAH_averaged_MasterSlave_Jun30th2022";
	qcom,therm-coefficients = <0x2318 0xd0c 0xdaf7 0xc556 0x848d>;
	qcom,therm-center-offset = <0x70>;
	qcom,therm-pull-up = <100>;
	qcom,rslow-normal-coeffs = <0x72 0xf2 0xda 0x12>;
	qcom,rslow-low-coeffs = <0xc9 0x15 0xa1 0xea>;
	qcom,checksum = <0xE21C>;
	qcom,gui-version = "PM855GUI - 1.0.0.14";
	qcom,fg-profile-data = [
		 09 00 EE E2
		 03 DD E6 E2
		 A4 DC 00 00
		 9B BD 7C 83
		 FF 87 24 86
		 32 80 FA 87
		 2F 00 72 F2
		 DA 12 60 06
		 EC EB CE 07
		 32 00 6A 00
		 9E ED 39 C5
		 0E 0B 75 E5
		 4C C4 AC EC
		 3C 02 C6 DA
		 60 00 47 00
		 47 00 46 00
		 37 00 2D 00
		 35 00 38 00
		 3F 00 42 00
		 3F 00 60 00
		 34 00 3E 00
		 42 00 3E 00
		 38 00 6D 00
		 59 64 4A 00
		 43 00 41 08
		 60 F8 4F 00
		 4C 08 6A 10
		 61 10 50 00
		 96 28 78 50
		 5E 68 53 09
		 56 00 D8 F8
		 07 20 00 0D
		 B6 02 B7 04
		 FA 1B 6E 0A
		 47 0C F8 23
		 B7 17 D8 42
		 B9 55 8C 02
		 63 13 28 1F
		 1F 04 15 0A
		 C0 FE B8 1C
		 7A FA C0 04
		 AB 03 7B 18
		 C4 22 D6 3D
		 5A 52 6A 14
		 36 1F FE E5
		 2C CA 3D CD
		 CE 1C 6F B3
		 A8 04 EA BB
		 9C 18 91 8A
		 24 84 00 9A
		 7C A0 09 80
		 B3 02 87 05
		 03 02 E7 F2
		 00 00 83 ED
		 62 EA FB 07
		 04 E4 1D B5
		 34 09 22 00
		 C0 CE 4A 02
		 9E 06 46 02
		 CE 07 32 00
		 58 01 4E 02
		 B4 04 48 01
		 C2 05 68 03
		 72 02 09 01
		 60 04 47 00
		 3B 00 46 00
		 4B 64 4F 00
		 50 08 50 08
		 52 00 4C 00
		 55 00 59 08
		 43 08 3A 00
		 52 20 56 48
		 60 58 6D 0E
		 50 00 61 00
		 62 08 70 00
		 61 00 44 00
		 46 10 65 10
		 62 00 76 28
		 8A 48 5C 58
		 6C 0D 74 00
		 7B 00 5F 08
		 D8 F8 CC 21
		 F1 05 49 0B
		 C9 0D F4 1C
		 E7 22 81 44
		 43 53 9D 18
		 E7 03 DD 05
		 3F 03 84 10
		 3F 0A 5D 20
		 D1 04 04 03
		 D7 05 BD 1C
		 2C 03 CB 05
		 5B 02 7C 18
		 11 02 91 05
		 F9 03 6D 00
		 DB 1F 51 05
		 B6 02 2D 04
		 DD 1C 45 02
		 3E 05 11 03
		 A9 18 33 03
		 04 05 D7 03
		 74 00 AC 00
		 C0 00 FA 00
		 0A 16 00 00
	];
};
