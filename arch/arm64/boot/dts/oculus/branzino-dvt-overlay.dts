/dts-v1/;
/plugin/;

#include "branzino.dtsi"

/ {
	model = "Branzino DVT";
	compatible = "meta,florian", "meta,branzino", "meta,branzino-dvt";
	qcom,msm-id = <554 0x10000>;
	qcom,board-id = <61 0x21>;
};
