
&mdss_mdp {
	dsi_dual_auo_video: qcom,mdss_dsi_auo_960x1600_video {
		qcom,mdss-dsi-panel-name = "Dual AUO video mode dsi panel";
		qcom,mdss-dsi-panel-type = "dsi_video_mode";

		// orientation, resolution
		qcom,mdss-dsi-panel-width = <960>;
		qcom,mdss-dsi-panel-height = <1600>;

		// physical dimensions
		// note: physical width counts *both* screens
		qcom,mdss-pan-physical-width-dimension = <118>;
		qcom,mdss-pan-physical-height-dimension = <66>;

		qcom,mdss-dsi-panel-hdr-enabled;
		// Scale by 1 / 50000 to get x & y coordinates
		qcom,mdss-dsi-panel-hdr-color-primaries = <
			15000 16000 // W - x: 0.300, y: 0.320
			33500 16500 // R - x: 0.670, y: 0.330
			11800 35550 // G - x: 0.236. y: 0.711
			6500 3250>; // B - x: 0.130, y: 0.065
		// Scale by 1 / 10000 to get nits
		qcom,mdss-dsi-panel-peak-brightness = <1000000>;
		qcom,mdss-dsi-panel-blackness-level = <50>;

		// timings
		qcom,mdss-dsi-panel-framerate = <72>;
		qcom,mdss-dsi-h-front-porch = <16>;
		qcom,mdss-dsi-h-back-porch = <8>;
		qcom,mdss-dsi-h-pulse-width = <8>;
		qcom,mdss-dsi-h-sync-skew = <0>;
		qcom,mdss-dsi-v-front-porch = <16>;
		qcom,mdss-dsi-v-back-porch = <8>;
		qcom,mdss-dsi-v-pulse-width = <8>;

		// border
		qcom,mdss-dsi-h-left-border = <0>;
		qcom,mdss-dsi-h-right-border = <0>;
		qcom,mdss-dsi-v-top-border = <0>;
		qcom,mdss-dsi-v-bottom-border = <0>;
		qcom,mdss-dsi-bpp = <24>;

		// sync
		qcom,mdss-dsi-traffic-mode = "non_burst_sync_event";
		qcom,cmd-sync-wait-broadcast;
		qcom,mdss-dsi-h-sync-pulse = <0>;

		// power & reset
		qcom,mdss-dsi-bllp-eof-power-mode;
		qcom,mdss-dsi-bllp-power-mode;
		qcom,mdss-dsi-lp11-init;
		qcom,mdss-dsi-reset-sequence = <1 10>, <0 10>, <1 50>;

		// 4 lanes enabled, timings from QC spreadsheet
		qcom,mdss-dsi-lane-0-state;
		qcom,mdss-dsi-lane-1-state;
		qcom,mdss-dsi-lane-2-state;
		qcom,mdss-dsi-lane-3-state;
		qcom,mdss-dsi-panel-timings = [
			00 19 06 06 21 20 06 06 04 03 04 00
		];
		qcom,mdss-dsi-t-clk-post = <0xc>;
		qcom,mdss-dsi-t-clk-pre = <0x28>;
		qcom,mdss-dsi-dma-trigger = "trigger_sw";
		qcom,mdss-dsi-mdp-trigger = "none";

		// backlight
		qcom,mdss-dsi-bl-pmic-control-type = "bl_ctrl_dcs";
		qcom,mdss-dsi-bl-min-level = <1>;
		qcom,mdss-dsi-bl-max-level = <255>;

		// found in the AUO panel operating guide
		qcom,mdss-dsi-on-command = [
			/* AUO Initial Settings */
			15 01 00 00 00 00 02 fe 0a
			15 01 00 00 00 00 02 25 00
			15 01 00 00 00 00 02 fe 0d
			15 01 00 00 00 00 02 7d 84
			15 01 00 00 00 00 02 fe 04
			15 01 00 00 00 00 02 66 01
			15 01 00 00 00 00 02 fe 00
			15 01 00 00 00 00 02 c2 03
			/* TE Signal Enable for Vsync */
			39 01 00 00 00 00 03 44 00 00
			15 01 00 00 00 00 02 35 00
			/* exit sleep mode, wait 200ms */
			05 01 00 00 3C 00 01 11
			/* Set display on, wait 200ms */
			05 01 00 00 3C 00 01 29
		];
		qcom,mdss-dsi-off-command = [
			/* set display off */
			05 01 00 00 32 00 02 28 00
			/* enter sleep mode */
			05 01 00 00 78 00 02 10 00
		];

		// before video is on, the DSI panels typically
		// accept either hs or lp, but lp is prefered.
		qcom,mdss-dsi-on-command-state = "dsi_lp_mode";
		// once video is on, the DSI panels typically
		// only accept hs mode commands
		qcom,mdss-dsi-off-command-state = "dsi_hs_mode";

		qcom,config-select = <&dsi_dual_auo_video_config0>;
		dsi_dual_auo_video_config0: config0 {
			qcom,split-mode = "dualctl-split";
		};
		dsi_dual_auo_video_config1: config1 {
			qcom,split-mode = "pingpong-split";
		};
	};
};
