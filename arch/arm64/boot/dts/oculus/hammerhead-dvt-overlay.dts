/dts-v1/;
/plugin/;

#include "hammerhead.dtsi"
#include "hammerhead-thermal.dtsi"

/ {
	model = "Hammerhead DVT";
	compatible = "meta,hammerhead", "meta,hammerhead-dvt";
	qcom,msm-id = <554 0x10000>;
	qcom,board-id = <34 0xa7>;
};
