/dts-v1/;
/plugin/;

#include "seacliff-p2.dtsi"

/ {
	model = "Seacliff (P2)";
	compatible = "qcom,kona";
	qcom,board-id = <66 64>;
};

&qupv3_se19_spi {
	oculusnrf@0 {
		swd@0 {
			oculus,fw-path = "syncboss-ipl-spl.bin";
		};
	};
};
