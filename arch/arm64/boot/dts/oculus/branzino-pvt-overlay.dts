/dts-v1/;
/plugin/;

#include "branzino.dtsi"

/ {
	model = "Branzino PVT";
	compatible = "meta,florian", "meta,branzino", "meta,branzino-pvt";
	qcom,msm-id = <554 0x10000>;
	qcom,board-id = <61 0x22>;
};
