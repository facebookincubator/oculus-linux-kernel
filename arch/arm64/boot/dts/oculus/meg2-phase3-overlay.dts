// SPDX-License-Identifier: GPL-2.0

/dts-v1/;
/plugin/;

#include "meg2.dtsi"
#include "meg2-avo.dtsi"
#include "meg2-phase3-left-imu.dtsi"
#include "meta-neo-camera-ov05c.dtsi"

/ {
	model = "Meg2 Dev0 (Phase3) NFF";
	compatible = "meta,meg2";
	qcom,msm-id = <579 0x10000>;
	qcom,board-id = <34 0xE3>;
};
