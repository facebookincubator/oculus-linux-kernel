#include "vendor-base/qcom/audio/neo-audio.dtsi"
#include "vendor-base/qcom/audio/waipio-lpi.dtsi"
#include "vendor-base/qcom/camera/neo_la-camera.dtsi"
#include "vendor-base/qcom/eva/neo-eva.dtsi"
#include "vendor-base/qcom/video/neo-vidc.dtsi"
#include "vendor-base/qcom/mmrm/neo-mmrm.dtsi"
#include "neo-prune.dtsi"

/delete-node/ &cam_csiphy_tpg13;
/delete-node/ &cam_csiphy_tpg14;
/delete-node/ &cam_csiphy_tpg15;

/delete-node/ &battery;
/delete-node/ &battery_630mAh;
/delete-node/ &battery_645mAh;
/delete-node/ &bq27421;
/delete-node/ &charger;
