/* Copyright (c) 2016, The Linux Foundation. All rights reserved.
 *
 * This program is free software; you can redistribute it and/or modify
 * it under the terms of the GNU General Public License version 2 and
 * only version 2 as published by the Free Software Foundation.
 *
 * This program is distributed in the hope that it will be useful,
 * but WITHOUT ANY WARRANTY; without even the implied warranty of
 * MERCHANTABILITY or FITNESS FOR A PARTICULAR PURPOSE.  See the
 * GNU General Public License for more details.
 */


/dts-v1/;

#include "vs1-dvt.dtsi"

/ {
	model = "vs1 dvt (SDC)";
	compatible = "qcom,apq8998-mtp", "qcom,apq8998", "qcom,mtp";
	qcom,board-id = <0x08 0x0A>;
};

&pmi8998_wled {
	qcom,avdd-target-voltage-mv = <7300>;
};
