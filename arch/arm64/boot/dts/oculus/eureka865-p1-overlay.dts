// SPDX-License-Identifier: GPL-2.0

/dts-v1/;
/plugin/;

#include "eureka865.dtsi"
#include "eureka865-p1.dtsi"

/ {
	model = "Eureka865 (P1)";
	compatible = "qcom,kona";
	qcom,board-id = <68 147>, <68 148>;
};
