/* Copyright (c) 2016-2017, The Linux Foundation. All rights reserved.
 *
 * This program is free software; you can redistribute it and/or modify
 * it under the terms of the GNU General Public License version 2 and
 * only version 2 as published by the Free Software Foundation.
 *
 * This program is distributed in the hope that it will be useful,
 * but WITHOUT ANY WARRANTY; without even the implied warranty of
 * MERCHANTABILITY or FITNESS FOR A PARTICULAR PURPOSE.  See the
 * GNU General Public License for more details.
 */

//JDI/NVT panel 3664x1920(24bpp) @ 120Hz


&mdss_mdp {
	dsi_jdi_nvt_4k_120Hz_dsc_video: qcom,mdss_dsi_jdi_nvt_4k_120Hz_dsc_video {
		qcom,mdss-dsi-panel-name = "jdi nvt 4k video mode dsc dsi panel";
		qcom,dsi-ctrl-num = <0 1>;
		qcom,dsi-phy-num = <0 1>;
		qcom,mdss-dsi-panel-type = "dsi_video_mode";
		qcom,mdss-dsi-virtual-channel-id = <0>;
		qcom,mdss-dsi-stream = <0>;
		qcom,mdss-dsi-bpp = <24>; /* TBD */
		qcom,mdss-dsi-border-color = <0>;
		qcom,mdss-dsi-traffic-mode = "non_burst_sync_event";
		qcom,mdss-dsi-bllp-eof-power-mode;
		qcom,mdss-dsi-bllp-power-mode;
		qcom,mdss-dsi-lane-0-state;
		qcom,mdss-dsi-lane-1-state;
		qcom,mdss-dsi-lane-2-state;
		qcom,mdss-dsi-lane-3-state;
		qcom,mdss-dsi-dma-trigger = "trigger_sw";
		qcom,mdss-dsi-mdp-trigger = "none";
		qcom,mdss-dsi-reset-sequence = <0 5>, <1 25>;
		qcom,adjust-timer-wakeup-ms = <1>;
		qcom,dsi-supported-dfps-list = <90 120 80 72 60>;
		qcom,mdss-dsi-pan-enable-dynamic-fps;
		qcom,mdss-dsi-pan-fps-update = "dfps_immediate_porch_mode_vfp";
		qcom,mdss-dsi-min-refresh-rate = <60>;
		qcom,mdss-dsi-max-refresh-rate = <120>;
		qcom,mdss-dsi-force-clock-lane-hs;
		qcom,mdss-dsi-display-timings {
			timing@0{
				qcom,mdss-dsi-panel-width = <960>;
				qcom,mdss-dsi-panel-height = <3664>;
				qcom,mdss-dsi-h-front-porch = <56>;
				qcom,mdss-dsi-h-back-porch = <44>;
				qcom,mdss-dsi-h-pulse-width = <12>;
				qcom,mdss-dsi-h-sync-skew = <0>;
				qcom,mdss-dsi-v-back-porch = <15>;
				qcom,mdss-dsi-v-front-porch = <16>;
				qcom,mdss-dsi-v-pulse-width = <1>;
				qcom,mdss-dsi-h-sync-pulse = <0>;
				qcom,mdss-dsi-panel-framerate = <120>;

				qcom,mdss-dsi-on-command = [
					29 01 00 00 00 00 02 FF 23 //page 3 is selected(BBL Function Setting)
					29 01 00 00 00 00 02 00 00
					29 01 00 00 00 00 02 B4 30 //D4:EN_BBL
					29 01 00 00 00 00 02 B6 01
					29 01 00 00 00 00 02 B8 03 //PV1TES1[12:8] multiply 4 = h lines
					29 01 00 00 00 00 02 B9 3F //PV1TES1[7:0] - - BCKLIGHT0: delay before pulse 1
					29 01 00 00 00 00 02 BA 00 //PV1TEW1[13:8] multiply 2 = h lines
					29 01 00 00 00 00 02 BB B7 //PV1TEW1[7:0] - - pulse 1 duty -- > right panel
					29 01 00 00 00 00 02 BC 00
					29 01 00 00 00 00 02 BD FF
					29 01 00 00 00 00 02 BE 00
					29 01 00 00 00 00 02 BF 00
					29 01 00 00 00 00 02 C0 01 //PV1TES2[12:8]
					29 01 00 00 00 00 02 C1 6C //PV1TES2[7:0] - - delay before pulse 2
					29 01 00 00 00 00 02 C2 00 //PV1TEW2[13:8]
					29 01 00 00 00 00 02 C3 B7 //PV1TEW2[7:0] - - pulse 2 duty --> left panel
					29 01 00 00 00 00 02 C4 00
					29 01 00 00 00 00 02 C5 FF
					29 01 00 00 00 00 02 C6 00
					29 01 00 00 00 00 02 C7 00 //C0-C7  - - BCKLIGHT1
					29 01 00 00 00 00 02 D0 01 //BBL 2 pulse mode
					29 01 00 00 00 00 02 D1 03 //Enable BBL1 & BBL2
					29 01 00 00 00 00 02 FB 01
					29 01 00 00 00 00 02 FF 25
					29 01 00 00 00 00 02 CC 00
					29 01 00 00 00 00 02 CD 10
					29 01 00 00 00 00 02 CE 00
					29 01 00 00 00 00 02 CF 10
					29 01 00 00 00 00 02 D0 00
					29 01 00 00 00 00 02 D1 10
					29 01 00 00 00 00 02 D2 00
					29 01 00 00 00 00 02 D3 10
					29 01 00 00 00 00 02 77 00
					29 01 00 00 00 00 02 78 10
					29 01 00 00 00 00 02 79 00
					29 01 00 00 00 00 02 7A 10
					29 01 00 00 00 00 02 7B 00
					29 01 00 00 00 00 02 7C 10
					29 01 00 00 00 00 02 7D 00
					29 01 00 00 00 00 02 7E 10
					29 01 00 00 00 00 02 D4 00
					29 01 00 00 00 00 02 D5 10
					29 01 00 00 00 00 02 D6 00
					29 01 00 00 00 00 02 D7 10
					29 01 00 00 00 00 02 D8 00
					29 01 00 00 00 00 02 D9 10
					29 01 00 00 00 00 02 DA 00
					29 01 00 00 00 00 02 DB 10
					29 01 00 00 00 00 02 BC FF
					29 01 00 00 00 00 02 BD FF
					29 01 00 00 00 00 02 BE 00
					29 01 00 00 00 00 02 BF 10
					29 01 00 00 00 00 02 C0 FF
					29 01 00 00 00 00 02 C1 FF
					29 01 00 00 00 00 02 C2 FF
					29 01 00 00 00 00 02 C3 FF
					29 01 00 00 00 00 02 FB 01
					15 01 00 00 20 00 02 FF 10
					15 01 00 00 20 00 02 03 01
					15 01 00 00 20 00 02 BB 03
					15 01 00 00 20 00 02 C0 03
					39 01 00 00 00 00 05 2A 00 00 07 7F
					39 01 00 00 00 00 05 2B 00 00 0E 4F
					39 01 00 00 00 00 11 C1 89 28 00 10 C2 00 02 E0 01 F0 00 0D 06 67 03 94
					39 01 00 00 00 00 03 C2 10 F0
					15 01 00 00 20 00 02 35 00
					15 01 00 00 20 00 02 36 00
					15 01 00 00 20 00 02 3A 77
					39 01 00 00 00 00 03 44 00 00
					39 01 00 00 00 00 02 51 FF
					15 01 00 00 20 00 02 53 24 //enable backlight
					15 01 00 00 20 00 02 FB 01
					05 01 00 00 0A 00 01 29
					05 01 00 00 00 00 01 11
				];
				qcom,mdss-dsi-on-command-state = "dsi_lp_mode";
				qcom,mdss-dsi-off-command = [
					15 01 00 00 00 00 02 FF 10
					05 01 00 00 00 00 01 28
					05 01 00 00 00 00 01 34
					05 01 00 00 78 00 01 10
				];
				qcom,mdss-dsi-off-command-state = "dsi_hs_mode";
				qcom,compression-mode = "dsc";
				qcom,mdss-dsc-slice-height = <16>;
				qcom,mdss-dsc-slice-width = <960>;
				qcom,mdss-dsc-slice-per-pkt = <2>;
				qcom,mdss-dsc-bit-per-component = <8>;
				qcom,mdss-dsc-bit-per-pixel = <8>;
				qcom,mdss-dsc-block-prediction-enable;
			};
		};
	};
};
