/dts-v1/;
/plugin/;

#include "oatmeal.dtsi"

/ {
	model = "Oatmeal EVT-S";
	compatible = "meta,oatmeal", "meta,oatmeal-evt-s";
	qcom,msm-id = <579 0x10000>;
	qcom,board-id = <34 0xc6>;
};

&pcal6408 {
	status = "ok";
};

&tps61280 {
	status = "ok";
};

&bbc_ctrl {
	status = "ok";
};
