/* Copyright (c) 2016-2017, The Linux Foundation. All rights reserved.
 *
 * This program is free software; you can redistribute it and/or modify
 * it under the terms of the GNU General Public License version 2 and
 * only version 2 as published by the Free Software Foundation.
 *
 * This program is distributed in the hope that it will be useful,
 * but WITHOUT ANY WARRANTY; without even the implied warranty of
 * MERCHANTABILITY or FITNESS FOR A PARTICULAR PURPOSE.  See the
 * GNU General Public License for more details.
 */

// NT 57950 uOLED panels, DSC, 2784 X 3000 @ 90Hz


&mdss_mdp {
	dsi_dual_nt57950_uoled_dsc_video: qcom,mdss_dsi_dual_nt57950_uoled_dsc_video {
		qcom,mdss-dsi-panel-name = "NT57950 UOLED dual video mode dsi panel with dsc";
		qcom,mdss-dsi-panel-type = "dsi_video_mode";
		qcom,dsi-ctrl-num = <0 1>;
		qcom,dsi-phy-num = <0 1>;
		qcom,mdss-dsi-bpp = <24>;

		com,mdss-dsi-virtual-channel-id = <0>; //TODO
		qcom,mdss-dsi-stream = <0>; //TODO
		qcom,mdss-dsi-border-color = <0>; //TODO
		qcom,mdss-dsi-traffic-mode = "burst_mode";
		qcom,mdss-dsi-bllp-eof-power-mode;
		qcom,mdss-dsi-bllp-power-mode;
		qcom,mdss-dsi-lane-0-state;
		qcom,mdss-dsi-lane-1-state;
		qcom,mdss-dsi-lane-2-state;
		qcom,mdss-dsi-dma-trigger = "trigger_sw";
		qcom,mdss-dsi-mdp-trigger = "none";
		qcom,mdss-dsi-reset-sequence = <1 20>, <0 20>, <1 20>;
		qcom,adjust-timer-wakeup-ms = <1>;
		qcom,mdss-dsi-lp11-init;
		qcom,mdss-dsi-tx-eot-append;
		qcom,cmd-sync-wait-broadcast;

		qcom,panel-cphy-mode;

		qcom,dsi-supported-dfps-list = <90>;
		qcom,mdss-dsi-pan-enable-dynamic-fps;
		qcom,mdss-dsi-pan-fps-update = "dfps_immediate_porch_mode_hfp";
		qcom,mdss-dsi-min-refresh-rate = <60>;
		qcom,mdss-dsi-max-refresh-rate = <90>;
		qcom,mdss-dsi-display-timings {
			timing@0{
				qcom,mdss-dsi-panel-width = <2768>;
				qcom,mdss-dsi-panel-height = <3000>;
				qcom,mdss-dsi-h-front-porch = <39>;
				qcom,mdss-dsi-h-back-porch = <40>;
				qcom,mdss-dsi-h-pulse-width = <2>;
				qcom,mdss-dsi-h-sync-skew = <0>;
				qcom,mdss-dsi-v-front-porch = <8>;
				qcom,mdss-dsi-v-back-porch = <8>;
				qcom,mdss-dsi-v-pulse-width = <1>;
				qcom,mdss-dsi-h-sync-pulse = <0>;
				qcom,mdss-dsi-panel-framerate = <90>;

				qcom,mdss-dsi-bpp = <24>;

				qcom,mdss-dsi-on-command = [
					15 01 00 00 00 00 02 FF 27
					15 01 00 00 00 00 02 FB 01
					15 01 00 00 00 00 02 18 29
					15 01 00 00 00 00 02 19 57
					15 01 00 00 00 00 02 1A 37
					15 01 00 00 00 00 02 FF 10
					15 01 00 00 00 00 02 FF 24
					15 01 00 00 00 00 02 FB 01
					15 01 00 00 00 00 02 09 25
					15 01 00 00 00 00 02 1D 25
					15 01 00 00 00 00 02 EF 75
					15 01 00 00 00 00 02 72 20
					15 01 00 00 00 00 02 81 20
					15 01 00 00 00 00 02 E5 2E
					15 01 00 00 00 00 02 E6 3A
					15 01 00 00 00 00 02 C2 00
					15 01 00 00 00 00 02 60 BA
					15 01 00 00 00 00 02 61 B8
					15 01 00 00 00 00 02 62 E0
					15 01 00 00 00 00 02 93 08
					15 01 00 00 00 00 02 94 08
					15 01 00 00 00 00 02 95 40
					15 01 00 00 00 00 02 96 C7
					15 01 00 00 00 00 02 97 0B
					15 01 00 00 00 00 02 FF 10
					15 01 00 00 00 00 02 FF F0
					15 01 00 00 00 00 02 FB 01
					15 01 00 00 00 00 02 E5 00
					15 01 00 00 00 00 02 FF 10
					15 01 00 00 00 00 02 FF 20
					15 01 00 00 00 00 02 FB 01
					15 01 00 00 00 00 02 0C 57
					15 01 00 00 00 00 02 FF 10
					15 01 00 00 00 00 02 FF 2A
					15 01 00 00 00 00 02 FB 01
					39 01 00 00 00 00 0B B3 01 32 01 32 01 32 01 32 01 32
					39 01 00 00 00 00 0D B3 01 32 01 32 01 32 01 32 01 32 01 32
					15 01 00 00 00 00 02 FF 10
					39 01 00 00 00 00 11 C1 89 28 00 0C C2 00 03 B8 01 9C 00 13 08 BB 03 4A
					39 01 00 00 00 00 03 C2 10 F0
					05 01 00 00 C8 00 01 11
					15 01 00 00 00 00 02 FF 10
					15 01 00 00 00 00 02 FB 01
					39 01 00 00 00 00 03 35 00 04
					39 01 00 00 00 00 03 44 00 01
					39 01 00 00 00 00 02 36 00
					39 01 00 00 FF 00 03 51 0F FF
					39 01 00 00 FF 00 01 00
					39 01 00 00 FF 00 01 00
					39 01 00 00 FF 00 01 00
					05 01 00 00 C8 00 01 29
				];

				qcom,mdss-dsi-off-command = [
					05 01 00 00 14 00 02 28 00
					05 01 00 00 78 00 02 10 00
				];

				// before video is on, the DSI panels typically
				// accept either hs or lp, but lp is prefered.
				qcom,mdss-dsi-on-command-state = "dsi_lp_mode";
				// once video is on, the DSI panels typically
				// only accept hs mode commands
				qcom,mdss-dsi-off-command-state = "dsi_hs_mode";
				qcom,compression-mode = "dsc";
				qcom,mdss-dsc-slice-height = <24>;
				qcom,mdss-dsc-slice-width = <692>;
				qcom,mdss-dsc-slice-per-pkt = <2>;
				qcom,mdss-dsc-bit-per-component = <8>;
				qcom,mdss-dsc-bit-per-pixel = <8>;
				qcom,mdss-dsc-block-prediction-enable;

				qcom,mdss-dsi-pre-post-panel-on-delay = <100>;
				qcom,mdss-dsi-post-panel-on-command = [
					15 01 00 00 00 00 02 35 00
				];
			};
		};
	};
};
