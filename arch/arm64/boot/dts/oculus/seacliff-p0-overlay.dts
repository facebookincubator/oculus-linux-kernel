/dts-v1/;
/plugin/;

#include "seacliff-p0.dtsi"

/ {
	model = "Seacliff (P0)";
	compatible = "qcom,kona";
	qcom,board-id = <66 61>;
};

&qupv3_se19_spi {
	oculusnrf@0 {
		swd@0 {
			oculus,fw-path = "syncboss-ipl-spl.bin";
		};
	};
};
