/dts-v1/;
/plugin/;

#include "seacliff-p0.dtsi"
#include "seacliff-dd.dtsi"

/ {
	model = "Seacliff (P0) DD Rev 1.5";
	compatible = "qcom,kona-mtp", "qcom,kona", "qcom,mtp";
	qcom,board-id = <8 97>;
};
