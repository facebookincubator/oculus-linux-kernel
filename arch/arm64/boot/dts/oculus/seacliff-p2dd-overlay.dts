/dts-v1/;
/plugin/;

#include "seacliff-p2.dtsi"
#include "seacliff-dd.dtsi"

/ {
	model = "Seacliff (P2) DD";
	compatible = "qcom,kona";
	qcom,board-id = <66 98>;
};

&cypd3177 {
	status = "disabled";
};
