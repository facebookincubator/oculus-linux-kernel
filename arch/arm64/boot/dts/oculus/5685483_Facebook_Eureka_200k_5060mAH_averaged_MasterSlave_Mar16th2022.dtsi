
qcom,5685483_facebook_eureka_5060mah_averaged_masterslave_mar16th2022 {
	qcom,profile-revision = <24>;
	/* #5685483_Facebook_Eureka_5060mAH_averaged_MasterSlave_Mar16th2022*/
	qcom,max-voltage-uv = <4450000>;
	qcom,fastchg-current-ma = <3542>;/* 0.7C */
	qcom,jeita-fcc-ranges-0 = <10 100  1012000
				101 200  2530000
				201 450  3542000
				451 550  2530000>;
	qcom,jeita-fcc-ranges-1 = <10 100  1012000
				101 200  2530000
				201 450  3542000
				451 550  2530000>;
	qcom,jeita-fv-ranges-0 = <10  100  4450000
				101 200  4450000
				201 450  4450000
				451 550  4180000>;
	qcom,jeita-fv-ranges-1 = <10  100  4200000
				101 200  4200000
				201 450  4200000
				451 550  4000000>;
	qcom,chg-disable-ranges-0 = <3600000 4100000 0
				4101000 4450000 0>;
	qcom,chg-disable-ranges-1 = <3600000 4100000 0
				4101000 4450000 1>;
	/* COLD = 0 DegC, HOT = 52 DegC */
	qcom,jeita-hard-thresholds = <0x58cd 0x1882>;
	/* COOL = 10 DegC, WARM = 45 DegC */
	qcom,jeita-soft-thresholds = <0x4ccc 0x20b8>;
	/* COLD hys = 12 DegC, WARM hys = 43 DegC */
	qcom,jeita-soft-hys-thresholds = <0x4a2a 0x22b8>;
	qcom,jeita-soft-fcc-ua = <1012000 1012000>;/* 0.2C */
	qcom,jeita-soft-fv-uv = <4180000 4180000>;
	qcom,vnow-based-step-chg;
	qcom,taper-fcc;
	qcom,fg-cc-cv-threshold-mv = <4390>;
	qcom,nom-batt-capacity-mah = <5060>;
	qcom,batt-id-kohm = <200>;
	qcom,battery-beta = <4250>;
	qcom,therm-room-temp = <100000>;
	qcom,battery-type = "5685483_facebook_eureka_5060mah_averaged_masterslave_mar16th2022";
	qcom,therm-coefficients = <0x2318 0xd0c 0xdaf7 0xc556 0x848d>;
	qcom,therm-center-offset = <0x70>;
	qcom,therm-pull-up = <100>;
	qcom,rslow-normal-coeffs = <0x49 0x0d 0x20 0x12>;
	qcom,rslow-low-coeffs = <0x65 0x14 0xbb 0x05>;
	qcom,checksum = <0x1B45>;
	qcom,gui-version = "PM855GUI - 1.0.0.14";
	qcom,fg-profile-data = [
		 09 00 A1 E3
		 C7 DC 0C E3
		 94 DC 00 00
		 41 B4 1D 83
		 FE 87 CB 9D
		 65 8A 37 80
		 1C 00 49 0D
		 20 12 0F 05
		 DF 01 CE 07
		 32 00 32 EB
		 81 ED 47 C5
		 F5 0B C5 E3
		 E7 BD 25 04
		 CD 00 8E CA
		 60 00 45 00
		 49 00 4B 00
		 35 00 2D 00
		 34 00 3F 00
		 41 00 46 00
		 3D 00 60 00
		 33 00 3B 00
		 43 00 3D 00
		 36 00 70 00
		 52 64 45 00
		 43 00 41 08
		 60 00 49 00
		 50 00 73 10
		 5C 10 4C 00
		 9F 28 6F 48
		 5A 60 4F 0B
		 4D 00 D8 08
		 ED 1F DA 14
		 2E 03 AE FD
		 61 1C 80 03
		 71 05 E1 22
		 79 17 AC 42
		 6C 5C 4F 03
		 66 10 EA 21
		 7F 05 3F 0A
		 69 04 F3 1C
		 1F 03 61 05
		 3D 03 97 17
		 FF 23 36 44
		 72 52 91 11
		 E3 20 1A E4
		 C0 CB 09 CD
		 E9 1C 84 B9
		 AA 05 FD B2
		 CF 17 98 83
		 CB 84 E7 9B
		 8D A0 09 80
		 62 03 A9 04
		 30 02 12 FB
		 00 00 3D D4
		 EE E3 FB 07
		 8D DA 28 BD
		 6A 18 13 00
		 6D 06 72 02
		 AB 05 43 03
		 CE 07 32 00
		 81 01 E6 02
		 0B 04 58 02
		 B0 03 09 05
		 51 03 3E 01
		 F3 07 50 00
		 3E 00 43 00
		 44 64 47 00
		 45 00 44 08
		 48 F8 46 00
		 47 00 46 10
		 41 10 3D 00
		 4F 28 4E 48
		 55 60 65 0D
		 45 00 4E 00
		 56 08 58 00
		 4C 00 3F 00
		 48 08 57 10
		 52 00 68 20
		 7C 40 4D 58
		 5E 0E 59 00
		 4D 08 2F 10
		 D8 08 1A 20
		 6B 05 8F 02
		 7D 04 D0 1C
		 4C 23 C8 45
		 57 5A 62 18
		 26 02 78 05
		 11 02 6B 10
		 3F 0A 56 20
		 C3 04 58 03
		 57 05 D4 1C
		 F8 02 05 04
		 37 02 8F 18
		 B8 03 12 04
		 E0 02 6C 00
		 E7 22 01 05
		 A1 02 D2 05
		 FF 1C CD 01
		 CB 04 AF 03
		 92 18 6F 03
		 AC 04 37 02
		 91 00 2E 01
		 C0 00 FA 00
		 B4 13 00 00
	];
};
