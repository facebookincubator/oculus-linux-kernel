
qcom,5133886_facebook_sealiff_5348mah_averaged_masterslave_apr23rd2021 {
	qcom,profile-revision = <24>;
	/* #5133886_Facebook_Sealiff_5348mAH_averaged_MasterSlave_Apr23rd2021*/
	qcom,max-voltage-uv = <4400000>;
	qcom,fastchg-current-ma = <4813>;/* 0.9C */
	qcom,jeita-fcc-ranges-0 = <10 100  534000
				101 200  2674000
				201 450  4813000
				451 550  1069000>;
	qcom,jeita-fcc-ranges-1 = <10 100  534000
				101 200  2674000
				201 450  4813000
				451 550  1069000>;
	qcom,jeita-fv-ranges-0 = <10  100  4400000
				101 200  4400000
				201 450  4400000
				451 550  4200000>;
	qcom,jeita-fv-ranges-1 = <10  100  4100000
				101 200  4100000
				201 450  4100000
				451 550  3900000>;
	qcom,cycle-fcc-ranges-0 = <0  500  4813000
				501 800  4813000>;
	qcom,cycle-fcc-ranges-1 = <0  500  2674000
				501 800  2674000>;
	qcom,cycle-fv-ranges-0 = <0   500  4400000
				501 800  4300000>;
	qcom,cycle-fv-ranges-1 = <0   500  4100000
				501 800  4000000>;
	qcom,chg-disable-ranges-0 = <3600000 4100000 0
				4101000 4400000 0>;
	qcom,chg-disable-ranges-1 = <3600000 4100000 0
				4101000 4400000 1>;
	/* rblt-low, rblt-high, max-voltage-throttle */
	qcom,rblt-ranges = <0 72200 3900000
				72300 134800 4200000
				134900 145700 4400000
				145800 179400 4200000>;
	qcom,rblt-limited-check;
	qcom,step-chg-ranges-0 = <3000000 4200000 4813000
				4201000 4400000 2674000>;
	qcom,step-chg-ranges-1 = <3000000 4000000 2674000
				4001000 4400000 2674000>;
	/* COLD = 0 DegC, HOT = 52 DegC */
	qcom,jeita-hard-thresholds = <0x58cd 0x1882>;
	/* COOL = 10 DegC, WARM = 45 DegC */
	qcom,jeita-soft-thresholds = <0x4ccc 0x20b8>;
	/* COLD hys = 12 DegC, WARM hys = 43 DegC */
	qcom,jeita-soft-hys-thresholds = <0x4a2a 0x22b8>;
	qcom,jeita-soft-fcc-ua = <1069000 1069000>;/* 0.2C */
	qcom,jeita-soft-fv-uv = <4200000 4200000>;
	qcom,vnow-based-step-chg;
	qcom,taper-fcc;
	qcom,fg-cc-cv-threshold-mv = <4390>;
	qcom,nom-batt-capacity-mah = <5348>;
	qcom,batt-id-kohm = <200>;
	qcom,battery-beta = <4250>;
	qcom,therm-room-temp = <100000>;
	qcom,battery-type = "5133886_facebook_sealiff_5348mah_averaged_masterslave_apr23rd2021";
	qcom,therm-coefficients = <0x2318 0xd0c 0xdaf7 0xc556 0x848d>;
	qcom,therm-center-offset = <0x70>;
	qcom,therm-pull-up = <100>;
	qcom,rslow-normal-coeffs = <0x5d 0x02 0x35 0x13>;
	qcom,rslow-low-coeffs = <0x48 0x0c 0x31 0x01>;
	qcom,checksum = <0x6647>;
	qcom,gui-version = "PM855GUI - 1.0.0.14";
	qcom,fg-profile-data = [
		 09 00 69 E3
		 74 DC 4F E3
		 52 DC 00 00
		 67 BD 98 83
		 00 00 A2 82
		 55 95 3A 80
		 2C 00 5D 02
		 35 13 66 05
		 54 01 CE 07
		 32 00 F9 EB
		 61 ED DF DC
		 A6 0B 04 E4
		 C9 CD C6 EA
		 07 03 8D DA
		 60 00 48 00
		 47 00 44 00
		 3A 00 2E 00
		 34 00 35 00
		 3F 00 41 00
		 40 00 60 00
		 31 00 37 00
		 3C 00 38 00
		 34 00 5D 00
		 4E 64 44 00
		 3D F8 3D 00
		 60 F0 55 00
		 54 00 73 08
		 66 10 56 00
		 AE 20 7C 40
		 62 58 54 0F
		 57 00 D8 00
		 F2 1E 0D 05
		 53 EB CB 04
		 C0 1C B3 0A
		 60 0C 09 22
		 94 18 67 43
		 A4 54 4D 02
		 65 11 B4 1E
		 CC 06 A9 02
		 FE F4 CC 1C
		 3B 02 35 05
		 1E 03 34 18
		 62 23 EE 44
		 D6 53 6A 14
		 AA 1E C1 E6
		 F4 CA 89 CD
		 D3 1C B0 B1
		 B9 04 CC BB
		 45 18 D7 8A
		 CE 85 56 9A
		 78 A0 09 80
		 12 03 CF 04
		 8C FA DE F2
		 00 F8 6D ED
		 46 02 FC EF
		 FC DD 5B 84
		 3B 11 1D F8
		 9F DE 34 03
		 0F 04 ED 03
		 CE 07 32 00
		 D3 02 3D 02
		 82 07 CE 04
		 5D 03 BD 07
		 A8 02 5B 02
		 AC 05 48 00
		 3C 00 44 00
		 46 64 48 00
		 4D 10 4B 10
		 4B 08 4A 00
		 4C 00 44 08
		 3F 08 39 00
		 4E 28 53 48
		 5C 58 66 0D
		 4C 00 5F 00
		 68 08 7A 00
		 69 00 50 00
		 4B 10 68 10
		 69 00 7B 28
		 92 48 5E 60
		 75 0C 7D 00
		 81 F8 6E 00
		 D8 F0 20 26
		 E6 05 00 0B
		 C8 15 0C 1D
		 8E 22 2D 45
		 85 5A 8D 18
		 14 02 A0 05
		 BF 03 9F 0F
		 3F 0A C1 1F
		 B1 05 39 02
		 B4 06 AB 1C
		 79 03 80 05
		 AF 02 6F 18
		 24 02 62 05
		 39 02 66 00
		 F2 1E 0D 05
		 53 03 CB 04
		 C0 1C B3 02
		 60 04 09 02
		 94 18 67 03
		 A4 04 4D 02
		 65 00 D3 00
		 C0 00 FA 00
		 09 16 00 00
	];
};
