/dts-v1/;

#include "vendor-base/qcom/bengal.dtsi"
#include "starlet-prune.dtsi"
#include "starlet-base.dtsi"

/ {
	model = "Starlet";
	compatible = "qcom,bengal", "oculus,starlet";
	qcom,msm-id = <417 0x10000>, <444 0x10000>, <470 0x10000>;
	qcom,board-id = <0 0>;
};
