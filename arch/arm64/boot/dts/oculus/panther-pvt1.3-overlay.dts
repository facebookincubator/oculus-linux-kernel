// SPDX-License-Identifier: GPL-2.0

/dts-v1/;
/plugin/;

#include <dt-bindings/gpio/gpio.h>
#include "panther-evt2-flood-led.dtsi"
#include "panther-blu-current-common.dtsi"

/ {
	model = "Panther (PVT1.3)";
	compatible = "oculus,panther-pvt1.3", "oculus,panther", "qcom,anorak";
	qcom,msm-id = <549 0x10000>;
	qcom,board-id = <0x10343 0x4>;  // board-id = <(major)(minor)(product) (subtype)>

};

&wlan {
	cal-file-prefix = "panther_pvt1.3_";
};

